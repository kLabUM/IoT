.ifndef INCLUDED_CYFITTERGNU_INC
.set INCLUDED_CYFITTERGNU_INC, 1
.include "cydevicegnu.inc"
.include "cydevicegnu_trm.inc"

/* I2C_1_I2C_IRQ */
.set I2C_1_I2C_IRQ__INTC_CLR_EN_REG, CYREG_NVIC_CLRENA0
.set I2C_1_I2C_IRQ__INTC_CLR_PD_REG, CYREG_NVIC_CLRPEND0
.set I2C_1_I2C_IRQ__INTC_MASK, 0x01
.set I2C_1_I2C_IRQ__INTC_NUMBER, 0
.set I2C_1_I2C_IRQ__INTC_PRIOR_NUM, 7
.set I2C_1_I2C_IRQ__INTC_PRIOR_REG, CYREG_NVIC_PRI_0
.set I2C_1_I2C_IRQ__INTC_SET_EN_REG, CYREG_NVIC_SETENA0
.set I2C_1_I2C_IRQ__INTC_SET_PD_REG, CYREG_NVIC_SETPEND0

/* I2C_1_I2C_FF */
.set I2C_1_I2C_FF__ADR, CYREG_I2C_ADR
.set I2C_1_I2C_FF__CFG, CYREG_I2C_CFG
.set I2C_1_I2C_FF__CLK_DIV, CYREG_I2C_CLK_DIV
.set I2C_1_I2C_FF__CSR, CYREG_I2C_CSR
.set I2C_1_I2C_FF__D, CYREG_I2C_D
.set I2C_1_I2C_FF__MCSR, CYREG_I2C_MCSR
.set I2C_1_I2C_FF__PM_ACT_CFG, CYREG_PM_ACT_CFG5
.set I2C_1_I2C_FF__PM_ACT_MSK, 0x04
.set I2C_1_I2C_FF__PM_STBY_CFG, CYREG_PM_STBY_CFG5
.set I2C_1_I2C_FF__PM_STBY_MSK, 0x04
.set I2C_1_I2C_FF__XCFG, CYREG_I2C_XCFG

/* crustal */
.set crustal__0__MASK, 0x08
.set crustal__0__PC, CYREG_PRT15_PC3
.set crustal__0__PORT, 15
.set crustal__0__SHIFT, 3
.set crustal__AG, CYREG_PRT15_AG
.set crustal__AMUX, CYREG_PRT15_AMUX
.set crustal__BIE, CYREG_PRT15_BIE
.set crustal__BIT_MASK, CYREG_PRT15_BIT_MASK
.set crustal__BYP, CYREG_PRT15_BYP
.set crustal__CTL, CYREG_PRT15_CTL
.set crustal__DM0, CYREG_PRT15_DM0
.set crustal__DM1, CYREG_PRT15_DM1
.set crustal__DM2, CYREG_PRT15_DM2
.set crustal__DR, CYREG_PRT15_DR
.set crustal__INP_DIS, CYREG_PRT15_INP_DIS
.set crustal__LCD_COM_SEG, CYREG_PRT15_LCD_COM_SEG
.set crustal__LCD_EN, CYREG_PRT15_LCD_EN
.set crustal__MASK, 0x08
.set crustal__PORT, 15
.set crustal__PRT, CYREG_PRT15_PRT
.set crustal__PRTDSI__CAPS_SEL, CYREG_PRT15_CAPS_SEL
.set crustal__PRTDSI__DBL_SYNC_IN, CYREG_PRT15_DBL_SYNC_IN
.set crustal__PRTDSI__OE_SEL0, CYREG_PRT15_OE_SEL0
.set crustal__PRTDSI__OE_SEL1, CYREG_PRT15_OE_SEL1
.set crustal__PRTDSI__OUT_SEL0, CYREG_PRT15_OUT_SEL0
.set crustal__PRTDSI__OUT_SEL1, CYREG_PRT15_OUT_SEL1
.set crustal__PRTDSI__SYNC_OUT, CYREG_PRT15_SYNC_OUT
.set crustal__PS, CYREG_PRT15_PS
.set crustal__SHIFT, 3
.set crustal__SLW, CYREG_PRT15_SLW

/* Pin_14 */
.set Pin_14__0__MASK, 0x10
.set Pin_14__0__PC, CYREG_PRT12_PC4
.set Pin_14__0__PORT, 12
.set Pin_14__0__SHIFT, 4
.set Pin_14__AG, CYREG_PRT12_AG
.set Pin_14__BIE, CYREG_PRT12_BIE
.set Pin_14__BIT_MASK, CYREG_PRT12_BIT_MASK
.set Pin_14__BYP, CYREG_PRT12_BYP
.set Pin_14__DM0, CYREG_PRT12_DM0
.set Pin_14__DM1, CYREG_PRT12_DM1
.set Pin_14__DM2, CYREG_PRT12_DM2
.set Pin_14__DR, CYREG_PRT12_DR
.set Pin_14__INP_DIS, CYREG_PRT12_INP_DIS
.set Pin_14__MASK, 0x10
.set Pin_14__PORT, 12
.set Pin_14__PRT, CYREG_PRT12_PRT
.set Pin_14__PRTDSI__DBL_SYNC_IN, CYREG_PRT12_DBL_SYNC_IN
.set Pin_14__PRTDSI__OE_SEL0, CYREG_PRT12_OE_SEL0
.set Pin_14__PRTDSI__OE_SEL1, CYREG_PRT12_OE_SEL1
.set Pin_14__PRTDSI__OUT_SEL0, CYREG_PRT12_OUT_SEL0
.set Pin_14__PRTDSI__OUT_SEL1, CYREG_PRT12_OUT_SEL1
.set Pin_14__PRTDSI__SYNC_OUT, CYREG_PRT12_SYNC_OUT
.set Pin_14__PS, CYREG_PRT12_PS
.set Pin_14__SHIFT, 4
.set Pin_14__SIO_CFG, CYREG_PRT12_SIO_CFG
.set Pin_14__SIO_DIFF, CYREG_PRT12_SIO_DIFF
.set Pin_14__SIO_HYST_EN, CYREG_PRT12_SIO_HYST_EN
.set Pin_14__SIO_REG_HIFREQ, CYREG_PRT12_SIO_REG_HIFREQ
.set Pin_14__SLW, CYREG_PRT12_SLW

/* Pin_15 */
.set Pin_15__0__MASK, 0x20
.set Pin_15__0__PC, CYREG_PRT12_PC5
.set Pin_15__0__PORT, 12
.set Pin_15__0__SHIFT, 5
.set Pin_15__AG, CYREG_PRT12_AG
.set Pin_15__BIE, CYREG_PRT12_BIE
.set Pin_15__BIT_MASK, CYREG_PRT12_BIT_MASK
.set Pin_15__BYP, CYREG_PRT12_BYP
.set Pin_15__DM0, CYREG_PRT12_DM0
.set Pin_15__DM1, CYREG_PRT12_DM1
.set Pin_15__DM2, CYREG_PRT12_DM2
.set Pin_15__DR, CYREG_PRT12_DR
.set Pin_15__INP_DIS, CYREG_PRT12_INP_DIS
.set Pin_15__MASK, 0x20
.set Pin_15__PORT, 12
.set Pin_15__PRT, CYREG_PRT12_PRT
.set Pin_15__PRTDSI__DBL_SYNC_IN, CYREG_PRT12_DBL_SYNC_IN
.set Pin_15__PRTDSI__OE_SEL0, CYREG_PRT12_OE_SEL0
.set Pin_15__PRTDSI__OE_SEL1, CYREG_PRT12_OE_SEL1
.set Pin_15__PRTDSI__OUT_SEL0, CYREG_PRT12_OUT_SEL0
.set Pin_15__PRTDSI__OUT_SEL1, CYREG_PRT12_OUT_SEL1
.set Pin_15__PRTDSI__SYNC_OUT, CYREG_PRT12_SYNC_OUT
.set Pin_15__PS, CYREG_PRT12_PS
.set Pin_15__SHIFT, 5
.set Pin_15__SIO_CFG, CYREG_PRT12_SIO_CFG
.set Pin_15__SIO_DIFF, CYREG_PRT12_SIO_DIFF
.set Pin_15__SIO_HYST_EN, CYREG_PRT12_SIO_HYST_EN
.set Pin_15__SIO_REG_HIFREQ, CYREG_PRT12_SIO_REG_HIFREQ
.set Pin_15__SLW, CYREG_PRT12_SLW

/* inbt2 */
.set inbt2__0__MASK, 0x80
.set inbt2__0__PC, CYREG_PRT1_PC7
.set inbt2__0__PORT, 1
.set inbt2__0__SHIFT, 7
.set inbt2__AG, CYREG_PRT1_AG
.set inbt2__AMUX, CYREG_PRT1_AMUX
.set inbt2__BIE, CYREG_PRT1_BIE
.set inbt2__BIT_MASK, CYREG_PRT1_BIT_MASK
.set inbt2__BYP, CYREG_PRT1_BYP
.set inbt2__CTL, CYREG_PRT1_CTL
.set inbt2__DM0, CYREG_PRT1_DM0
.set inbt2__DM1, CYREG_PRT1_DM1
.set inbt2__DM2, CYREG_PRT1_DM2
.set inbt2__DR, CYREG_PRT1_DR
.set inbt2__INP_DIS, CYREG_PRT1_INP_DIS
.set inbt2__LCD_COM_SEG, CYREG_PRT1_LCD_COM_SEG
.set inbt2__LCD_EN, CYREG_PRT1_LCD_EN
.set inbt2__MASK, 0x80
.set inbt2__PORT, 1
.set inbt2__PRT, CYREG_PRT1_PRT
.set inbt2__PRTDSI__CAPS_SEL, CYREG_PRT1_CAPS_SEL
.set inbt2__PRTDSI__DBL_SYNC_IN, CYREG_PRT1_DBL_SYNC_IN
.set inbt2__PRTDSI__OE_SEL0, CYREG_PRT1_OE_SEL0
.set inbt2__PRTDSI__OE_SEL1, CYREG_PRT1_OE_SEL1
.set inbt2__PRTDSI__OUT_SEL0, CYREG_PRT1_OUT_SEL0
.set inbt2__PRTDSI__OUT_SEL1, CYREG_PRT1_OUT_SEL1
.set inbt2__PRTDSI__SYNC_OUT, CYREG_PRT1_SYNC_OUT
.set inbt2__PS, CYREG_PRT1_PS
.set inbt2__SHIFT, 7
.set inbt2__SLW, CYREG_PRT1_SLW

/* isr_1 */
.set isr_1__INTC_CLR_EN_REG, CYREG_NVIC_CLRENA0
.set isr_1__INTC_CLR_PD_REG, CYREG_NVIC_CLRPEND0
.set isr_1__INTC_MASK, 0x20
.set isr_1__INTC_NUMBER, 5
.set isr_1__INTC_PRIOR_NUM, 7
.set isr_1__INTC_PRIOR_REG, CYREG_NVIC_PRI_5
.set isr_1__INTC_SET_EN_REG, CYREG_NVIC_SETENA0
.set isr_1__INTC_SET_PD_REG, CYREG_NVIC_SETPEND0

/* Pin_1 */
.set Pin_1__0__MASK, 0x20
.set Pin_1__0__PC, CYREG_PRT3_PC5
.set Pin_1__0__PORT, 3
.set Pin_1__0__SHIFT, 5
.set Pin_1__AG, CYREG_PRT3_AG
.set Pin_1__AMUX, CYREG_PRT3_AMUX
.set Pin_1__BIE, CYREG_PRT3_BIE
.set Pin_1__BIT_MASK, CYREG_PRT3_BIT_MASK
.set Pin_1__BYP, CYREG_PRT3_BYP
.set Pin_1__CTL, CYREG_PRT3_CTL
.set Pin_1__DM0, CYREG_PRT3_DM0
.set Pin_1__DM1, CYREG_PRT3_DM1
.set Pin_1__DM2, CYREG_PRT3_DM2
.set Pin_1__DR, CYREG_PRT3_DR
.set Pin_1__INP_DIS, CYREG_PRT3_INP_DIS
.set Pin_1__LCD_COM_SEG, CYREG_PRT3_LCD_COM_SEG
.set Pin_1__LCD_EN, CYREG_PRT3_LCD_EN
.set Pin_1__MASK, 0x20
.set Pin_1__PORT, 3
.set Pin_1__PRT, CYREG_PRT3_PRT
.set Pin_1__PRTDSI__CAPS_SEL, CYREG_PRT3_CAPS_SEL
.set Pin_1__PRTDSI__DBL_SYNC_IN, CYREG_PRT3_DBL_SYNC_IN
.set Pin_1__PRTDSI__OE_SEL0, CYREG_PRT3_OE_SEL0
.set Pin_1__PRTDSI__OE_SEL1, CYREG_PRT3_OE_SEL1
.set Pin_1__PRTDSI__OUT_SEL0, CYREG_PRT3_OUT_SEL0
.set Pin_1__PRTDSI__OUT_SEL1, CYREG_PRT3_OUT_SEL1
.set Pin_1__PRTDSI__SYNC_OUT, CYREG_PRT3_SYNC_OUT
.set Pin_1__PS, CYREG_PRT3_PS
.set Pin_1__SHIFT, 5
.set Pin_1__SLW, CYREG_PRT3_SLW

/* Pin_2 */
.set Pin_2__0__MASK, 0x01
.set Pin_2__0__PC, CYREG_PRT2_PC0
.set Pin_2__0__PORT, 2
.set Pin_2__0__SHIFT, 0
.set Pin_2__AG, CYREG_PRT2_AG
.set Pin_2__AMUX, CYREG_PRT2_AMUX
.set Pin_2__BIE, CYREG_PRT2_BIE
.set Pin_2__BIT_MASK, CYREG_PRT2_BIT_MASK
.set Pin_2__BYP, CYREG_PRT2_BYP
.set Pin_2__CTL, CYREG_PRT2_CTL
.set Pin_2__DM0, CYREG_PRT2_DM0
.set Pin_2__DM1, CYREG_PRT2_DM1
.set Pin_2__DM2, CYREG_PRT2_DM2
.set Pin_2__DR, CYREG_PRT2_DR
.set Pin_2__INP_DIS, CYREG_PRT2_INP_DIS
.set Pin_2__LCD_COM_SEG, CYREG_PRT2_LCD_COM_SEG
.set Pin_2__LCD_EN, CYREG_PRT2_LCD_EN
.set Pin_2__MASK, 0x01
.set Pin_2__PORT, 2
.set Pin_2__PRT, CYREG_PRT2_PRT
.set Pin_2__PRTDSI__CAPS_SEL, CYREG_PRT2_CAPS_SEL
.set Pin_2__PRTDSI__DBL_SYNC_IN, CYREG_PRT2_DBL_SYNC_IN
.set Pin_2__PRTDSI__OE_SEL0, CYREG_PRT2_OE_SEL0
.set Pin_2__PRTDSI__OE_SEL1, CYREG_PRT2_OE_SEL1
.set Pin_2__PRTDSI__OUT_SEL0, CYREG_PRT2_OUT_SEL0
.set Pin_2__PRTDSI__OUT_SEL1, CYREG_PRT2_OUT_SEL1
.set Pin_2__PRTDSI__SYNC_OUT, CYREG_PRT2_SYNC_OUT
.set Pin_2__PS, CYREG_PRT2_PS
.set Pin_2__SHIFT, 0
.set Pin_2__SLW, CYREG_PRT2_SLW

/* Pin_3 */
.set Pin_3__0__MASK, 0x02
.set Pin_3__0__PC, CYREG_PRT2_PC1
.set Pin_3__0__PORT, 2
.set Pin_3__0__SHIFT, 1
.set Pin_3__AG, CYREG_PRT2_AG
.set Pin_3__AMUX, CYREG_PRT2_AMUX
.set Pin_3__BIE, CYREG_PRT2_BIE
.set Pin_3__BIT_MASK, CYREG_PRT2_BIT_MASK
.set Pin_3__BYP, CYREG_PRT2_BYP
.set Pin_3__CTL, CYREG_PRT2_CTL
.set Pin_3__DM0, CYREG_PRT2_DM0
.set Pin_3__DM1, CYREG_PRT2_DM1
.set Pin_3__DM2, CYREG_PRT2_DM2
.set Pin_3__DR, CYREG_PRT2_DR
.set Pin_3__INP_DIS, CYREG_PRT2_INP_DIS
.set Pin_3__LCD_COM_SEG, CYREG_PRT2_LCD_COM_SEG
.set Pin_3__LCD_EN, CYREG_PRT2_LCD_EN
.set Pin_3__MASK, 0x02
.set Pin_3__PORT, 2
.set Pin_3__PRT, CYREG_PRT2_PRT
.set Pin_3__PRTDSI__CAPS_SEL, CYREG_PRT2_CAPS_SEL
.set Pin_3__PRTDSI__DBL_SYNC_IN, CYREG_PRT2_DBL_SYNC_IN
.set Pin_3__PRTDSI__OE_SEL0, CYREG_PRT2_OE_SEL0
.set Pin_3__PRTDSI__OE_SEL1, CYREG_PRT2_OE_SEL1
.set Pin_3__PRTDSI__OUT_SEL0, CYREG_PRT2_OUT_SEL0
.set Pin_3__PRTDSI__OUT_SEL1, CYREG_PRT2_OUT_SEL1
.set Pin_3__PRTDSI__SYNC_OUT, CYREG_PRT2_SYNC_OUT
.set Pin_3__PS, CYREG_PRT2_PS
.set Pin_3__SHIFT, 1
.set Pin_3__SLW, CYREG_PRT2_SLW

/* Pin_4 */
.set Pin_4__0__MASK, 0x04
.set Pin_4__0__PC, CYREG_PRT2_PC2
.set Pin_4__0__PORT, 2
.set Pin_4__0__SHIFT, 2
.set Pin_4__AG, CYREG_PRT2_AG
.set Pin_4__AMUX, CYREG_PRT2_AMUX
.set Pin_4__BIE, CYREG_PRT2_BIE
.set Pin_4__BIT_MASK, CYREG_PRT2_BIT_MASK
.set Pin_4__BYP, CYREG_PRT2_BYP
.set Pin_4__CTL, CYREG_PRT2_CTL
.set Pin_4__DM0, CYREG_PRT2_DM0
.set Pin_4__DM1, CYREG_PRT2_DM1
.set Pin_4__DM2, CYREG_PRT2_DM2
.set Pin_4__DR, CYREG_PRT2_DR
.set Pin_4__INP_DIS, CYREG_PRT2_INP_DIS
.set Pin_4__LCD_COM_SEG, CYREG_PRT2_LCD_COM_SEG
.set Pin_4__LCD_EN, CYREG_PRT2_LCD_EN
.set Pin_4__MASK, 0x04
.set Pin_4__PORT, 2
.set Pin_4__PRT, CYREG_PRT2_PRT
.set Pin_4__PRTDSI__CAPS_SEL, CYREG_PRT2_CAPS_SEL
.set Pin_4__PRTDSI__DBL_SYNC_IN, CYREG_PRT2_DBL_SYNC_IN
.set Pin_4__PRTDSI__OE_SEL0, CYREG_PRT2_OE_SEL0
.set Pin_4__PRTDSI__OE_SEL1, CYREG_PRT2_OE_SEL1
.set Pin_4__PRTDSI__OUT_SEL0, CYREG_PRT2_OUT_SEL0
.set Pin_4__PRTDSI__OUT_SEL1, CYREG_PRT2_OUT_SEL1
.set Pin_4__PRTDSI__SYNC_OUT, CYREG_PRT2_SYNC_OUT
.set Pin_4__PS, CYREG_PRT2_PS
.set Pin_4__SHIFT, 2
.set Pin_4__SLW, CYREG_PRT2_SLW

/* Pin_5 */
.set Pin_5__0__MASK, 0x08
.set Pin_5__0__PC, CYREG_PRT2_PC3
.set Pin_5__0__PORT, 2
.set Pin_5__0__SHIFT, 3
.set Pin_5__AG, CYREG_PRT2_AG
.set Pin_5__AMUX, CYREG_PRT2_AMUX
.set Pin_5__BIE, CYREG_PRT2_BIE
.set Pin_5__BIT_MASK, CYREG_PRT2_BIT_MASK
.set Pin_5__BYP, CYREG_PRT2_BYP
.set Pin_5__CTL, CYREG_PRT2_CTL
.set Pin_5__DM0, CYREG_PRT2_DM0
.set Pin_5__DM1, CYREG_PRT2_DM1
.set Pin_5__DM2, CYREG_PRT2_DM2
.set Pin_5__DR, CYREG_PRT2_DR
.set Pin_5__INP_DIS, CYREG_PRT2_INP_DIS
.set Pin_5__LCD_COM_SEG, CYREG_PRT2_LCD_COM_SEG
.set Pin_5__LCD_EN, CYREG_PRT2_LCD_EN
.set Pin_5__MASK, 0x08
.set Pin_5__PORT, 2
.set Pin_5__PRT, CYREG_PRT2_PRT
.set Pin_5__PRTDSI__CAPS_SEL, CYREG_PRT2_CAPS_SEL
.set Pin_5__PRTDSI__DBL_SYNC_IN, CYREG_PRT2_DBL_SYNC_IN
.set Pin_5__PRTDSI__OE_SEL0, CYREG_PRT2_OE_SEL0
.set Pin_5__PRTDSI__OE_SEL1, CYREG_PRT2_OE_SEL1
.set Pin_5__PRTDSI__OUT_SEL0, CYREG_PRT2_OUT_SEL0
.set Pin_5__PRTDSI__OUT_SEL1, CYREG_PRT2_OUT_SEL1
.set Pin_5__PRTDSI__SYNC_OUT, CYREG_PRT2_SYNC_OUT
.set Pin_5__PS, CYREG_PRT2_PS
.set Pin_5__SHIFT, 3
.set Pin_5__SLW, CYREG_PRT2_SLW

/* Pin_6 */
.set Pin_6__0__MASK, 0x10
.set Pin_6__0__PC, CYREG_PRT2_PC4
.set Pin_6__0__PORT, 2
.set Pin_6__0__SHIFT, 4
.set Pin_6__AG, CYREG_PRT2_AG
.set Pin_6__AMUX, CYREG_PRT2_AMUX
.set Pin_6__BIE, CYREG_PRT2_BIE
.set Pin_6__BIT_MASK, CYREG_PRT2_BIT_MASK
.set Pin_6__BYP, CYREG_PRT2_BYP
.set Pin_6__CTL, CYREG_PRT2_CTL
.set Pin_6__DM0, CYREG_PRT2_DM0
.set Pin_6__DM1, CYREG_PRT2_DM1
.set Pin_6__DM2, CYREG_PRT2_DM2
.set Pin_6__DR, CYREG_PRT2_DR
.set Pin_6__INP_DIS, CYREG_PRT2_INP_DIS
.set Pin_6__LCD_COM_SEG, CYREG_PRT2_LCD_COM_SEG
.set Pin_6__LCD_EN, CYREG_PRT2_LCD_EN
.set Pin_6__MASK, 0x10
.set Pin_6__PORT, 2
.set Pin_6__PRT, CYREG_PRT2_PRT
.set Pin_6__PRTDSI__CAPS_SEL, CYREG_PRT2_CAPS_SEL
.set Pin_6__PRTDSI__DBL_SYNC_IN, CYREG_PRT2_DBL_SYNC_IN
.set Pin_6__PRTDSI__OE_SEL0, CYREG_PRT2_OE_SEL0
.set Pin_6__PRTDSI__OE_SEL1, CYREG_PRT2_OE_SEL1
.set Pin_6__PRTDSI__OUT_SEL0, CYREG_PRT2_OUT_SEL0
.set Pin_6__PRTDSI__OUT_SEL1, CYREG_PRT2_OUT_SEL1
.set Pin_6__PRTDSI__SYNC_OUT, CYREG_PRT2_SYNC_OUT
.set Pin_6__PS, CYREG_PRT2_PS
.set Pin_6__SHIFT, 4
.set Pin_6__SLW, CYREG_PRT2_SLW

/* Pin_7 */
.set Pin_7__0__MASK, 0x40
.set Pin_7__0__PC, CYREG_PRT2_PC6
.set Pin_7__0__PORT, 2
.set Pin_7__0__SHIFT, 6
.set Pin_7__AG, CYREG_PRT2_AG
.set Pin_7__AMUX, CYREG_PRT2_AMUX
.set Pin_7__BIE, CYREG_PRT2_BIE
.set Pin_7__BIT_MASK, CYREG_PRT2_BIT_MASK
.set Pin_7__BYP, CYREG_PRT2_BYP
.set Pin_7__CTL, CYREG_PRT2_CTL
.set Pin_7__DM0, CYREG_PRT2_DM0
.set Pin_7__DM1, CYREG_PRT2_DM1
.set Pin_7__DM2, CYREG_PRT2_DM2
.set Pin_7__DR, CYREG_PRT2_DR
.set Pin_7__INP_DIS, CYREG_PRT2_INP_DIS
.set Pin_7__LCD_COM_SEG, CYREG_PRT2_LCD_COM_SEG
.set Pin_7__LCD_EN, CYREG_PRT2_LCD_EN
.set Pin_7__MASK, 0x40
.set Pin_7__PORT, 2
.set Pin_7__PRT, CYREG_PRT2_PRT
.set Pin_7__PRTDSI__CAPS_SEL, CYREG_PRT2_CAPS_SEL
.set Pin_7__PRTDSI__DBL_SYNC_IN, CYREG_PRT2_DBL_SYNC_IN
.set Pin_7__PRTDSI__OE_SEL0, CYREG_PRT2_OE_SEL0
.set Pin_7__PRTDSI__OE_SEL1, CYREG_PRT2_OE_SEL1
.set Pin_7__PRTDSI__OUT_SEL0, CYREG_PRT2_OUT_SEL0
.set Pin_7__PRTDSI__OUT_SEL1, CYREG_PRT2_OUT_SEL1
.set Pin_7__PRTDSI__SYNC_OUT, CYREG_PRT2_SYNC_OUT
.set Pin_7__PS, CYREG_PRT2_PS
.set Pin_7__SHIFT, 6
.set Pin_7__SLW, CYREG_PRT2_SLW

/* Pin_8 */
.set Pin_8__0__MASK, 0x20
.set Pin_8__0__PC, CYREG_PRT2_PC5
.set Pin_8__0__PORT, 2
.set Pin_8__0__SHIFT, 5
.set Pin_8__AG, CYREG_PRT2_AG
.set Pin_8__AMUX, CYREG_PRT2_AMUX
.set Pin_8__BIE, CYREG_PRT2_BIE
.set Pin_8__BIT_MASK, CYREG_PRT2_BIT_MASK
.set Pin_8__BYP, CYREG_PRT2_BYP
.set Pin_8__CTL, CYREG_PRT2_CTL
.set Pin_8__DM0, CYREG_PRT2_DM0
.set Pin_8__DM1, CYREG_PRT2_DM1
.set Pin_8__DM2, CYREG_PRT2_DM2
.set Pin_8__DR, CYREG_PRT2_DR
.set Pin_8__INP_DIS, CYREG_PRT2_INP_DIS
.set Pin_8__LCD_COM_SEG, CYREG_PRT2_LCD_COM_SEG
.set Pin_8__LCD_EN, CYREG_PRT2_LCD_EN
.set Pin_8__MASK, 0x20
.set Pin_8__PORT, 2
.set Pin_8__PRT, CYREG_PRT2_PRT
.set Pin_8__PRTDSI__CAPS_SEL, CYREG_PRT2_CAPS_SEL
.set Pin_8__PRTDSI__DBL_SYNC_IN, CYREG_PRT2_DBL_SYNC_IN
.set Pin_8__PRTDSI__OE_SEL0, CYREG_PRT2_OE_SEL0
.set Pin_8__PRTDSI__OE_SEL1, CYREG_PRT2_OE_SEL1
.set Pin_8__PRTDSI__OUT_SEL0, CYREG_PRT2_OUT_SEL0
.set Pin_8__PRTDSI__OUT_SEL1, CYREG_PRT2_OUT_SEL1
.set Pin_8__PRTDSI__SYNC_OUT, CYREG_PRT2_SYNC_OUT
.set Pin_8__PS, CYREG_PRT2_PS
.set Pin_8__SHIFT, 5
.set Pin_8__SLW, CYREG_PRT2_SLW

/* Pin_9 */
.set Pin_9__0__MASK, 0x80
.set Pin_9__0__PC, CYREG_PRT2_PC7
.set Pin_9__0__PORT, 2
.set Pin_9__0__SHIFT, 7
.set Pin_9__AG, CYREG_PRT2_AG
.set Pin_9__AMUX, CYREG_PRT2_AMUX
.set Pin_9__BIE, CYREG_PRT2_BIE
.set Pin_9__BIT_MASK, CYREG_PRT2_BIT_MASK
.set Pin_9__BYP, CYREG_PRT2_BYP
.set Pin_9__CTL, CYREG_PRT2_CTL
.set Pin_9__DM0, CYREG_PRT2_DM0
.set Pin_9__DM1, CYREG_PRT2_DM1
.set Pin_9__DM2, CYREG_PRT2_DM2
.set Pin_9__DR, CYREG_PRT2_DR
.set Pin_9__INP_DIS, CYREG_PRT2_INP_DIS
.set Pin_9__LCD_COM_SEG, CYREG_PRT2_LCD_COM_SEG
.set Pin_9__LCD_EN, CYREG_PRT2_LCD_EN
.set Pin_9__MASK, 0x80
.set Pin_9__PORT, 2
.set Pin_9__PRT, CYREG_PRT2_PRT
.set Pin_9__PRTDSI__CAPS_SEL, CYREG_PRT2_CAPS_SEL
.set Pin_9__PRTDSI__DBL_SYNC_IN, CYREG_PRT2_DBL_SYNC_IN
.set Pin_9__PRTDSI__OE_SEL0, CYREG_PRT2_OE_SEL0
.set Pin_9__PRTDSI__OE_SEL1, CYREG_PRT2_OE_SEL1
.set Pin_9__PRTDSI__OUT_SEL0, CYREG_PRT2_OUT_SEL0
.set Pin_9__PRTDSI__OUT_SEL1, CYREG_PRT2_OUT_SEL1
.set Pin_9__PRTDSI__SYNC_OUT, CYREG_PRT2_SYNC_OUT
.set Pin_9__PS, CYREG_PRT2_PS
.set Pin_9__SHIFT, 7
.set Pin_9__SLW, CYREG_PRT2_SLW

/* int1 */
.set int1__0__MASK, 0x40
.set int1__0__PC, CYREG_PRT1_PC6
.set int1__0__PORT, 1
.set int1__0__SHIFT, 6
.set int1__AG, CYREG_PRT1_AG
.set int1__AMUX, CYREG_PRT1_AMUX
.set int1__BIE, CYREG_PRT1_BIE
.set int1__BIT_MASK, CYREG_PRT1_BIT_MASK
.set int1__BYP, CYREG_PRT1_BYP
.set int1__CTL, CYREG_PRT1_CTL
.set int1__DM0, CYREG_PRT1_DM0
.set int1__DM1, CYREG_PRT1_DM1
.set int1__DM2, CYREG_PRT1_DM2
.set int1__DR, CYREG_PRT1_DR
.set int1__INP_DIS, CYREG_PRT1_INP_DIS
.set int1__INTSTAT, CYREG_PICU1_INTSTAT
.set int1__LCD_COM_SEG, CYREG_PRT1_LCD_COM_SEG
.set int1__LCD_EN, CYREG_PRT1_LCD_EN
.set int1__MASK, 0x40
.set int1__PORT, 1
.set int1__PRT, CYREG_PRT1_PRT
.set int1__PRTDSI__CAPS_SEL, CYREG_PRT1_CAPS_SEL
.set int1__PRTDSI__DBL_SYNC_IN, CYREG_PRT1_DBL_SYNC_IN
.set int1__PRTDSI__OE_SEL0, CYREG_PRT1_OE_SEL0
.set int1__PRTDSI__OE_SEL1, CYREG_PRT1_OE_SEL1
.set int1__PRTDSI__OUT_SEL0, CYREG_PRT1_OUT_SEL0
.set int1__PRTDSI__OUT_SEL1, CYREG_PRT1_OUT_SEL1
.set int1__PRTDSI__SYNC_OUT, CYREG_PRT1_SYNC_OUT
.set int1__PS, CYREG_PRT1_PS
.set int1__SHIFT, 6
.set int1__SLW, CYREG_PRT1_SLW
.set int1__SNAP, CYREG_PICU1_SNAP

/* Miscellaneous */
/* -- WARNING: define names containing LEOPARD or PANTHER are deprecated and will be removed in a future release */
.set CYDEV_DEBUGGING_DPS_SWD_SWV, 6
.set CYDEV_CONFIG_UNUSED_IO_AllowButWarn, 0
.set CYDEV_CONFIGURATION_MODE_COMPRESSED, 0
.set CYDEV_CONFIG_FASTBOOT_ENABLED, 0
.set CYDEV_CHIP_REV_PANTHER_PRODUCTION, 1
.set CYDEV_CHIP_REVISION_5A_PRODUCTION, 1
.set CYDEV_CHIP_MEMBER_5A, 3
.set CYDEV_CHIP_FAMILY_PSOC5, 3
.set CYDEV_CHIP_DIE_PANTHER, 3
.set CYDEV_CHIP_DIE_EXPECT, CYDEV_CHIP_DIE_PANTHER
.set BCLK__BUS_CLK__HZ, 24000000
.set BCLK__BUS_CLK__KHZ, 24000
.set BCLK__BUS_CLK__MHZ, 24
.set CYDEV_CHIP_DIE_ACTUAL, CYDEV_CHIP_DIE_EXPECT
.set CYDEV_CHIP_DIE_LEOPARD, 1
.set CYDEV_CHIP_DIE_PSOC4A, 2
.set CYDEV_CHIP_DIE_PSOC5LP, 4
.set CYDEV_CHIP_DIE_UNKNOWN, 0
.set CYDEV_CHIP_FAMILY_PSOC3, 1
.set CYDEV_CHIP_FAMILY_PSOC4, 2
.set CYDEV_CHIP_FAMILY_UNKNOWN, 0
.set CYDEV_CHIP_FAMILY_USED, CYDEV_CHIP_FAMILY_PSOC5
.set CYDEV_CHIP_JTAG_ID, 0x0E13C069
.set CYDEV_CHIP_MEMBER_3A, 1
.set CYDEV_CHIP_MEMBER_4A, 2
.set CYDEV_CHIP_MEMBER_5B, 4
.set CYDEV_CHIP_MEMBER_UNKNOWN, 0
.set CYDEV_CHIP_MEMBER_USED, CYDEV_CHIP_MEMBER_5A
.set CYDEV_CHIP_REVISION_3A_ES1, 0
.set CYDEV_CHIP_REVISION_3A_ES2, 1
.set CYDEV_CHIP_REVISION_3A_ES3, 3
.set CYDEV_CHIP_REVISION_3A_PRODUCTION, 3
.set CYDEV_CHIP_REVISION_4A_ES0, 17
.set CYDEV_CHIP_REVISION_4A_PRODUCTION, 17
.set CYDEV_CHIP_REVISION_5A_ES0, 0
.set CYDEV_CHIP_REVISION_5A_ES1, 1
.set CYDEV_CHIP_REVISION_5B_ES0, 0
.set CYDEV_CHIP_REVISION_5B_PRODUCTION, 0
.set CYDEV_CHIP_REVISION_USED, CYDEV_CHIP_REVISION_5A_PRODUCTION
.set CYDEV_CHIP_REV_EXPECT, CYDEV_CHIP_REV_PANTHER_PRODUCTION
.set CYDEV_CHIP_REV_LEOPARD_ES1, 0
.set CYDEV_CHIP_REV_LEOPARD_ES2, 1
.set CYDEV_CHIP_REV_LEOPARD_ES3, 3
.set CYDEV_CHIP_REV_LEOPARD_PRODUCTION, 3
.set CYDEV_CHIP_REV_PANTHER_ES0, 0
.set CYDEV_CHIP_REV_PANTHER_ES1, 1
.set CYDEV_CHIP_REV_PSOC4A_ES0, 17
.set CYDEV_CHIP_REV_PSOC4A_PRODUCTION, 17
.set CYDEV_CHIP_REV_PSOC5LP_ES0, 0
.set CYDEV_CHIP_REV_PSOC5LP_PRODUCTION, 0
.set CYDEV_CONFIGURATION_COMPRESSED, 1
.set CYDEV_CONFIGURATION_DMA, 0
.set CYDEV_CONFIGURATION_ECC, 1
.set CYDEV_CONFIGURATION_IMOENABLED, CYDEV_CONFIG_FASTBOOT_ENABLED
.set CYDEV_CONFIGURATION_MODE, CYDEV_CONFIGURATION_MODE_COMPRESSED
.set CYDEV_CONFIGURATION_MODE_DMA, 2
.set CYDEV_CONFIGURATION_MODE_UNCOMPRESSED, 1
.set CYDEV_CONFIG_UNUSED_IO, CYDEV_CONFIG_UNUSED_IO_AllowButWarn
.set CYDEV_CONFIG_UNUSED_IO_AllowWithInfo, 1
.set CYDEV_CONFIG_UNUSED_IO_Disallowed, 2
.set CYDEV_DATA_CACHE_ENABLED, 0
.set CYDEV_DEBUGGING_DPS, CYDEV_DEBUGGING_DPS_SWD_SWV
.set CYDEV_DEBUGGING_DPS_Disable, 3
.set CYDEV_DEBUGGING_ENABLE, 1
.set CYDEV_DEBUGGING_REQXRES, 1
.set CYDEV_DEBUGGING_XRES, 0
.set CYDEV_DEBUG_ENABLE_MASK, 0x01
.set CYDEV_DEBUG_ENABLE_REGISTER, CYREG_MLOGIC_DBG_DBE
.set CYDEV_DMA_CHANNELS_AVAILABLE, 24
.set CYDEV_ECC_ENABLE, 0
.set CYDEV_HEAP_SIZE, 0x1000
.set CYDEV_INSTRUCT_CACHE_ENABLED, 1
.set CYDEV_INTR_RISING, 0x00000001
.set CYDEV_PROJ_TYPE, 0
.set CYDEV_PROJ_TYPE_BOOTLOADER, 1
.set CYDEV_PROJ_TYPE_LOADABLE, 2
.set CYDEV_PROJ_TYPE_MULTIAPPBOOTLOADER, 3
.set CYDEV_PROJ_TYPE_STANDARD, 0
.set CYDEV_PROTECTION_ENABLE, 0
.set CYDEV_STACK_SIZE, 0x4000
.set CYDEV_USE_BUNDLED_CMSIS, 1
.set CYDEV_VDDA, 5
.set CYDEV_VDDA_MV, 5000
.set CYDEV_VDDD_MV, 3300
.set CYDEV_VDDIO0_MV, 5000
.set CYDEV_VDDIO1_MV, 3300
.set CYDEV_VDDIO2_MV, 3300
.set CYDEV_VDDIO3_MV, 5000
.set CYDEV_VIO0, 5
.set CYDEV_VIO0_MV, 5000
.set CYDEV_VIO1_MV, 3300
.set CYDEV_VIO2_MV, 3300
.set CYDEV_VIO3, 5
.set CYDEV_VIO3_MV, 5000
.set DMA_CHANNELS_USED__MASK0, 0x00000000
.set CYDEV_BOOTLOADER_ENABLE, 0
.endif
