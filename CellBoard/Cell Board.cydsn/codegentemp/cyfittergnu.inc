.ifndef INCLUDED_CYFITTERGNU_INC
.set INCLUDED_CYFITTERGNU_INC, 1
.include "cydevicegnu.inc"
.include "cydevicegnu_trm.inc"

/* LED */
.set LED__0__INTTYPE, CYREG_PICU2_INTTYPE0
.set LED__0__MASK, 0x01
.set LED__0__PC, CYREG_PRT2_PC0
.set LED__0__PORT, 2
.set LED__0__SHIFT, 0
.set LED__AG, CYREG_PRT2_AG
.set LED__AMUX, CYREG_PRT2_AMUX
.set LED__BIE, CYREG_PRT2_BIE
.set LED__BIT_MASK, CYREG_PRT2_BIT_MASK
.set LED__BYP, CYREG_PRT2_BYP
.set LED__CTL, CYREG_PRT2_CTL
.set LED__DM0, CYREG_PRT2_DM0
.set LED__DM1, CYREG_PRT2_DM1
.set LED__DM2, CYREG_PRT2_DM2
.set LED__DR, CYREG_PRT2_DR
.set LED__INP_DIS, CYREG_PRT2_INP_DIS
.set LED__INTTYPE_BASE, CYDEV_PICU_INTTYPE_PICU2_BASE
.set LED__LCD_COM_SEG, CYREG_PRT2_LCD_COM_SEG
.set LED__LCD_EN, CYREG_PRT2_LCD_EN
.set LED__MASK, 0x01
.set LED__PORT, 2
.set LED__PRT, CYREG_PRT2_PRT
.set LED__PRTDSI__CAPS_SEL, CYREG_PRT2_CAPS_SEL
.set LED__PRTDSI__DBL_SYNC_IN, CYREG_PRT2_DBL_SYNC_IN
.set LED__PRTDSI__OE_SEL0, CYREG_PRT2_OE_SEL0
.set LED__PRTDSI__OE_SEL1, CYREG_PRT2_OE_SEL1
.set LED__PRTDSI__OUT_SEL0, CYREG_PRT2_OUT_SEL0
.set LED__PRTDSI__OUT_SEL1, CYREG_PRT2_OUT_SEL1
.set LED__PRTDSI__SYNC_OUT, CYREG_PRT2_SYNC_OUT
.set LED__PS, CYREG_PRT2_PS
.set LED__SHIFT, 0
.set LED__SLW, CYREG_PRT2_SLW

/* Telit_ON */
.set Telit_ON__0__INTTYPE, CYREG_PICU15_INTTYPE1
.set Telit_ON__0__MASK, 0x02
.set Telit_ON__0__PC, CYREG_IO_PC_PRT15_PC1
.set Telit_ON__0__PORT, 15
.set Telit_ON__0__SHIFT, 1
.set Telit_ON__AG, CYREG_PRT15_AG
.set Telit_ON__AMUX, CYREG_PRT15_AMUX
.set Telit_ON__BIE, CYREG_PRT15_BIE
.set Telit_ON__BIT_MASK, CYREG_PRT15_BIT_MASK
.set Telit_ON__BYP, CYREG_PRT15_BYP
.set Telit_ON__CTL, CYREG_PRT15_CTL
.set Telit_ON__DM0, CYREG_PRT15_DM0
.set Telit_ON__DM1, CYREG_PRT15_DM1
.set Telit_ON__DM2, CYREG_PRT15_DM2
.set Telit_ON__DR, CYREG_PRT15_DR
.set Telit_ON__INP_DIS, CYREG_PRT15_INP_DIS
.set Telit_ON__INTTYPE_BASE, CYDEV_PICU_INTTYPE_PICU15_BASE
.set Telit_ON__LCD_COM_SEG, CYREG_PRT15_LCD_COM_SEG
.set Telit_ON__LCD_EN, CYREG_PRT15_LCD_EN
.set Telit_ON__MASK, 0x02
.set Telit_ON__PORT, 15
.set Telit_ON__PRT, CYREG_PRT15_PRT
.set Telit_ON__PRTDSI__CAPS_SEL, CYREG_PRT15_CAPS_SEL
.set Telit_ON__PRTDSI__DBL_SYNC_IN, CYREG_PRT15_DBL_SYNC_IN
.set Telit_ON__PRTDSI__OE_SEL0, CYREG_PRT15_OE_SEL0
.set Telit_ON__PRTDSI__OE_SEL1, CYREG_PRT15_OE_SEL1
.set Telit_ON__PRTDSI__OUT_SEL0, CYREG_PRT15_OUT_SEL0
.set Telit_ON__PRTDSI__OUT_SEL1, CYREG_PRT15_OUT_SEL1
.set Telit_ON__PRTDSI__SYNC_OUT, CYREG_PRT15_SYNC_OUT
.set Telit_ON__PS, CYREG_PRT15_PS
.set Telit_ON__SHIFT, 1
.set Telit_ON__SLW, CYREG_PRT15_SLW

/* Telit_rx */
.set Telit_rx__0__INTTYPE, CYREG_PICU3_INTTYPE7
.set Telit_rx__0__MASK, 0x80
.set Telit_rx__0__PC, CYREG_PRT3_PC7
.set Telit_rx__0__PORT, 3
.set Telit_rx__0__SHIFT, 7
.set Telit_rx__AG, CYREG_PRT3_AG
.set Telit_rx__AMUX, CYREG_PRT3_AMUX
.set Telit_rx__BIE, CYREG_PRT3_BIE
.set Telit_rx__BIT_MASK, CYREG_PRT3_BIT_MASK
.set Telit_rx__BYP, CYREG_PRT3_BYP
.set Telit_rx__CTL, CYREG_PRT3_CTL
.set Telit_rx__DM0, CYREG_PRT3_DM0
.set Telit_rx__DM1, CYREG_PRT3_DM1
.set Telit_rx__DM2, CYREG_PRT3_DM2
.set Telit_rx__DR, CYREG_PRT3_DR
.set Telit_rx__INP_DIS, CYREG_PRT3_INP_DIS
.set Telit_rx__INTTYPE_BASE, CYDEV_PICU_INTTYPE_PICU3_BASE
.set Telit_rx__LCD_COM_SEG, CYREG_PRT3_LCD_COM_SEG
.set Telit_rx__LCD_EN, CYREG_PRT3_LCD_EN
.set Telit_rx__MASK, 0x80
.set Telit_rx__PORT, 3
.set Telit_rx__PRT, CYREG_PRT3_PRT
.set Telit_rx__PRTDSI__CAPS_SEL, CYREG_PRT3_CAPS_SEL
.set Telit_rx__PRTDSI__DBL_SYNC_IN, CYREG_PRT3_DBL_SYNC_IN
.set Telit_rx__PRTDSI__OE_SEL0, CYREG_PRT3_OE_SEL0
.set Telit_rx__PRTDSI__OE_SEL1, CYREG_PRT3_OE_SEL1
.set Telit_rx__PRTDSI__OUT_SEL0, CYREG_PRT3_OUT_SEL0
.set Telit_rx__PRTDSI__OUT_SEL1, CYREG_PRT3_OUT_SEL1
.set Telit_rx__PRTDSI__SYNC_OUT, CYREG_PRT3_SYNC_OUT
.set Telit_rx__PS, CYREG_PRT3_PS
.set Telit_rx__SHIFT, 7
.set Telit_rx__SLW, CYREG_PRT3_SLW

/* Telit_tx */
.set Telit_tx__0__INTTYPE, CYREG_PICU3_INTTYPE6
.set Telit_tx__0__MASK, 0x40
.set Telit_tx__0__PC, CYREG_PRT3_PC6
.set Telit_tx__0__PORT, 3
.set Telit_tx__0__SHIFT, 6
.set Telit_tx__AG, CYREG_PRT3_AG
.set Telit_tx__AMUX, CYREG_PRT3_AMUX
.set Telit_tx__BIE, CYREG_PRT3_BIE
.set Telit_tx__BIT_MASK, CYREG_PRT3_BIT_MASK
.set Telit_tx__BYP, CYREG_PRT3_BYP
.set Telit_tx__CTL, CYREG_PRT3_CTL
.set Telit_tx__DM0, CYREG_PRT3_DM0
.set Telit_tx__DM1, CYREG_PRT3_DM1
.set Telit_tx__DM2, CYREG_PRT3_DM2
.set Telit_tx__DR, CYREG_PRT3_DR
.set Telit_tx__INP_DIS, CYREG_PRT3_INP_DIS
.set Telit_tx__INTTYPE_BASE, CYDEV_PICU_INTTYPE_PICU3_BASE
.set Telit_tx__LCD_COM_SEG, CYREG_PRT3_LCD_COM_SEG
.set Telit_tx__LCD_EN, CYREG_PRT3_LCD_EN
.set Telit_tx__MASK, 0x40
.set Telit_tx__PORT, 3
.set Telit_tx__PRT, CYREG_PRT3_PRT
.set Telit_tx__PRTDSI__CAPS_SEL, CYREG_PRT3_CAPS_SEL
.set Telit_tx__PRTDSI__DBL_SYNC_IN, CYREG_PRT3_DBL_SYNC_IN
.set Telit_tx__PRTDSI__OE_SEL0, CYREG_PRT3_OE_SEL0
.set Telit_tx__PRTDSI__OE_SEL1, CYREG_PRT3_OE_SEL1
.set Telit_tx__PRTDSI__OUT_SEL0, CYREG_PRT3_OUT_SEL0
.set Telit_tx__PRTDSI__OUT_SEL1, CYREG_PRT3_OUT_SEL1
.set Telit_tx__PRTDSI__SYNC_OUT, CYREG_PRT3_SYNC_OUT
.set Telit_tx__PS, CYREG_PRT3_PS
.set Telit_tx__SHIFT, 6
.set Telit_tx__SLW, CYREG_PRT3_SLW

/* Telit_PWR */
.set Telit_PWR__0__INTTYPE, CYREG_PICU0_INTTYPE4
.set Telit_PWR__0__MASK, 0x10
.set Telit_PWR__0__PC, CYREG_PRT0_PC4
.set Telit_PWR__0__PORT, 0
.set Telit_PWR__0__SHIFT, 4
.set Telit_PWR__AG, CYREG_PRT0_AG
.set Telit_PWR__AMUX, CYREG_PRT0_AMUX
.set Telit_PWR__BIE, CYREG_PRT0_BIE
.set Telit_PWR__BIT_MASK, CYREG_PRT0_BIT_MASK
.set Telit_PWR__BYP, CYREG_PRT0_BYP
.set Telit_PWR__CTL, CYREG_PRT0_CTL
.set Telit_PWR__DM0, CYREG_PRT0_DM0
.set Telit_PWR__DM1, CYREG_PRT0_DM1
.set Telit_PWR__DM2, CYREG_PRT0_DM2
.set Telit_PWR__DR, CYREG_PRT0_DR
.set Telit_PWR__INP_DIS, CYREG_PRT0_INP_DIS
.set Telit_PWR__INTTYPE_BASE, CYDEV_PICU_INTTYPE_PICU0_BASE
.set Telit_PWR__LCD_COM_SEG, CYREG_PRT0_LCD_COM_SEG
.set Telit_PWR__LCD_EN, CYREG_PRT0_LCD_EN
.set Telit_PWR__MASK, 0x10
.set Telit_PWR__PORT, 0
.set Telit_PWR__PRT, CYREG_PRT0_PRT
.set Telit_PWR__PRTDSI__CAPS_SEL, CYREG_PRT0_CAPS_SEL
.set Telit_PWR__PRTDSI__DBL_SYNC_IN, CYREG_PRT0_DBL_SYNC_IN
.set Telit_PWR__PRTDSI__OE_SEL0, CYREG_PRT0_OE_SEL0
.set Telit_PWR__PRTDSI__OE_SEL1, CYREG_PRT0_OE_SEL1
.set Telit_PWR__PRTDSI__OUT_SEL0, CYREG_PRT0_OUT_SEL0
.set Telit_PWR__PRTDSI__OUT_SEL1, CYREG_PRT0_OUT_SEL1
.set Telit_PWR__PRTDSI__SYNC_OUT, CYREG_PRT0_SYNC_OUT
.set Telit_PWR__PS, CYREG_PRT0_PS
.set Telit_PWR__SHIFT, 4
.set Telit_PWR__SLW, CYREG_PRT0_SLW

/* Telit_RST */
.set Telit_RST__0__INTTYPE, CYREG_PICU15_INTTYPE0
.set Telit_RST__0__MASK, 0x01
.set Telit_RST__0__PC, CYREG_IO_PC_PRT15_PC0
.set Telit_RST__0__PORT, 15
.set Telit_RST__0__SHIFT, 0
.set Telit_RST__AG, CYREG_PRT15_AG
.set Telit_RST__AMUX, CYREG_PRT15_AMUX
.set Telit_RST__BIE, CYREG_PRT15_BIE
.set Telit_RST__BIT_MASK, CYREG_PRT15_BIT_MASK
.set Telit_RST__BYP, CYREG_PRT15_BYP
.set Telit_RST__CTL, CYREG_PRT15_CTL
.set Telit_RST__DM0, CYREG_PRT15_DM0
.set Telit_RST__DM1, CYREG_PRT15_DM1
.set Telit_RST__DM2, CYREG_PRT15_DM2
.set Telit_RST__DR, CYREG_PRT15_DR
.set Telit_RST__INP_DIS, CYREG_PRT15_INP_DIS
.set Telit_RST__INTTYPE_BASE, CYDEV_PICU_INTTYPE_PICU15_BASE
.set Telit_RST__LCD_COM_SEG, CYREG_PRT15_LCD_COM_SEG
.set Telit_RST__LCD_EN, CYREG_PRT15_LCD_EN
.set Telit_RST__MASK, 0x01
.set Telit_RST__PORT, 15
.set Telit_RST__PRT, CYREG_PRT15_PRT
.set Telit_RST__PRTDSI__CAPS_SEL, CYREG_PRT15_CAPS_SEL
.set Telit_RST__PRTDSI__DBL_SYNC_IN, CYREG_PRT15_DBL_SYNC_IN
.set Telit_RST__PRTDSI__OE_SEL0, CYREG_PRT15_OE_SEL0
.set Telit_RST__PRTDSI__OE_SEL1, CYREG_PRT15_OE_SEL1
.set Telit_RST__PRTDSI__OUT_SEL0, CYREG_PRT15_OUT_SEL0
.set Telit_RST__PRTDSI__OUT_SEL1, CYREG_PRT15_OUT_SEL1
.set Telit_RST__PRTDSI__SYNC_OUT, CYREG_PRT15_SYNC_OUT
.set Telit_RST__PS, CYREG_PRT15_PS
.set Telit_RST__SHIFT, 0
.set Telit_RST__SLW, CYREG_PRT15_SLW

/* sleep_isr */
.set sleep_isr__INTC_CLR_EN_REG, CYREG_NVIC_CLRENA0
.set sleep_isr__INTC_CLR_PD_REG, CYREG_NVIC_CLRPEND0
.set sleep_isr__INTC_MASK, 0x02
.set sleep_isr__INTC_NUMBER, 1
.set sleep_isr__INTC_PRIOR_NUM, 7
.set sleep_isr__INTC_PRIOR_REG, CYREG_NVIC_PRI_1
.set sleep_isr__INTC_SET_EN_REG, CYREG_NVIC_SETENA0
.set sleep_isr__INTC_SET_PD_REG, CYREG_NVIC_SETPEND0

/* Telit_UART_BUART */
.set Telit_UART_BUART_sRX_RxBitCounter__16BIT_CONTROL_AUX_CTL_REG, CYREG_B1_UDB07_08_ACTL
.set Telit_UART_BUART_sRX_RxBitCounter__16BIT_CONTROL_CONTROL_REG, CYREG_B1_UDB07_08_CTL
.set Telit_UART_BUART_sRX_RxBitCounter__16BIT_CONTROL_COUNT_REG, CYREG_B1_UDB07_08_CTL
.set Telit_UART_BUART_sRX_RxBitCounter__16BIT_COUNT_CONTROL_REG, CYREG_B1_UDB07_08_CTL
.set Telit_UART_BUART_sRX_RxBitCounter__16BIT_COUNT_COUNT_REG, CYREG_B1_UDB07_08_CTL
.set Telit_UART_BUART_sRX_RxBitCounter__16BIT_MASK_MASK_REG, CYREG_B1_UDB07_08_MSK
.set Telit_UART_BUART_sRX_RxBitCounter__16BIT_MASK_PERIOD_REG, CYREG_B1_UDB07_08_MSK
.set Telit_UART_BUART_sRX_RxBitCounter__16BIT_PERIOD_MASK_REG, CYREG_B1_UDB07_08_MSK
.set Telit_UART_BUART_sRX_RxBitCounter__16BIT_PERIOD_PERIOD_REG, CYREG_B1_UDB07_08_MSK
.set Telit_UART_BUART_sRX_RxBitCounter__CONTROL_AUX_CTL_REG, CYREG_B1_UDB07_ACTL
.set Telit_UART_BUART_sRX_RxBitCounter__CONTROL_REG, CYREG_B1_UDB07_CTL
.set Telit_UART_BUART_sRX_RxBitCounter__CONTROL_ST_REG, CYREG_B1_UDB07_ST_CTL
.set Telit_UART_BUART_sRX_RxBitCounter__COUNT_REG, CYREG_B1_UDB07_CTL
.set Telit_UART_BUART_sRX_RxBitCounter__COUNT_ST_REG, CYREG_B1_UDB07_ST_CTL
.set Telit_UART_BUART_sRX_RxBitCounter__MASK_CTL_AUX_CTL_REG, CYREG_B1_UDB07_MSK_ACTL
.set Telit_UART_BUART_sRX_RxBitCounter__PER_CTL_AUX_CTL_REG, CYREG_B1_UDB07_MSK_ACTL
.set Telit_UART_BUART_sRX_RxBitCounter__PERIOD_REG, CYREG_B1_UDB07_MSK
.set Telit_UART_BUART_sRX_RxBitCounter_ST__16BIT_STATUS_AUX_CTL_REG, CYREG_B1_UDB07_08_ACTL
.set Telit_UART_BUART_sRX_RxBitCounter_ST__16BIT_STATUS_REG, CYREG_B1_UDB07_08_ST
.set Telit_UART_BUART_sRX_RxBitCounter_ST__MASK_REG, CYREG_B1_UDB07_MSK
.set Telit_UART_BUART_sRX_RxBitCounter_ST__MASK_ST_AUX_CTL_REG, CYREG_B1_UDB07_MSK_ACTL
.set Telit_UART_BUART_sRX_RxBitCounter_ST__PER_ST_AUX_CTL_REG, CYREG_B1_UDB07_MSK_ACTL
.set Telit_UART_BUART_sRX_RxBitCounter_ST__STATUS_AUX_CTL_REG, CYREG_B1_UDB07_ACTL
.set Telit_UART_BUART_sRX_RxBitCounter_ST__STATUS_CNT_REG, CYREG_B1_UDB07_ST_CTL
.set Telit_UART_BUART_sRX_RxBitCounter_ST__STATUS_CONTROL_REG, CYREG_B1_UDB07_ST_CTL
.set Telit_UART_BUART_sRX_RxBitCounter_ST__STATUS_REG, CYREG_B1_UDB07_ST
.set Telit_UART_BUART_sRX_RxShifter_u0__16BIT_A0_REG, CYREG_B1_UDB07_08_A0
.set Telit_UART_BUART_sRX_RxShifter_u0__16BIT_A1_REG, CYREG_B1_UDB07_08_A1
.set Telit_UART_BUART_sRX_RxShifter_u0__16BIT_D0_REG, CYREG_B1_UDB07_08_D0
.set Telit_UART_BUART_sRX_RxShifter_u0__16BIT_D1_REG, CYREG_B1_UDB07_08_D1
.set Telit_UART_BUART_sRX_RxShifter_u0__16BIT_DP_AUX_CTL_REG, CYREG_B1_UDB07_08_ACTL
.set Telit_UART_BUART_sRX_RxShifter_u0__16BIT_F0_REG, CYREG_B1_UDB07_08_F0
.set Telit_UART_BUART_sRX_RxShifter_u0__16BIT_F1_REG, CYREG_B1_UDB07_08_F1
.set Telit_UART_BUART_sRX_RxShifter_u0__A0_A1_REG, CYREG_B1_UDB07_A0_A1
.set Telit_UART_BUART_sRX_RxShifter_u0__A0_REG, CYREG_B1_UDB07_A0
.set Telit_UART_BUART_sRX_RxShifter_u0__A1_REG, CYREG_B1_UDB07_A1
.set Telit_UART_BUART_sRX_RxShifter_u0__D0_D1_REG, CYREG_B1_UDB07_D0_D1
.set Telit_UART_BUART_sRX_RxShifter_u0__D0_REG, CYREG_B1_UDB07_D0
.set Telit_UART_BUART_sRX_RxShifter_u0__D1_REG, CYREG_B1_UDB07_D1
.set Telit_UART_BUART_sRX_RxShifter_u0__DP_AUX_CTL_REG, CYREG_B1_UDB07_ACTL
.set Telit_UART_BUART_sRX_RxShifter_u0__F0_F1_REG, CYREG_B1_UDB07_F0_F1
.set Telit_UART_BUART_sRX_RxShifter_u0__F0_REG, CYREG_B1_UDB07_F0
.set Telit_UART_BUART_sRX_RxShifter_u0__F1_REG, CYREG_B1_UDB07_F1
.set Telit_UART_BUART_sRX_RxShifter_u0__MSK_DP_AUX_CTL_REG, CYREG_B1_UDB07_MSK_ACTL
.set Telit_UART_BUART_sRX_RxShifter_u0__PER_DP_AUX_CTL_REG, CYREG_B1_UDB07_MSK_ACTL
.set Telit_UART_BUART_sRX_RxSts__16BIT_STATUS_AUX_CTL_REG, CYREG_B1_UDB04_05_ACTL
.set Telit_UART_BUART_sRX_RxSts__16BIT_STATUS_REG, CYREG_B1_UDB04_05_ST
.set Telit_UART_BUART_sRX_RxSts__3__MASK, 0x08
.set Telit_UART_BUART_sRX_RxSts__3__POS, 3
.set Telit_UART_BUART_sRX_RxSts__4__MASK, 0x10
.set Telit_UART_BUART_sRX_RxSts__4__POS, 4
.set Telit_UART_BUART_sRX_RxSts__5__MASK, 0x20
.set Telit_UART_BUART_sRX_RxSts__5__POS, 5
.set Telit_UART_BUART_sRX_RxSts__MASK, 0x38
.set Telit_UART_BUART_sRX_RxSts__MASK_REG, CYREG_B1_UDB04_MSK
.set Telit_UART_BUART_sRX_RxSts__STATUS_AUX_CTL_REG, CYREG_B1_UDB04_ACTL
.set Telit_UART_BUART_sRX_RxSts__STATUS_REG, CYREG_B1_UDB04_ST
.set Telit_UART_BUART_sTX_sCLOCK_TxBitClkGen__16BIT_A0_REG, CYREG_B0_UDB06_07_A0
.set Telit_UART_BUART_sTX_sCLOCK_TxBitClkGen__16BIT_A1_REG, CYREG_B0_UDB06_07_A1
.set Telit_UART_BUART_sTX_sCLOCK_TxBitClkGen__16BIT_D0_REG, CYREG_B0_UDB06_07_D0
.set Telit_UART_BUART_sTX_sCLOCK_TxBitClkGen__16BIT_D1_REG, CYREG_B0_UDB06_07_D1
.set Telit_UART_BUART_sTX_sCLOCK_TxBitClkGen__16BIT_DP_AUX_CTL_REG, CYREG_B0_UDB06_07_ACTL
.set Telit_UART_BUART_sTX_sCLOCK_TxBitClkGen__16BIT_F0_REG, CYREG_B0_UDB06_07_F0
.set Telit_UART_BUART_sTX_sCLOCK_TxBitClkGen__16BIT_F1_REG, CYREG_B0_UDB06_07_F1
.set Telit_UART_BUART_sTX_sCLOCK_TxBitClkGen__A0_A1_REG, CYREG_B0_UDB06_A0_A1
.set Telit_UART_BUART_sTX_sCLOCK_TxBitClkGen__A0_REG, CYREG_B0_UDB06_A0
.set Telit_UART_BUART_sTX_sCLOCK_TxBitClkGen__A1_REG, CYREG_B0_UDB06_A1
.set Telit_UART_BUART_sTX_sCLOCK_TxBitClkGen__D0_D1_REG, CYREG_B0_UDB06_D0_D1
.set Telit_UART_BUART_sTX_sCLOCK_TxBitClkGen__D0_REG, CYREG_B0_UDB06_D0
.set Telit_UART_BUART_sTX_sCLOCK_TxBitClkGen__D1_REG, CYREG_B0_UDB06_D1
.set Telit_UART_BUART_sTX_sCLOCK_TxBitClkGen__DP_AUX_CTL_REG, CYREG_B0_UDB06_ACTL
.set Telit_UART_BUART_sTX_sCLOCK_TxBitClkGen__F0_F1_REG, CYREG_B0_UDB06_F0_F1
.set Telit_UART_BUART_sTX_sCLOCK_TxBitClkGen__F0_REG, CYREG_B0_UDB06_F0
.set Telit_UART_BUART_sTX_sCLOCK_TxBitClkGen__F1_REG, CYREG_B0_UDB06_F1
.set Telit_UART_BUART_sTX_TxShifter_u0__16BIT_A0_REG, CYREG_B0_UDB07_08_A0
.set Telit_UART_BUART_sTX_TxShifter_u0__16BIT_A1_REG, CYREG_B0_UDB07_08_A1
.set Telit_UART_BUART_sTX_TxShifter_u0__16BIT_D0_REG, CYREG_B0_UDB07_08_D0
.set Telit_UART_BUART_sTX_TxShifter_u0__16BIT_D1_REG, CYREG_B0_UDB07_08_D1
.set Telit_UART_BUART_sTX_TxShifter_u0__16BIT_DP_AUX_CTL_REG, CYREG_B0_UDB07_08_ACTL
.set Telit_UART_BUART_sTX_TxShifter_u0__16BIT_F0_REG, CYREG_B0_UDB07_08_F0
.set Telit_UART_BUART_sTX_TxShifter_u0__16BIT_F1_REG, CYREG_B0_UDB07_08_F1
.set Telit_UART_BUART_sTX_TxShifter_u0__A0_A1_REG, CYREG_B0_UDB07_A0_A1
.set Telit_UART_BUART_sTX_TxShifter_u0__A0_REG, CYREG_B0_UDB07_A0
.set Telit_UART_BUART_sTX_TxShifter_u0__A1_REG, CYREG_B0_UDB07_A1
.set Telit_UART_BUART_sTX_TxShifter_u0__D0_D1_REG, CYREG_B0_UDB07_D0_D1
.set Telit_UART_BUART_sTX_TxShifter_u0__D0_REG, CYREG_B0_UDB07_D0
.set Telit_UART_BUART_sTX_TxShifter_u0__D1_REG, CYREG_B0_UDB07_D1
.set Telit_UART_BUART_sTX_TxShifter_u0__DP_AUX_CTL_REG, CYREG_B0_UDB07_ACTL
.set Telit_UART_BUART_sTX_TxShifter_u0__F0_F1_REG, CYREG_B0_UDB07_F0_F1
.set Telit_UART_BUART_sTX_TxShifter_u0__F0_REG, CYREG_B0_UDB07_F0
.set Telit_UART_BUART_sTX_TxShifter_u0__F1_REG, CYREG_B0_UDB07_F1
.set Telit_UART_BUART_sTX_TxSts__0__MASK, 0x01
.set Telit_UART_BUART_sTX_TxSts__0__POS, 0
.set Telit_UART_BUART_sTX_TxSts__1__MASK, 0x02
.set Telit_UART_BUART_sTX_TxSts__1__POS, 1
.set Telit_UART_BUART_sTX_TxSts__16BIT_STATUS_AUX_CTL_REG, CYREG_B0_UDB07_08_ACTL
.set Telit_UART_BUART_sTX_TxSts__16BIT_STATUS_REG, CYREG_B0_UDB07_08_ST
.set Telit_UART_BUART_sTX_TxSts__2__MASK, 0x04
.set Telit_UART_BUART_sTX_TxSts__2__POS, 2
.set Telit_UART_BUART_sTX_TxSts__3__MASK, 0x08
.set Telit_UART_BUART_sTX_TxSts__3__POS, 3
.set Telit_UART_BUART_sTX_TxSts__MASK, 0x0F
.set Telit_UART_BUART_sTX_TxSts__MASK_REG, CYREG_B0_UDB07_MSK
.set Telit_UART_BUART_sTX_TxSts__STATUS_AUX_CTL_REG, CYREG_B0_UDB07_ACTL
.set Telit_UART_BUART_sTX_TxSts__STATUS_REG, CYREG_B0_UDB07_ST

/* Telit_UART_IntClock */
.set Telit_UART_IntClock__CFG0, CYREG_CLKDIST_DCFG0_CFG0
.set Telit_UART_IntClock__CFG1, CYREG_CLKDIST_DCFG0_CFG1
.set Telit_UART_IntClock__CFG2, CYREG_CLKDIST_DCFG0_CFG2
.set Telit_UART_IntClock__CFG2_SRC_SEL_MASK, 0x07
.set Telit_UART_IntClock__INDEX, 0x00
.set Telit_UART_IntClock__PM_ACT_CFG, CYREG_PM_ACT_CFG2
.set Telit_UART_IntClock__PM_ACT_MSK, 0x01
.set Telit_UART_IntClock__PM_STBY_CFG, CYREG_PM_STBY_CFG2
.set Telit_UART_IntClock__PM_STBY_MSK, 0x01

/* Telit_isr_rx */
.set Telit_isr_rx__INTC_CLR_EN_REG, CYREG_NVIC_CLRENA0
.set Telit_isr_rx__INTC_CLR_PD_REG, CYREG_NVIC_CLRPEND0
.set Telit_isr_rx__INTC_MASK, 0x01
.set Telit_isr_rx__INTC_NUMBER, 0
.set Telit_isr_rx__INTC_PRIOR_NUM, 7
.set Telit_isr_rx__INTC_PRIOR_REG, CYREG_NVIC_PRI_0
.set Telit_isr_rx__INTC_SET_EN_REG, CYREG_NVIC_SETENA0
.set Telit_isr_rx__INTC_SET_PD_REG, CYREG_NVIC_SETPEND0

/* Miscellaneous */
.set BCLK__BUS_CLK__HZ, 24000000
.set BCLK__BUS_CLK__KHZ, 24000
.set BCLK__BUS_CLK__MHZ, 24
.set CYDEV_CHIP_DIE_LEOPARD, 1
.set CYDEV_CHIP_DIE_PANTHER, 18
.set CYDEV_CHIP_DIE_PSOC4A, 10
.set CYDEV_CHIP_DIE_PSOC5LP, 17
.set CYDEV_CHIP_DIE_TMA4, 2
.set CYDEV_CHIP_DIE_UNKNOWN, 0
.set CYDEV_CHIP_FAMILY_PSOC3, 1
.set CYDEV_CHIP_FAMILY_PSOC4, 2
.set CYDEV_CHIP_FAMILY_PSOC5, 3
.set CYDEV_CHIP_FAMILY_UNKNOWN, 0
.set CYDEV_CHIP_FAMILY_USED, CYDEV_CHIP_FAMILY_PSOC5
.set CYDEV_CHIP_JTAG_ID, 0x2E161069
.set CYDEV_CHIP_MEMBER_3A, 1
.set CYDEV_CHIP_MEMBER_4A, 10
.set CYDEV_CHIP_MEMBER_4C, 15
.set CYDEV_CHIP_MEMBER_4D, 6
.set CYDEV_CHIP_MEMBER_4E, 4
.set CYDEV_CHIP_MEMBER_4F, 11
.set CYDEV_CHIP_MEMBER_4G, 2
.set CYDEV_CHIP_MEMBER_4H, 9
.set CYDEV_CHIP_MEMBER_4I, 14
.set CYDEV_CHIP_MEMBER_4J, 7
.set CYDEV_CHIP_MEMBER_4K, 8
.set CYDEV_CHIP_MEMBER_4L, 13
.set CYDEV_CHIP_MEMBER_4M, 12
.set CYDEV_CHIP_MEMBER_4N, 5
.set CYDEV_CHIP_MEMBER_4U, 3
.set CYDEV_CHIP_MEMBER_5A, 17
.set CYDEV_CHIP_MEMBER_5B, 16
.set CYDEV_CHIP_MEMBER_UNKNOWN, 0
.set CYDEV_CHIP_MEMBER_USED, CYDEV_CHIP_MEMBER_5B
.set CYDEV_CHIP_DIE_EXPECT, CYDEV_CHIP_MEMBER_USED
.set CYDEV_CHIP_DIE_ACTUAL, CYDEV_CHIP_DIE_EXPECT
.set CYDEV_CHIP_REV_LEOPARD_ES1, 0
.set CYDEV_CHIP_REV_LEOPARD_ES2, 1
.set CYDEV_CHIP_REV_LEOPARD_ES3, 3
.set CYDEV_CHIP_REV_LEOPARD_PRODUCTION, 3
.set CYDEV_CHIP_REV_PANTHER_ES0, 0
.set CYDEV_CHIP_REV_PANTHER_ES1, 1
.set CYDEV_CHIP_REV_PANTHER_PRODUCTION, 1
.set CYDEV_CHIP_REV_PSOC4A_ES0, 17
.set CYDEV_CHIP_REV_PSOC4A_PRODUCTION, 17
.set CYDEV_CHIP_REV_PSOC5LP_ES0, 0
.set CYDEV_CHIP_REV_PSOC5LP_PRODUCTION, 0
.set CYDEV_CHIP_REV_TMA4_ES, 17
.set CYDEV_CHIP_REV_TMA4_ES2, 33
.set CYDEV_CHIP_REV_TMA4_PRODUCTION, 17
.set CYDEV_CHIP_REVISION_3A_ES1, 0
.set CYDEV_CHIP_REVISION_3A_ES2, 1
.set CYDEV_CHIP_REVISION_3A_ES3, 3
.set CYDEV_CHIP_REVISION_3A_PRODUCTION, 3
.set CYDEV_CHIP_REVISION_4A_ES0, 17
.set CYDEV_CHIP_REVISION_4A_PRODUCTION, 17
.set CYDEV_CHIP_REVISION_4C_PRODUCTION, 0
.set CYDEV_CHIP_REVISION_4D_PRODUCTION, 0
.set CYDEV_CHIP_REVISION_4E_PRODUCTION, 0
.set CYDEV_CHIP_REVISION_4F_PRODUCTION, 0
.set CYDEV_CHIP_REVISION_4F_PRODUCTION_256DMA, 0
.set CYDEV_CHIP_REVISION_4F_PRODUCTION_256K, 0
.set CYDEV_CHIP_REVISION_4G_ES, 17
.set CYDEV_CHIP_REVISION_4G_ES2, 33
.set CYDEV_CHIP_REVISION_4G_PRODUCTION, 17
.set CYDEV_CHIP_REVISION_4H_PRODUCTION, 0
.set CYDEV_CHIP_REVISION_4I_PRODUCTION, 0
.set CYDEV_CHIP_REVISION_4J_PRODUCTION, 0
.set CYDEV_CHIP_REVISION_4K_PRODUCTION, 0
.set CYDEV_CHIP_REVISION_4L_PRODUCTION, 0
.set CYDEV_CHIP_REVISION_4M_PRODUCTION, 0
.set CYDEV_CHIP_REVISION_4N_PRODUCTION, 0
.set CYDEV_CHIP_REVISION_4U_PRODUCTION, 0
.set CYDEV_CHIP_REVISION_5A_ES0, 0
.set CYDEV_CHIP_REVISION_5A_ES1, 1
.set CYDEV_CHIP_REVISION_5A_PRODUCTION, 1
.set CYDEV_CHIP_REVISION_5B_ES0, 0
.set CYDEV_CHIP_REVISION_5B_PRODUCTION, 0
.set CYDEV_CHIP_REVISION_USED, CYDEV_CHIP_REVISION_5B_PRODUCTION
.set CYDEV_CHIP_REV_EXPECT, CYDEV_CHIP_REVISION_USED
.set CYDEV_CONFIG_FASTBOOT_ENABLED, 1
.set CYDEV_CONFIG_UNUSED_IO_AllowButWarn, 0
.set CYDEV_CONFIG_UNUSED_IO, CYDEV_CONFIG_UNUSED_IO_AllowButWarn
.set CYDEV_CONFIG_UNUSED_IO_AllowWithInfo, 1
.set CYDEV_CONFIG_UNUSED_IO_Disallowed, 2
.set CYDEV_CONFIGURATION_COMPRESSED, 1
.set CYDEV_CONFIGURATION_DMA, 0
.set CYDEV_CONFIGURATION_ECC, 1
.set CYDEV_CONFIGURATION_IMOENABLED, CYDEV_CONFIG_FASTBOOT_ENABLED
.set CYDEV_CONFIGURATION_MODE_COMPRESSED, 0
.set CYDEV_CONFIGURATION_MODE, CYDEV_CONFIGURATION_MODE_COMPRESSED
.set CYDEV_CONFIGURATION_MODE_DMA, 2
.set CYDEV_CONFIGURATION_MODE_UNCOMPRESSED, 1
.set CYDEV_DEBUG_ENABLE_MASK, 0x20
.set CYDEV_DEBUG_ENABLE_REGISTER, CYREG_MLOGIC_DEBUG
.set CYDEV_DEBUGGING_DPS_Disable, 3
.set CYDEV_DEBUGGING_DPS_JTAG_4, 1
.set CYDEV_DEBUGGING_DPS_JTAG_5, 0
.set CYDEV_DEBUGGING_DPS_SWD, 2
.set CYDEV_DEBUGGING_DPS_SWD_SWV, 6
.set CYDEV_DEBUGGING_DPS, CYDEV_DEBUGGING_DPS_SWD_SWV
.set CYDEV_DEBUGGING_ENABLE, 1
.set CYDEV_DEBUGGING_XRES, 0
.set CYDEV_DMA_CHANNELS_AVAILABLE, 24
.set CYDEV_ECC_ENABLE, 0
.set CYDEV_HEAP_SIZE, 0x1000
.set CYDEV_INSTRUCT_CACHE_ENABLED, 1
.set CYDEV_INTR_RISING, 0x00000001
.set CYDEV_IS_EXPORTING_CODE, 0
.set CYDEV_IS_IMPORTING_CODE, 0
.set CYDEV_PROJ_TYPE, 0
.set CYDEV_PROJ_TYPE_BOOTLOADER, 1
.set CYDEV_PROJ_TYPE_LAUNCHER, 5
.set CYDEV_PROJ_TYPE_LOADABLE, 2
.set CYDEV_PROJ_TYPE_LOADABLEANDBOOTLOADER, 4
.set CYDEV_PROJ_TYPE_MULTIAPPBOOTLOADER, 3
.set CYDEV_PROJ_TYPE_STANDARD, 0
.set CYDEV_PROTECTION_ENABLE, 0
.set CYDEV_STACK_SIZE, 0x4000
.set CYDEV_USE_BUNDLED_CMSIS, 1
.set CYDEV_VARIABLE_VDDA, 0
.set CYDEV_VDDA_MV, 5000
.set CYDEV_VDDD_MV, 5000
.set CYDEV_VDDIO0_MV, 5000
.set CYDEV_VDDIO1_MV, 5000
.set CYDEV_VDDIO2_MV, 5000
.set CYDEV_VDDIO3_MV, 5000
.set CYDEV_VIO0_MV, 5000
.set CYDEV_VIO1_MV, 5000
.set CYDEV_VIO2_MV, 5000
.set CYDEV_VIO3_MV, 5000
.set CYIPBLOCK_ARM_CM3_VERSION, 0
.set CYIPBLOCK_P3_ANAIF_VERSION, 0
.set CYIPBLOCK_P3_CAN_VERSION, 0
.set CYIPBLOCK_P3_CAPSENSE_VERSION, 0
.set CYIPBLOCK_P3_COMP_VERSION, 0
.set CYIPBLOCK_P3_DECIMATOR_VERSION, 0
.set CYIPBLOCK_P3_DFB_VERSION, 0
.set CYIPBLOCK_P3_DMA_VERSION, 0
.set CYIPBLOCK_P3_DRQ_VERSION, 0
.set CYIPBLOCK_P3_DSM_VERSION, 0
.set CYIPBLOCK_P3_EMIF_VERSION, 0
.set CYIPBLOCK_P3_I2C_VERSION, 0
.set CYIPBLOCK_P3_LCD_VERSION, 0
.set CYIPBLOCK_P3_LPF_VERSION, 0
.set CYIPBLOCK_P3_OPAMP_VERSION, 0
.set CYIPBLOCK_P3_PM_VERSION, 0
.set CYIPBLOCK_P3_SCCT_VERSION, 0
.set CYIPBLOCK_P3_TIMER_VERSION, 0
.set CYIPBLOCK_P3_USB_VERSION, 0
.set CYIPBLOCK_P3_VIDAC_VERSION, 0
.set CYIPBLOCK_P3_VREF_VERSION, 0
.set CYIPBLOCK_S8_GPIO_VERSION, 0
.set CYIPBLOCK_S8_IRQ_VERSION, 0
.set CYIPBLOCK_S8_SAR_VERSION, 0
.set CYIPBLOCK_S8_SIO_VERSION, 0
.set CYIPBLOCK_S8_UDB_VERSION, 0
.set DMA_CHANNELS_USED__MASK0, 0x00000000
.set CYDEV_BOOTLOADER_ENABLE, 0
.endif
