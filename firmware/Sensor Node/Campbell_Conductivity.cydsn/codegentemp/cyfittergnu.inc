.ifndef INCLUDED_CYFITTERGNU_INC
.set INCLUDED_CYFITTERGNU_INC, 1
.include "cydevicegnu.inc"
.include "cydevicegnu_trm.inc"

/* ADC_DelSig_1_Ext_CP_Clk */
.set ADC_DelSig_1_Ext_CP_Clk__CFG0, CYREG_CLKDIST_DCFG0_CFG0
.set ADC_DelSig_1_Ext_CP_Clk__CFG1, CYREG_CLKDIST_DCFG0_CFG1
.set ADC_DelSig_1_Ext_CP_Clk__CFG2, CYREG_CLKDIST_DCFG0_CFG2
.set ADC_DelSig_1_Ext_CP_Clk__CFG2_SRC_SEL_MASK, 0x07
.set ADC_DelSig_1_Ext_CP_Clk__INDEX, 0x00
.set ADC_DelSig_1_Ext_CP_Clk__PM_ACT_CFG, CYREG_PM_ACT_CFG2
.set ADC_DelSig_1_Ext_CP_Clk__PM_ACT_MSK, 0x01
.set ADC_DelSig_1_Ext_CP_Clk__PM_STBY_CFG, CYREG_PM_STBY_CFG2
.set ADC_DelSig_1_Ext_CP_Clk__PM_STBY_MSK, 0x01

/* ADC_DelSig_1_theACLK */
.set ADC_DelSig_1_theACLK__CFG0, CYREG_CLKDIST_ACFG0_CFG0
.set ADC_DelSig_1_theACLK__CFG1, CYREG_CLKDIST_ACFG0_CFG1
.set ADC_DelSig_1_theACLK__CFG2, CYREG_CLKDIST_ACFG0_CFG2
.set ADC_DelSig_1_theACLK__CFG2_SRC_SEL_MASK, 0x07
.set ADC_DelSig_1_theACLK__CFG3, CYREG_CLKDIST_ACFG0_CFG3
.set ADC_DelSig_1_theACLK__CFG3_PHASE_DLY_MASK, 0x0F
.set ADC_DelSig_1_theACLK__INDEX, 0x00
.set ADC_DelSig_1_theACLK__PM_ACT_CFG, CYREG_PM_ACT_CFG1
.set ADC_DelSig_1_theACLK__PM_ACT_MSK, 0x01
.set ADC_DelSig_1_theACLK__PM_STBY_CFG, CYREG_PM_STBY_CFG1
.set ADC_DelSig_1_theACLK__PM_STBY_MSK, 0x01

/* ADC_DelSig_1_DSM4 */
.set ADC_DelSig_1_DSM4__BUF0, CYREG_DSM0_BUF0
.set ADC_DelSig_1_DSM4__BUF1, CYREG_DSM0_BUF1
.set ADC_DelSig_1_DSM4__BUF2, CYREG_DSM0_BUF2
.set ADC_DelSig_1_DSM4__BUF3, CYREG_DSM0_BUF3
.set ADC_DelSig_1_DSM4__CLK, CYREG_DSM0_CLK
.set ADC_DelSig_1_DSM4__CR0, CYREG_DSM0_CR0
.set ADC_DelSig_1_DSM4__CR1, CYREG_DSM0_CR1
.set ADC_DelSig_1_DSM4__CR10, CYREG_DSM0_CR10
.set ADC_DelSig_1_DSM4__CR11, CYREG_DSM0_CR11
.set ADC_DelSig_1_DSM4__CR12, CYREG_DSM0_CR12
.set ADC_DelSig_1_DSM4__CR13, CYREG_DSM0_CR13
.set ADC_DelSig_1_DSM4__CR14, CYREG_DSM0_CR14
.set ADC_DelSig_1_DSM4__CR15, CYREG_DSM0_CR15
.set ADC_DelSig_1_DSM4__CR16, CYREG_DSM0_CR16
.set ADC_DelSig_1_DSM4__CR17, CYREG_DSM0_CR17
.set ADC_DelSig_1_DSM4__CR2, CYREG_DSM0_CR2
.set ADC_DelSig_1_DSM4__CR3, CYREG_DSM0_CR3
.set ADC_DelSig_1_DSM4__CR4, CYREG_DSM0_CR4
.set ADC_DelSig_1_DSM4__CR5, CYREG_DSM0_CR5
.set ADC_DelSig_1_DSM4__CR6, CYREG_DSM0_CR6
.set ADC_DelSig_1_DSM4__CR7, CYREG_DSM0_CR7
.set ADC_DelSig_1_DSM4__CR8, CYREG_DSM0_CR8
.set ADC_DelSig_1_DSM4__CR9, CYREG_DSM0_CR9
.set ADC_DelSig_1_DSM4__DEM0, CYREG_DSM0_DEM0
.set ADC_DelSig_1_DSM4__DEM1, CYREG_DSM0_DEM1
.set ADC_DelSig_1_DSM4__MISC, CYREG_DSM0_MISC
.set ADC_DelSig_1_DSM4__OUT0, CYREG_DSM0_OUT0
.set ADC_DelSig_1_DSM4__OUT1, CYREG_DSM0_OUT1
.set ADC_DelSig_1_DSM4__REF0, CYREG_DSM0_REF0
.set ADC_DelSig_1_DSM4__REF1, CYREG_DSM0_REF1
.set ADC_DelSig_1_DSM4__REF2, CYREG_DSM0_REF2
.set ADC_DelSig_1_DSM4__REF3, CYREG_DSM0_REF3
.set ADC_DelSig_1_DSM4__RSVD1, CYREG_DSM0_RSVD1
.set ADC_DelSig_1_DSM4__SW0, CYREG_DSM0_SW0
.set ADC_DelSig_1_DSM4__SW2, CYREG_DSM0_SW2
.set ADC_DelSig_1_DSM4__SW3, CYREG_DSM0_SW3
.set ADC_DelSig_1_DSM4__SW4, CYREG_DSM0_SW4
.set ADC_DelSig_1_DSM4__SW6, CYREG_DSM0_SW6
.set ADC_DelSig_1_DSM4__TR0, CYREG_NPUMP_DSM_TR0
.set ADC_DelSig_1_DSM4__TST0, CYREG_DSM0_TST0
.set ADC_DelSig_1_DSM4__TST1, CYREG_DSM0_TST1

/* ADC_DelSig_1_DEC */
.set ADC_DelSig_1_DEC__COHER, CYREG_DEC_COHER
.set ADC_DelSig_1_DEC__CR, CYREG_DEC_CR
.set ADC_DelSig_1_DEC__DR1, CYREG_DEC_DR1
.set ADC_DelSig_1_DEC__DR2, CYREG_DEC_DR2
.set ADC_DelSig_1_DEC__DR2H, CYREG_DEC_DR2H
.set ADC_DelSig_1_DEC__GCOR, CYREG_DEC_GCOR
.set ADC_DelSig_1_DEC__GCORH, CYREG_DEC_GCORH
.set ADC_DelSig_1_DEC__GVAL, CYREG_DEC_GVAL
.set ADC_DelSig_1_DEC__OCOR, CYREG_DEC_OCOR
.set ADC_DelSig_1_DEC__OCORH, CYREG_DEC_OCORH
.set ADC_DelSig_1_DEC__OCORM, CYREG_DEC_OCORM
.set ADC_DelSig_1_DEC__OUTSAMP, CYREG_DEC_OUTSAMP
.set ADC_DelSig_1_DEC__OUTSAMPH, CYREG_DEC_OUTSAMPH
.set ADC_DelSig_1_DEC__OUTSAMPM, CYREG_DEC_OUTSAMPM
.set ADC_DelSig_1_DEC__OUTSAMPS, CYREG_DEC_OUTSAMPS
.set ADC_DelSig_1_DEC__PM_ACT_CFG, CYREG_PM_ACT_CFG10
.set ADC_DelSig_1_DEC__PM_ACT_MSK, 0x01
.set ADC_DelSig_1_DEC__PM_STBY_CFG, CYREG_PM_STBY_CFG10
.set ADC_DelSig_1_DEC__PM_STBY_MSK, 0x01
.set ADC_DelSig_1_DEC__SHIFT1, CYREG_DEC_SHIFT1
.set ADC_DelSig_1_DEC__SHIFT2, CYREG_DEC_SHIFT2
.set ADC_DelSig_1_DEC__SR, CYREG_DEC_SR
.set ADC_DelSig_1_DEC__TRIM__M1, CYREG_FLSHID_CUST_TABLES_DEC_M1
.set ADC_DelSig_1_DEC__TRIM__M2, CYREG_FLSHID_CUST_TABLES_DEC_M2
.set ADC_DelSig_1_DEC__TRIM__M3, CYREG_FLSHID_CUST_TABLES_DEC_M3
.set ADC_DelSig_1_DEC__TRIM__M4, CYREG_FLSHID_CUST_TABLES_DEC_M4
.set ADC_DelSig_1_DEC__TRIM__M5, CYREG_FLSHID_CUST_TABLES_DEC_M5
.set ADC_DelSig_1_DEC__TRIM__M6, CYREG_FLSHID_CUST_TABLES_DEC_M6
.set ADC_DelSig_1_DEC__TRIM__M7, CYREG_FLSHID_CUST_TABLES_DEC_M7
.set ADC_DelSig_1_DEC__TRIM__M8, CYREG_FLSHID_CUST_TABLES_DEC_M8

/* ADC_DelSig_1_IRQ */
.set ADC_DelSig_1_IRQ__INTC_CLR_EN_REG, CYREG_NVIC_CLRENA0
.set ADC_DelSig_1_IRQ__INTC_CLR_PD_REG, CYREG_NVIC_CLRPEND0
.set ADC_DelSig_1_IRQ__INTC_MASK, 0x20000000
.set ADC_DelSig_1_IRQ__INTC_NUMBER, 29
.set ADC_DelSig_1_IRQ__INTC_PRIOR_NUM, 7
.set ADC_DelSig_1_IRQ__INTC_PRIOR_REG, CYREG_NVIC_PRI_29
.set ADC_DelSig_1_IRQ__INTC_SET_EN_REG, CYREG_NVIC_SETENA0
.set ADC_DelSig_1_IRQ__INTC_SET_PD_REG, CYREG_NVIC_SETPEND0

/* Sample_Hold_1_SC */
.set Sample_Hold_1_SC__BST, CYREG_SC0_BST
.set Sample_Hold_1_SC__CLK, CYREG_SC0_CLK
.set Sample_Hold_1_SC__CMPINV, CYREG_SC_CMPINV
.set Sample_Hold_1_SC__CPTR, CYREG_SC_CPTR
.set Sample_Hold_1_SC__CR0, CYREG_SC0_CR0
.set Sample_Hold_1_SC__CR1, CYREG_SC0_CR1
.set Sample_Hold_1_SC__CR2, CYREG_SC0_CR2
.set Sample_Hold_1_SC__MSK, CYREG_SC_MSK
.set Sample_Hold_1_SC__PM_ACT_CFG, CYREG_PM_ACT_CFG9
.set Sample_Hold_1_SC__PM_ACT_MSK, 0x01
.set Sample_Hold_1_SC__PM_STBY_CFG, CYREG_PM_STBY_CFG9
.set Sample_Hold_1_SC__PM_STBY_MSK, 0x01
.set Sample_Hold_1_SC__SR, CYREG_SC_SR
.set Sample_Hold_1_SC__SW0, CYREG_SC0_SW0
.set Sample_Hold_1_SC__SW10, CYREG_SC0_SW10
.set Sample_Hold_1_SC__SW2, CYREG_SC0_SW2
.set Sample_Hold_1_SC__SW3, CYREG_SC0_SW3
.set Sample_Hold_1_SC__SW4, CYREG_SC0_SW4
.set Sample_Hold_1_SC__SW6, CYREG_SC0_SW6
.set Sample_Hold_1_SC__SW7, CYREG_SC0_SW7
.set Sample_Hold_1_SC__SW8, CYREG_SC0_SW8
.set Sample_Hold_1_SC__WRK1, CYREG_SC_WRK1

/* Sample_Hold_2_SC */
.set Sample_Hold_2_SC__BST, CYREG_SC2_BST
.set Sample_Hold_2_SC__CLK, CYREG_SC2_CLK
.set Sample_Hold_2_SC__CMPINV, CYREG_SC_CMPINV
.set Sample_Hold_2_SC__CPTR, CYREG_SC_CPTR
.set Sample_Hold_2_SC__CR0, CYREG_SC2_CR0
.set Sample_Hold_2_SC__CR1, CYREG_SC2_CR1
.set Sample_Hold_2_SC__CR2, CYREG_SC2_CR2
.set Sample_Hold_2_SC__MSK, CYREG_SC_MSK
.set Sample_Hold_2_SC__PM_ACT_CFG, CYREG_PM_ACT_CFG9
.set Sample_Hold_2_SC__PM_ACT_MSK, 0x04
.set Sample_Hold_2_SC__PM_STBY_CFG, CYREG_PM_STBY_CFG9
.set Sample_Hold_2_SC__PM_STBY_MSK, 0x04
.set Sample_Hold_2_SC__SR, CYREG_SC_SR
.set Sample_Hold_2_SC__SW0, CYREG_SC2_SW0
.set Sample_Hold_2_SC__SW10, CYREG_SC2_SW10
.set Sample_Hold_2_SC__SW2, CYREG_SC2_SW2
.set Sample_Hold_2_SC__SW3, CYREG_SC2_SW3
.set Sample_Hold_2_SC__SW4, CYREG_SC2_SW4
.set Sample_Hold_2_SC__SW6, CYREG_SC2_SW6
.set Sample_Hold_2_SC__SW7, CYREG_SC2_SW7
.set Sample_Hold_2_SC__SW8, CYREG_SC2_SW8
.set Sample_Hold_2_SC__WRK1, CYREG_SC_WRK1

/* Sample_Hold_3_SC */
.set Sample_Hold_3_SC__BST, CYREG_SC1_BST
.set Sample_Hold_3_SC__CLK, CYREG_SC1_CLK
.set Sample_Hold_3_SC__CMPINV, CYREG_SC_CMPINV
.set Sample_Hold_3_SC__CPTR, CYREG_SC_CPTR
.set Sample_Hold_3_SC__CR0, CYREG_SC1_CR0
.set Sample_Hold_3_SC__CR1, CYREG_SC1_CR1
.set Sample_Hold_3_SC__CR2, CYREG_SC1_CR2
.set Sample_Hold_3_SC__MSK, CYREG_SC_MSK
.set Sample_Hold_3_SC__PM_ACT_CFG, CYREG_PM_ACT_CFG9
.set Sample_Hold_3_SC__PM_ACT_MSK, 0x02
.set Sample_Hold_3_SC__PM_STBY_CFG, CYREG_PM_STBY_CFG9
.set Sample_Hold_3_SC__PM_STBY_MSK, 0x02
.set Sample_Hold_3_SC__SR, CYREG_SC_SR
.set Sample_Hold_3_SC__SW0, CYREG_SC1_SW0
.set Sample_Hold_3_SC__SW10, CYREG_SC1_SW10
.set Sample_Hold_3_SC__SW2, CYREG_SC1_SW2
.set Sample_Hold_3_SC__SW3, CYREG_SC1_SW3
.set Sample_Hold_3_SC__SW4, CYREG_SC1_SW4
.set Sample_Hold_3_SC__SW6, CYREG_SC1_SW6
.set Sample_Hold_3_SC__SW7, CYREG_SC1_SW7
.set Sample_Hold_3_SC__SW8, CYREG_SC1_SW8
.set Sample_Hold_3_SC__WRK1, CYREG_SC_WRK1

/* Comp_1_ctComp */
.set Comp_1_ctComp__CLK, CYREG_CMP2_CLK
.set Comp_1_ctComp__CMP_MASK, 0x04
.set Comp_1_ctComp__CMP_NUMBER, 2
.set Comp_1_ctComp__CR, CYREG_CMP2_CR
.set Comp_1_ctComp__LUT__CR, CYREG_LUT2_CR
.set Comp_1_ctComp__LUT__MSK, CYREG_LUT_MSK
.set Comp_1_ctComp__LUT__MSK_MASK, 0x04
.set Comp_1_ctComp__LUT__MSK_SHIFT, 2
.set Comp_1_ctComp__LUT__MX, CYREG_LUT2_MX
.set Comp_1_ctComp__LUT__SR, CYREG_LUT_SR
.set Comp_1_ctComp__LUT__SR_MASK, 0x04
.set Comp_1_ctComp__LUT__SR_SHIFT, 2
.set Comp_1_ctComp__PM_ACT_CFG, CYREG_PM_ACT_CFG7
.set Comp_1_ctComp__PM_ACT_MSK, 0x04
.set Comp_1_ctComp__PM_STBY_CFG, CYREG_PM_STBY_CFG7
.set Comp_1_ctComp__PM_STBY_MSK, 0x04
.set Comp_1_ctComp__SW0, CYREG_CMP2_SW0
.set Comp_1_ctComp__SW2, CYREG_CMP2_SW2
.set Comp_1_ctComp__SW3, CYREG_CMP2_SW3
.set Comp_1_ctComp__SW4, CYREG_CMP2_SW4
.set Comp_1_ctComp__SW6, CYREG_CMP2_SW6
.set Comp_1_ctComp__TR0, CYREG_CMP2_TR0
.set Comp_1_ctComp__TR1, CYREG_CMP2_TR1
.set Comp_1_ctComp__TRIM__TR0, CYREG_FLSHID_MFG_CFG_CMP2_TR0
.set Comp_1_ctComp__TRIM__TR0_HS, CYREG_FLSHID_CUST_TABLES_CMP2_TR0_HS
.set Comp_1_ctComp__TRIM__TR1, CYREG_FLSHID_MFG_CFG_CMP2_TR1
.set Comp_1_ctComp__TRIM__TR1_HS, CYREG_FLSHID_CUST_TABLES_CMP2_TR1_HS
.set Comp_1_ctComp__WRK, CYREG_CMP_WRK
.set Comp_1_ctComp__WRK_MASK, 0x04
.set Comp_1_ctComp__WRK_SHIFT, 2

/* Comp_2_ctComp */
.set Comp_2_ctComp__CLK, CYREG_CMP3_CLK
.set Comp_2_ctComp__CMP_MASK, 0x08
.set Comp_2_ctComp__CMP_NUMBER, 3
.set Comp_2_ctComp__CR, CYREG_CMP3_CR
.set Comp_2_ctComp__LUT__CR, CYREG_LUT3_CR
.set Comp_2_ctComp__LUT__MSK, CYREG_LUT_MSK
.set Comp_2_ctComp__LUT__MSK_MASK, 0x08
.set Comp_2_ctComp__LUT__MSK_SHIFT, 3
.set Comp_2_ctComp__LUT__MX, CYREG_LUT3_MX
.set Comp_2_ctComp__LUT__SR, CYREG_LUT_SR
.set Comp_2_ctComp__LUT__SR_MASK, 0x08
.set Comp_2_ctComp__LUT__SR_SHIFT, 3
.set Comp_2_ctComp__PM_ACT_CFG, CYREG_PM_ACT_CFG7
.set Comp_2_ctComp__PM_ACT_MSK, 0x08
.set Comp_2_ctComp__PM_STBY_CFG, CYREG_PM_STBY_CFG7
.set Comp_2_ctComp__PM_STBY_MSK, 0x08
.set Comp_2_ctComp__SW0, CYREG_CMP3_SW0
.set Comp_2_ctComp__SW2, CYREG_CMP3_SW2
.set Comp_2_ctComp__SW3, CYREG_CMP3_SW3
.set Comp_2_ctComp__SW4, CYREG_CMP3_SW4
.set Comp_2_ctComp__SW6, CYREG_CMP3_SW6
.set Comp_2_ctComp__TR0, CYREG_CMP3_TR0
.set Comp_2_ctComp__TR1, CYREG_CMP3_TR1
.set Comp_2_ctComp__TRIM__TR0, CYREG_FLSHID_MFG_CFG_CMP3_TR0
.set Comp_2_ctComp__TRIM__TR0_HS, CYREG_FLSHID_CUST_TABLES_CMP3_TR0_HS
.set Comp_2_ctComp__TRIM__TR1, CYREG_FLSHID_MFG_CFG_CMP3_TR1
.set Comp_2_ctComp__TRIM__TR1_HS, CYREG_FLSHID_CUST_TABLES_CMP3_TR1_HS
.set Comp_2_ctComp__WRK, CYREG_CMP_WRK
.set Comp_2_ctComp__WRK_MASK, 0x08
.set Comp_2_ctComp__WRK_SHIFT, 3

/* Comp_3_ctComp */
.set Comp_3_ctComp__CLK, CYREG_CMP1_CLK
.set Comp_3_ctComp__CMP_MASK, 0x02
.set Comp_3_ctComp__CMP_NUMBER, 1
.set Comp_3_ctComp__CR, CYREG_CMP1_CR
.set Comp_3_ctComp__LUT__CR, CYREG_LUT1_CR
.set Comp_3_ctComp__LUT__MSK, CYREG_LUT_MSK
.set Comp_3_ctComp__LUT__MSK_MASK, 0x02
.set Comp_3_ctComp__LUT__MSK_SHIFT, 1
.set Comp_3_ctComp__LUT__MX, CYREG_LUT1_MX
.set Comp_3_ctComp__LUT__SR, CYREG_LUT_SR
.set Comp_3_ctComp__LUT__SR_MASK, 0x02
.set Comp_3_ctComp__LUT__SR_SHIFT, 1
.set Comp_3_ctComp__PM_ACT_CFG, CYREG_PM_ACT_CFG7
.set Comp_3_ctComp__PM_ACT_MSK, 0x02
.set Comp_3_ctComp__PM_STBY_CFG, CYREG_PM_STBY_CFG7
.set Comp_3_ctComp__PM_STBY_MSK, 0x02
.set Comp_3_ctComp__SW0, CYREG_CMP1_SW0
.set Comp_3_ctComp__SW2, CYREG_CMP1_SW2
.set Comp_3_ctComp__SW3, CYREG_CMP1_SW3
.set Comp_3_ctComp__SW4, CYREG_CMP1_SW4
.set Comp_3_ctComp__SW6, CYREG_CMP1_SW6
.set Comp_3_ctComp__TR0, CYREG_CMP1_TR0
.set Comp_3_ctComp__TR1, CYREG_CMP1_TR1
.set Comp_3_ctComp__TRIM__TR0, CYREG_FLSHID_MFG_CFG_CMP1_TR0
.set Comp_3_ctComp__TRIM__TR0_HS, CYREG_FLSHID_CUST_TABLES_CMP1_TR0_HS
.set Comp_3_ctComp__TRIM__TR1, CYREG_FLSHID_MFG_CFG_CMP1_TR1
.set Comp_3_ctComp__TRIM__TR1_HS, CYREG_FLSHID_CUST_TABLES_CMP1_TR1_HS
.set Comp_3_ctComp__WRK, CYREG_CMP_WRK
.set Comp_3_ctComp__WRK_MASK, 0x02
.set Comp_3_ctComp__WRK_SHIFT, 1

/* Cond_PWM_out */
.set Cond_PWM_out__0__MASK, 0x40
.set Cond_PWM_out__0__PC, CYREG_PRT0_PC6
.set Cond_PWM_out__0__PORT, 0
.set Cond_PWM_out__0__SHIFT, 6
.set Cond_PWM_out__AG, CYREG_PRT0_AG
.set Cond_PWM_out__AMUX, CYREG_PRT0_AMUX
.set Cond_PWM_out__BIE, CYREG_PRT0_BIE
.set Cond_PWM_out__BIT_MASK, CYREG_PRT0_BIT_MASK
.set Cond_PWM_out__BYP, CYREG_PRT0_BYP
.set Cond_PWM_out__CTL, CYREG_PRT0_CTL
.set Cond_PWM_out__DM0, CYREG_PRT0_DM0
.set Cond_PWM_out__DM1, CYREG_PRT0_DM1
.set Cond_PWM_out__DM2, CYREG_PRT0_DM2
.set Cond_PWM_out__DR, CYREG_PRT0_DR
.set Cond_PWM_out__INP_DIS, CYREG_PRT0_INP_DIS
.set Cond_PWM_out__LCD_COM_SEG, CYREG_PRT0_LCD_COM_SEG
.set Cond_PWM_out__LCD_EN, CYREG_PRT0_LCD_EN
.set Cond_PWM_out__MASK, 0x40
.set Cond_PWM_out__PORT, 0
.set Cond_PWM_out__PRT, CYREG_PRT0_PRT
.set Cond_PWM_out__PRTDSI__CAPS_SEL, CYREG_PRT0_CAPS_SEL
.set Cond_PWM_out__PRTDSI__DBL_SYNC_IN, CYREG_PRT0_DBL_SYNC_IN
.set Cond_PWM_out__PRTDSI__OE_SEL0, CYREG_PRT0_OE_SEL0
.set Cond_PWM_out__PRTDSI__OE_SEL1, CYREG_PRT0_OE_SEL1
.set Cond_PWM_out__PRTDSI__OUT_SEL0, CYREG_PRT0_OUT_SEL0
.set Cond_PWM_out__PRTDSI__OUT_SEL1, CYREG_PRT0_OUT_SEL1
.set Cond_PWM_out__PRTDSI__SYNC_OUT, CYREG_PRT0_SYNC_OUT
.set Cond_PWM_out__PS, CYREG_PRT0_PS
.set Cond_PWM_out__SHIFT, 6
.set Cond_PWM_out__SLW, CYREG_PRT0_SLW

/* PWM_1_PWMUDB */
.set PWM_1_PWMUDB_sCTRLReg_SyncCtl_ctrlreg__16BIT_CONTROL_AUX_CTL_REG, CYREG_B0_UDB03_04_ACTL
.set PWM_1_PWMUDB_sCTRLReg_SyncCtl_ctrlreg__16BIT_CONTROL_CONTROL_REG, CYREG_B0_UDB03_04_CTL
.set PWM_1_PWMUDB_sCTRLReg_SyncCtl_ctrlreg__16BIT_CONTROL_COUNT_REG, CYREG_B0_UDB03_04_CTL
.set PWM_1_PWMUDB_sCTRLReg_SyncCtl_ctrlreg__16BIT_COUNT_CONTROL_REG, CYREG_B0_UDB03_04_CTL
.set PWM_1_PWMUDB_sCTRLReg_SyncCtl_ctrlreg__16BIT_COUNT_COUNT_REG, CYREG_B0_UDB03_04_CTL
.set PWM_1_PWMUDB_sCTRLReg_SyncCtl_ctrlreg__16BIT_MASK_MASK_REG, CYREG_B0_UDB03_04_MSK
.set PWM_1_PWMUDB_sCTRLReg_SyncCtl_ctrlreg__16BIT_MASK_PERIOD_REG, CYREG_B0_UDB03_04_MSK
.set PWM_1_PWMUDB_sCTRLReg_SyncCtl_ctrlreg__16BIT_PERIOD_MASK_REG, CYREG_B0_UDB03_04_MSK
.set PWM_1_PWMUDB_sCTRLReg_SyncCtl_ctrlreg__16BIT_PERIOD_PERIOD_REG, CYREG_B0_UDB03_04_MSK
.set PWM_1_PWMUDB_sCTRLReg_SyncCtl_ctrlreg__7__MASK, 0x80
.set PWM_1_PWMUDB_sCTRLReg_SyncCtl_ctrlreg__7__POS, 7
.set PWM_1_PWMUDB_sCTRLReg_SyncCtl_ctrlreg__CONTROL_AUX_CTL_REG, CYREG_B0_UDB03_ACTL
.set PWM_1_PWMUDB_sCTRLReg_SyncCtl_ctrlreg__CONTROL_REG, CYREG_B0_UDB03_CTL
.set PWM_1_PWMUDB_sCTRLReg_SyncCtl_ctrlreg__CONTROL_ST_REG, CYREG_B0_UDB03_ST_CTL
.set PWM_1_PWMUDB_sCTRLReg_SyncCtl_ctrlreg__COUNT_REG, CYREG_B0_UDB03_CTL
.set PWM_1_PWMUDB_sCTRLReg_SyncCtl_ctrlreg__COUNT_ST_REG, CYREG_B0_UDB03_ST_CTL
.set PWM_1_PWMUDB_sCTRLReg_SyncCtl_ctrlreg__MASK, 0x80
.set PWM_1_PWMUDB_sCTRLReg_SyncCtl_ctrlreg__MASK_CTL_AUX_CTL_REG, CYREG_B0_UDB03_MSK_ACTL
.set PWM_1_PWMUDB_sCTRLReg_SyncCtl_ctrlreg__PERIOD_REG, CYREG_B0_UDB03_MSK
.set PWM_1_PWMUDB_sCTRLReg_SyncCtl_ctrlreg__PER_CTL_AUX_CTL_REG, CYREG_B0_UDB03_MSK_ACTL
.set PWM_1_PWMUDB_sP8_pwmdp_u0__16BIT_A0_REG, CYREG_B0_UDB03_04_A0
.set PWM_1_PWMUDB_sP8_pwmdp_u0__16BIT_A1_REG, CYREG_B0_UDB03_04_A1
.set PWM_1_PWMUDB_sP8_pwmdp_u0__16BIT_D0_REG, CYREG_B0_UDB03_04_D0
.set PWM_1_PWMUDB_sP8_pwmdp_u0__16BIT_D1_REG, CYREG_B0_UDB03_04_D1
.set PWM_1_PWMUDB_sP8_pwmdp_u0__16BIT_DP_AUX_CTL_REG, CYREG_B0_UDB03_04_ACTL
.set PWM_1_PWMUDB_sP8_pwmdp_u0__16BIT_F0_REG, CYREG_B0_UDB03_04_F0
.set PWM_1_PWMUDB_sP8_pwmdp_u0__16BIT_F1_REG, CYREG_B0_UDB03_04_F1
.set PWM_1_PWMUDB_sP8_pwmdp_u0__A0_A1_REG, CYREG_B0_UDB03_A0_A1
.set PWM_1_PWMUDB_sP8_pwmdp_u0__A0_REG, CYREG_B0_UDB03_A0
.set PWM_1_PWMUDB_sP8_pwmdp_u0__A1_REG, CYREG_B0_UDB03_A1
.set PWM_1_PWMUDB_sP8_pwmdp_u0__D0_D1_REG, CYREG_B0_UDB03_D0_D1
.set PWM_1_PWMUDB_sP8_pwmdp_u0__D0_REG, CYREG_B0_UDB03_D0
.set PWM_1_PWMUDB_sP8_pwmdp_u0__D1_REG, CYREG_B0_UDB03_D1
.set PWM_1_PWMUDB_sP8_pwmdp_u0__DP_AUX_CTL_REG, CYREG_B0_UDB03_ACTL
.set PWM_1_PWMUDB_sP8_pwmdp_u0__F0_F1_REG, CYREG_B0_UDB03_F0_F1
.set PWM_1_PWMUDB_sP8_pwmdp_u0__F0_REG, CYREG_B0_UDB03_F0
.set PWM_1_PWMUDB_sP8_pwmdp_u0__F1_REG, CYREG_B0_UDB03_F1
.set PWM_1_PWMUDB_sP8_pwmdp_u0__MSK_DP_AUX_CTL_REG, CYREG_B0_UDB03_MSK_ACTL
.set PWM_1_PWMUDB_sP8_pwmdp_u0__PER_DP_AUX_CTL_REG, CYREG_B0_UDB03_MSK_ACTL

/* PWM_2_PWMUDB */
.set PWM_2_PWMUDB_sCTRLReg_SyncCtl_ctrlreg__16BIT_CONTROL_AUX_CTL_REG, CYREG_B0_UDB02_03_ACTL
.set PWM_2_PWMUDB_sCTRLReg_SyncCtl_ctrlreg__16BIT_CONTROL_CONTROL_REG, CYREG_B0_UDB02_03_CTL
.set PWM_2_PWMUDB_sCTRLReg_SyncCtl_ctrlreg__16BIT_CONTROL_COUNT_REG, CYREG_B0_UDB02_03_CTL
.set PWM_2_PWMUDB_sCTRLReg_SyncCtl_ctrlreg__16BIT_COUNT_CONTROL_REG, CYREG_B0_UDB02_03_CTL
.set PWM_2_PWMUDB_sCTRLReg_SyncCtl_ctrlreg__16BIT_COUNT_COUNT_REG, CYREG_B0_UDB02_03_CTL
.set PWM_2_PWMUDB_sCTRLReg_SyncCtl_ctrlreg__16BIT_MASK_MASK_REG, CYREG_B0_UDB02_03_MSK
.set PWM_2_PWMUDB_sCTRLReg_SyncCtl_ctrlreg__16BIT_MASK_PERIOD_REG, CYREG_B0_UDB02_03_MSK
.set PWM_2_PWMUDB_sCTRLReg_SyncCtl_ctrlreg__16BIT_PERIOD_MASK_REG, CYREG_B0_UDB02_03_MSK
.set PWM_2_PWMUDB_sCTRLReg_SyncCtl_ctrlreg__16BIT_PERIOD_PERIOD_REG, CYREG_B0_UDB02_03_MSK
.set PWM_2_PWMUDB_sCTRLReg_SyncCtl_ctrlreg__7__MASK, 0x80
.set PWM_2_PWMUDB_sCTRLReg_SyncCtl_ctrlreg__7__POS, 7
.set PWM_2_PWMUDB_sCTRLReg_SyncCtl_ctrlreg__CONTROL_AUX_CTL_REG, CYREG_B0_UDB02_ACTL
.set PWM_2_PWMUDB_sCTRLReg_SyncCtl_ctrlreg__CONTROL_REG, CYREG_B0_UDB02_CTL
.set PWM_2_PWMUDB_sCTRLReg_SyncCtl_ctrlreg__CONTROL_ST_REG, CYREG_B0_UDB02_ST_CTL
.set PWM_2_PWMUDB_sCTRLReg_SyncCtl_ctrlreg__COUNT_REG, CYREG_B0_UDB02_CTL
.set PWM_2_PWMUDB_sCTRLReg_SyncCtl_ctrlreg__COUNT_ST_REG, CYREG_B0_UDB02_ST_CTL
.set PWM_2_PWMUDB_sCTRLReg_SyncCtl_ctrlreg__MASK, 0x80
.set PWM_2_PWMUDB_sCTRLReg_SyncCtl_ctrlreg__MASK_CTL_AUX_CTL_REG, CYREG_B0_UDB02_MSK_ACTL
.set PWM_2_PWMUDB_sCTRLReg_SyncCtl_ctrlreg__PERIOD_REG, CYREG_B0_UDB02_MSK
.set PWM_2_PWMUDB_sCTRLReg_SyncCtl_ctrlreg__PER_CTL_AUX_CTL_REG, CYREG_B0_UDB02_MSK_ACTL
.set PWM_2_PWMUDB_sP8_pwmdp_u0__16BIT_A0_REG, CYREG_B0_UDB02_03_A0
.set PWM_2_PWMUDB_sP8_pwmdp_u0__16BIT_A1_REG, CYREG_B0_UDB02_03_A1
.set PWM_2_PWMUDB_sP8_pwmdp_u0__16BIT_D0_REG, CYREG_B0_UDB02_03_D0
.set PWM_2_PWMUDB_sP8_pwmdp_u0__16BIT_D1_REG, CYREG_B0_UDB02_03_D1
.set PWM_2_PWMUDB_sP8_pwmdp_u0__16BIT_DP_AUX_CTL_REG, CYREG_B0_UDB02_03_ACTL
.set PWM_2_PWMUDB_sP8_pwmdp_u0__16BIT_F0_REG, CYREG_B0_UDB02_03_F0
.set PWM_2_PWMUDB_sP8_pwmdp_u0__16BIT_F1_REG, CYREG_B0_UDB02_03_F1
.set PWM_2_PWMUDB_sP8_pwmdp_u0__A0_A1_REG, CYREG_B0_UDB02_A0_A1
.set PWM_2_PWMUDB_sP8_pwmdp_u0__A0_REG, CYREG_B0_UDB02_A0
.set PWM_2_PWMUDB_sP8_pwmdp_u0__A1_REG, CYREG_B0_UDB02_A1
.set PWM_2_PWMUDB_sP8_pwmdp_u0__D0_D1_REG, CYREG_B0_UDB02_D0_D1
.set PWM_2_PWMUDB_sP8_pwmdp_u0__D0_REG, CYREG_B0_UDB02_D0
.set PWM_2_PWMUDB_sP8_pwmdp_u0__D1_REG, CYREG_B0_UDB02_D1
.set PWM_2_PWMUDB_sP8_pwmdp_u0__DP_AUX_CTL_REG, CYREG_B0_UDB02_ACTL
.set PWM_2_PWMUDB_sP8_pwmdp_u0__F0_F1_REG, CYREG_B0_UDB02_F0_F1
.set PWM_2_PWMUDB_sP8_pwmdp_u0__F0_REG, CYREG_B0_UDB02_F0
.set PWM_2_PWMUDB_sP8_pwmdp_u0__F1_REG, CYREG_B0_UDB02_F1
.set PWM_2_PWMUDB_sP8_pwmdp_u0__MSK_DP_AUX_CTL_REG, CYREG_B0_UDB02_MSK_ACTL
.set PWM_2_PWMUDB_sP8_pwmdp_u0__PER_DP_AUX_CTL_REG, CYREG_B0_UDB02_MSK_ACTL

/* Cond_Vout */
.set Cond_Vout__0__MASK, 0x80
.set Cond_Vout__0__PC, CYREG_PRT0_PC7
.set Cond_Vout__0__PORT, 0
.set Cond_Vout__0__SHIFT, 7
.set Cond_Vout__AG, CYREG_PRT0_AG
.set Cond_Vout__AMUX, CYREG_PRT0_AMUX
.set Cond_Vout__BIE, CYREG_PRT0_BIE
.set Cond_Vout__BIT_MASK, CYREG_PRT0_BIT_MASK
.set Cond_Vout__BYP, CYREG_PRT0_BYP
.set Cond_Vout__CTL, CYREG_PRT0_CTL
.set Cond_Vout__DM0, CYREG_PRT0_DM0
.set Cond_Vout__DM1, CYREG_PRT0_DM1
.set Cond_Vout__DM2, CYREG_PRT0_DM2
.set Cond_Vout__DR, CYREG_PRT0_DR
.set Cond_Vout__INP_DIS, CYREG_PRT0_INP_DIS
.set Cond_Vout__LCD_COM_SEG, CYREG_PRT0_LCD_COM_SEG
.set Cond_Vout__LCD_EN, CYREG_PRT0_LCD_EN
.set Cond_Vout__MASK, 0x80
.set Cond_Vout__PORT, 0
.set Cond_Vout__PRT, CYREG_PRT0_PRT
.set Cond_Vout__PRTDSI__CAPS_SEL, CYREG_PRT0_CAPS_SEL
.set Cond_Vout__PRTDSI__DBL_SYNC_IN, CYREG_PRT0_DBL_SYNC_IN
.set Cond_Vout__PRTDSI__OE_SEL0, CYREG_PRT0_OE_SEL0
.set Cond_Vout__PRTDSI__OE_SEL1, CYREG_PRT0_OE_SEL1
.set Cond_Vout__PRTDSI__OUT_SEL0, CYREG_PRT0_OUT_SEL0
.set Cond_Vout__PRTDSI__OUT_SEL1, CYREG_PRT0_OUT_SEL1
.set Cond_Vout__PRTDSI__SYNC_OUT, CYREG_PRT0_SYNC_OUT
.set Cond_Vout__PS, CYREG_PRT0_PS
.set Cond_Vout__SHIFT, 7
.set Cond_Vout__SLW, CYREG_PRT0_SLW

/* Temp_Vout */
.set Temp_Vout__0__MASK, 0x01
.set Temp_Vout__0__PC, CYREG_PRT0_PC0
.set Temp_Vout__0__PORT, 0
.set Temp_Vout__0__SHIFT, 0
.set Temp_Vout__AG, CYREG_PRT0_AG
.set Temp_Vout__AMUX, CYREG_PRT0_AMUX
.set Temp_Vout__BIE, CYREG_PRT0_BIE
.set Temp_Vout__BIT_MASK, CYREG_PRT0_BIT_MASK
.set Temp_Vout__BYP, CYREG_PRT0_BYP
.set Temp_Vout__CTL, CYREG_PRT0_CTL
.set Temp_Vout__DM0, CYREG_PRT0_DM0
.set Temp_Vout__DM1, CYREG_PRT0_DM1
.set Temp_Vout__DM2, CYREG_PRT0_DM2
.set Temp_Vout__DR, CYREG_PRT0_DR
.set Temp_Vout__INP_DIS, CYREG_PRT0_INP_DIS
.set Temp_Vout__LCD_COM_SEG, CYREG_PRT0_LCD_COM_SEG
.set Temp_Vout__LCD_EN, CYREG_PRT0_LCD_EN
.set Temp_Vout__MASK, 0x01
.set Temp_Vout__PORT, 0
.set Temp_Vout__PRT, CYREG_PRT0_PRT
.set Temp_Vout__PRTDSI__CAPS_SEL, CYREG_PRT0_CAPS_SEL
.set Temp_Vout__PRTDSI__DBL_SYNC_IN, CYREG_PRT0_DBL_SYNC_IN
.set Temp_Vout__PRTDSI__OE_SEL0, CYREG_PRT0_OE_SEL0
.set Temp_Vout__PRTDSI__OE_SEL1, CYREG_PRT0_OE_SEL1
.set Temp_Vout__PRTDSI__OUT_SEL0, CYREG_PRT0_OUT_SEL0
.set Temp_Vout__PRTDSI__OUT_SEL1, CYREG_PRT0_OUT_SEL1
.set Temp_Vout__PRTDSI__SYNC_OUT, CYREG_PRT0_SYNC_OUT
.set Temp_Vout__PS, CYREG_PRT0_PS
.set Temp_Vout__SHIFT, 0
.set Temp_Vout__SLW, CYREG_PRT0_SLW

/* Clock_1 */
.set Clock_1__CFG0, CYREG_CLKDIST_DCFG1_CFG0
.set Clock_1__CFG1, CYREG_CLKDIST_DCFG1_CFG1
.set Clock_1__CFG2, CYREG_CLKDIST_DCFG1_CFG2
.set Clock_1__CFG2_SRC_SEL_MASK, 0x07
.set Clock_1__INDEX, 0x01
.set Clock_1__PM_ACT_CFG, CYREG_PM_ACT_CFG2
.set Clock_1__PM_ACT_MSK, 0x02
.set Clock_1__PM_STBY_CFG, CYREG_PM_STBY_CFG2
.set Clock_1__PM_STBY_MSK, 0x02

/* Cond_Vs */
.set Cond_Vs__0__MASK, 0x02
.set Cond_Vs__0__PC, CYREG_PRT3_PC1
.set Cond_Vs__0__PORT, 3
.set Cond_Vs__0__SHIFT, 1
.set Cond_Vs__AG, CYREG_PRT3_AG
.set Cond_Vs__AMUX, CYREG_PRT3_AMUX
.set Cond_Vs__BIE, CYREG_PRT3_BIE
.set Cond_Vs__BIT_MASK, CYREG_PRT3_BIT_MASK
.set Cond_Vs__BYP, CYREG_PRT3_BYP
.set Cond_Vs__CTL, CYREG_PRT3_CTL
.set Cond_Vs__DM0, CYREG_PRT3_DM0
.set Cond_Vs__DM1, CYREG_PRT3_DM1
.set Cond_Vs__DM2, CYREG_PRT3_DM2
.set Cond_Vs__DR, CYREG_PRT3_DR
.set Cond_Vs__INP_DIS, CYREG_PRT3_INP_DIS
.set Cond_Vs__LCD_COM_SEG, CYREG_PRT3_LCD_COM_SEG
.set Cond_Vs__LCD_EN, CYREG_PRT3_LCD_EN
.set Cond_Vs__MASK, 0x02
.set Cond_Vs__PORT, 3
.set Cond_Vs__PRT, CYREG_PRT3_PRT
.set Cond_Vs__PRTDSI__CAPS_SEL, CYREG_PRT3_CAPS_SEL
.set Cond_Vs__PRTDSI__DBL_SYNC_IN, CYREG_PRT3_DBL_SYNC_IN
.set Cond_Vs__PRTDSI__OE_SEL0, CYREG_PRT3_OE_SEL0
.set Cond_Vs__PRTDSI__OE_SEL1, CYREG_PRT3_OE_SEL1
.set Cond_Vs__PRTDSI__OUT_SEL0, CYREG_PRT3_OUT_SEL0
.set Cond_Vs__PRTDSI__OUT_SEL1, CYREG_PRT3_OUT_SEL1
.set Cond_Vs__PRTDSI__SYNC_OUT, CYREG_PRT3_SYNC_OUT
.set Cond_Vs__PS, CYREG_PRT3_PS
.set Cond_Vs__SHIFT, 1
.set Cond_Vs__SLW, CYREG_PRT3_SLW

/* Cond_Vx */
.set Cond_Vx__0__MASK, 0x01
.set Cond_Vx__0__PC, CYREG_PRT3_PC0
.set Cond_Vx__0__PORT, 3
.set Cond_Vx__0__SHIFT, 0
.set Cond_Vx__AG, CYREG_PRT3_AG
.set Cond_Vx__AMUX, CYREG_PRT3_AMUX
.set Cond_Vx__BIE, CYREG_PRT3_BIE
.set Cond_Vx__BIT_MASK, CYREG_PRT3_BIT_MASK
.set Cond_Vx__BYP, CYREG_PRT3_BYP
.set Cond_Vx__CTL, CYREG_PRT3_CTL
.set Cond_Vx__DM0, CYREG_PRT3_DM0
.set Cond_Vx__DM1, CYREG_PRT3_DM1
.set Cond_Vx__DM2, CYREG_PRT3_DM2
.set Cond_Vx__DR, CYREG_PRT3_DR
.set Cond_Vx__INP_DIS, CYREG_PRT3_INP_DIS
.set Cond_Vx__LCD_COM_SEG, CYREG_PRT3_LCD_COM_SEG
.set Cond_Vx__LCD_EN, CYREG_PRT3_LCD_EN
.set Cond_Vx__MASK, 0x01
.set Cond_Vx__PORT, 3
.set Cond_Vx__PRT, CYREG_PRT3_PRT
.set Cond_Vx__PRTDSI__CAPS_SEL, CYREG_PRT3_CAPS_SEL
.set Cond_Vx__PRTDSI__DBL_SYNC_IN, CYREG_PRT3_DBL_SYNC_IN
.set Cond_Vx__PRTDSI__OE_SEL0, CYREG_PRT3_OE_SEL0
.set Cond_Vx__PRTDSI__OE_SEL1, CYREG_PRT3_OE_SEL1
.set Cond_Vx__PRTDSI__OUT_SEL0, CYREG_PRT3_OUT_SEL0
.set Cond_Vx__PRTDSI__OUT_SEL1, CYREG_PRT3_OUT_SEL1
.set Cond_Vx__PRTDSI__SYNC_OUT, CYREG_PRT3_SYNC_OUT
.set Cond_Vx__PS, CYREG_PRT3_PS
.set Cond_Vx__SHIFT, 0
.set Cond_Vx__SLW, CYREG_PRT3_SLW

/* Temp_Vs */
.set Temp_Vs__0__MASK, 0x08
.set Temp_Vs__0__PC, CYREG_PRT3_PC3
.set Temp_Vs__0__PORT, 3
.set Temp_Vs__0__SHIFT, 3
.set Temp_Vs__AG, CYREG_PRT3_AG
.set Temp_Vs__AMUX, CYREG_PRT3_AMUX
.set Temp_Vs__BIE, CYREG_PRT3_BIE
.set Temp_Vs__BIT_MASK, CYREG_PRT3_BIT_MASK
.set Temp_Vs__BYP, CYREG_PRT3_BYP
.set Temp_Vs__CTL, CYREG_PRT3_CTL
.set Temp_Vs__DM0, CYREG_PRT3_DM0
.set Temp_Vs__DM1, CYREG_PRT3_DM1
.set Temp_Vs__DM2, CYREG_PRT3_DM2
.set Temp_Vs__DR, CYREG_PRT3_DR
.set Temp_Vs__INP_DIS, CYREG_PRT3_INP_DIS
.set Temp_Vs__LCD_COM_SEG, CYREG_PRT3_LCD_COM_SEG
.set Temp_Vs__LCD_EN, CYREG_PRT3_LCD_EN
.set Temp_Vs__MASK, 0x08
.set Temp_Vs__PORT, 3
.set Temp_Vs__PRT, CYREG_PRT3_PRT
.set Temp_Vs__PRTDSI__CAPS_SEL, CYREG_PRT3_CAPS_SEL
.set Temp_Vs__PRTDSI__DBL_SYNC_IN, CYREG_PRT3_DBL_SYNC_IN
.set Temp_Vs__PRTDSI__OE_SEL0, CYREG_PRT3_OE_SEL0
.set Temp_Vs__PRTDSI__OE_SEL1, CYREG_PRT3_OE_SEL1
.set Temp_Vs__PRTDSI__OUT_SEL0, CYREG_PRT3_OUT_SEL0
.set Temp_Vs__PRTDSI__OUT_SEL1, CYREG_PRT3_OUT_SEL1
.set Temp_Vs__PRTDSI__SYNC_OUT, CYREG_PRT3_SYNC_OUT
.set Temp_Vs__PS, CYREG_PRT3_PS
.set Temp_Vs__SHIFT, 3
.set Temp_Vs__SLW, CYREG_PRT3_SLW

/* Temp_Vx */
.set Temp_Vx__0__MASK, 0x10
.set Temp_Vx__0__PC, CYREG_PRT3_PC4
.set Temp_Vx__0__PORT, 3
.set Temp_Vx__0__SHIFT, 4
.set Temp_Vx__AG, CYREG_PRT3_AG
.set Temp_Vx__AMUX, CYREG_PRT3_AMUX
.set Temp_Vx__BIE, CYREG_PRT3_BIE
.set Temp_Vx__BIT_MASK, CYREG_PRT3_BIT_MASK
.set Temp_Vx__BYP, CYREG_PRT3_BYP
.set Temp_Vx__CTL, CYREG_PRT3_CTL
.set Temp_Vx__DM0, CYREG_PRT3_DM0
.set Temp_Vx__DM1, CYREG_PRT3_DM1
.set Temp_Vx__DM2, CYREG_PRT3_DM2
.set Temp_Vx__DR, CYREG_PRT3_DR
.set Temp_Vx__INP_DIS, CYREG_PRT3_INP_DIS
.set Temp_Vx__LCD_COM_SEG, CYREG_PRT3_LCD_COM_SEG
.set Temp_Vx__LCD_EN, CYREG_PRT3_LCD_EN
.set Temp_Vx__MASK, 0x10
.set Temp_Vx__PORT, 3
.set Temp_Vx__PRT, CYREG_PRT3_PRT
.set Temp_Vx__PRTDSI__CAPS_SEL, CYREG_PRT3_CAPS_SEL
.set Temp_Vx__PRTDSI__DBL_SYNC_IN, CYREG_PRT3_DBL_SYNC_IN
.set Temp_Vx__PRTDSI__OE_SEL0, CYREG_PRT3_OE_SEL0
.set Temp_Vx__PRTDSI__OE_SEL1, CYREG_PRT3_OE_SEL1
.set Temp_Vx__PRTDSI__OUT_SEL0, CYREG_PRT3_OUT_SEL0
.set Temp_Vx__PRTDSI__OUT_SEL1, CYREG_PRT3_OUT_SEL1
.set Temp_Vx__PRTDSI__SYNC_OUT, CYREG_PRT3_SYNC_OUT
.set Temp_Vx__PS, CYREG_PRT3_PS
.set Temp_Vx__SHIFT, 4
.set Temp_Vx__SLW, CYREG_PRT3_SLW

/* Miscellaneous */
/* -- WARNING: define names containing LEOPARD or PANTHER are deprecated and will be removed in a future release */
.set CYDEV_DEBUGGING_DPS_SWD_SWV, 6
.set CYDEV_CONFIG_UNUSED_IO_AllowButWarn, 0
.set CYDEV_CONFIGURATION_MODE_COMPRESSED, 0
.set CYDEV_CONFIG_FASTBOOT_ENABLED, 1
.set CYDEV_CHIP_REV_PSOC5LP_PRODUCTION, 0
.set CYDEV_CHIP_REVISION_5B_PRODUCTION, 0
.set CYDEV_CHIP_MEMBER_5B, 4
.set CYDEV_CHIP_FAMILY_PSOC5, 3
.set CYDEV_CHIP_DIE_PSOC5LP, 4
.set CYDEV_CHIP_DIE_EXPECT, CYDEV_CHIP_DIE_PSOC5LP
.set BCLK__BUS_CLK__HZ, 24000000
.set BCLK__BUS_CLK__KHZ, 24000
.set BCLK__BUS_CLK__MHZ, 24
.set CYDEV_CHIP_DIE_ACTUAL, CYDEV_CHIP_DIE_EXPECT
.set CYDEV_CHIP_DIE_LEOPARD, 1
.set CYDEV_CHIP_DIE_PANTHER, 3
.set CYDEV_CHIP_DIE_PSOC4A, 2
.set CYDEV_CHIP_DIE_UNKNOWN, 0
.set CYDEV_CHIP_FAMILY_PSOC3, 1
.set CYDEV_CHIP_FAMILY_PSOC4, 2
.set CYDEV_CHIP_FAMILY_UNKNOWN, 0
.set CYDEV_CHIP_FAMILY_USED, CYDEV_CHIP_FAMILY_PSOC5
.set CYDEV_CHIP_JTAG_ID, 0x2E123069
.set CYDEV_CHIP_MEMBER_3A, 1
.set CYDEV_CHIP_MEMBER_4A, 2
.set CYDEV_CHIP_MEMBER_5A, 3
.set CYDEV_CHIP_MEMBER_UNKNOWN, 0
.set CYDEV_CHIP_MEMBER_USED, CYDEV_CHIP_MEMBER_5B
.set CYDEV_CHIP_REVISION_3A_ES1, 0
.set CYDEV_CHIP_REVISION_3A_ES2, 1
.set CYDEV_CHIP_REVISION_3A_ES3, 3
.set CYDEV_CHIP_REVISION_3A_PRODUCTION, 3
.set CYDEV_CHIP_REVISION_4A_ES0, 17
.set CYDEV_CHIP_REVISION_4A_PRODUCTION, 17
.set CYDEV_CHIP_REVISION_5A_ES0, 0
.set CYDEV_CHIP_REVISION_5A_ES1, 1
.set CYDEV_CHIP_REVISION_5A_PRODUCTION, 1
.set CYDEV_CHIP_REVISION_5B_ES0, 0
.set CYDEV_CHIP_REVISION_USED, CYDEV_CHIP_REVISION_5B_PRODUCTION
.set CYDEV_CHIP_REV_EXPECT, CYDEV_CHIP_REV_PSOC5LP_PRODUCTION
.set CYDEV_CHIP_REV_LEOPARD_ES1, 0
.set CYDEV_CHIP_REV_LEOPARD_ES2, 1
.set CYDEV_CHIP_REV_LEOPARD_ES3, 3
.set CYDEV_CHIP_REV_LEOPARD_PRODUCTION, 3
.set CYDEV_CHIP_REV_PANTHER_ES0, 0
.set CYDEV_CHIP_REV_PANTHER_ES1, 1
.set CYDEV_CHIP_REV_PANTHER_PRODUCTION, 1
.set CYDEV_CHIP_REV_PSOC4A_ES0, 17
.set CYDEV_CHIP_REV_PSOC4A_PRODUCTION, 17
.set CYDEV_CHIP_REV_PSOC5LP_ES0, 0
.set CYDEV_CONFIGURATION_COMPRESSED, 1
.set CYDEV_CONFIGURATION_DMA, 0
.set CYDEV_CONFIGURATION_ECC, 1
.set CYDEV_CONFIGURATION_IMOENABLED, CYDEV_CONFIG_FASTBOOT_ENABLED
.set CYDEV_CONFIGURATION_MODE, CYDEV_CONFIGURATION_MODE_COMPRESSED
.set CYDEV_CONFIGURATION_MODE_DMA, 2
.set CYDEV_CONFIGURATION_MODE_UNCOMPRESSED, 1
.set CYDEV_CONFIG_UNUSED_IO, CYDEV_CONFIG_UNUSED_IO_AllowButWarn
.set CYDEV_CONFIG_UNUSED_IO_AllowWithInfo, 1
.set CYDEV_CONFIG_UNUSED_IO_Disallowed, 2
.set CYDEV_DEBUGGING_DPS, CYDEV_DEBUGGING_DPS_SWD_SWV
.set CYDEV_DEBUGGING_DPS_Disable, 3
.set CYDEV_DEBUGGING_DPS_JTAG_4, 1
.set CYDEV_DEBUGGING_DPS_JTAG_5, 0
.set CYDEV_DEBUGGING_DPS_SWD, 2
.set CYDEV_DEBUGGING_ENABLE, 1
.set CYDEV_DEBUGGING_REQXRES, 1
.set CYDEV_DEBUGGING_XRES, 0
.set CYDEV_DEBUG_ENABLE_MASK, 0x20
.set CYDEV_DEBUG_ENABLE_REGISTER, CYREG_MLOGIC_DEBUG
.set CYDEV_DMA_CHANNELS_AVAILABLE, 24
.set CYDEV_ECC_ENABLE, 0
.set CYDEV_HEAP_SIZE, 0x1000
.set CYDEV_INSTRUCT_CACHE_ENABLED, 1
.set CYDEV_INTR_RISING, 0x00000000
.set CYDEV_PROJ_TYPE, 0
.set CYDEV_PROJ_TYPE_BOOTLOADER, 1
.set CYDEV_PROJ_TYPE_LOADABLE, 2
.set CYDEV_PROJ_TYPE_MULTIAPPBOOTLOADER, 3
.set CYDEV_PROJ_TYPE_STANDARD, 0
.set CYDEV_PROTECTION_ENABLE, 0
.set CYDEV_STACK_SIZE, 0x4000
.set CYDEV_USE_BUNDLED_CMSIS, 1
.set CYDEV_VARIABLE_VDDA, 0
.set CYDEV_VDDA_MV, 5000
.set CYDEV_VDDD_MV, 5000
.set CYDEV_VDDIO0_MV, 5000
.set CYDEV_VDDIO1_MV, 5000
.set CYDEV_VDDIO2_MV, 5000
.set CYDEV_VDDIO3_MV, 5000
.set CYDEV_VIO0, 5
.set CYDEV_VIO0_MV, 5000
.set CYDEV_VIO1, 5
.set CYDEV_VIO1_MV, 5000
.set CYDEV_VIO2, 5
.set CYDEV_VIO2_MV, 5000
.set CYDEV_VIO3, 5
.set CYDEV_VIO3_MV, 5000
.set DMA_CHANNELS_USED__MASK0, 0x00000000
.set CYDEV_BOOTLOADER_ENABLE, 0
.endif
