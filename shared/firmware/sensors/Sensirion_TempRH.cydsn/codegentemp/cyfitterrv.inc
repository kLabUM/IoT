    IF :LNOT::DEF:INCLUDED_CYFITTERRV_INC
INCLUDED_CYFITTERRV_INC EQU 1
    GET cydevicerv.inc
    GET cydevicerv_trm.inc

; SCL_1
SCL_1__0__INTTYPE EQU CYREG_PICU1_INTTYPE2
SCL_1__0__MASK EQU 0x04
SCL_1__0__PC EQU CYREG_PRT1_PC2
SCL_1__0__PORT EQU 1
SCL_1__0__SHIFT EQU 2
SCL_1__AG EQU CYREG_PRT1_AG
SCL_1__AMUX EQU CYREG_PRT1_AMUX
SCL_1__BIE EQU CYREG_PRT1_BIE
SCL_1__BIT_MASK EQU CYREG_PRT1_BIT_MASK
SCL_1__BYP EQU CYREG_PRT1_BYP
SCL_1__CTL EQU CYREG_PRT1_CTL
SCL_1__DM0 EQU CYREG_PRT1_DM0
SCL_1__DM1 EQU CYREG_PRT1_DM1
SCL_1__DM2 EQU CYREG_PRT1_DM2
SCL_1__DR EQU CYREG_PRT1_DR
SCL_1__INP_DIS EQU CYREG_PRT1_INP_DIS
SCL_1__INTTYPE_BASE EQU CYDEV_PICU_INTTYPE_PICU1_BASE
SCL_1__LCD_COM_SEG EQU CYREG_PRT1_LCD_COM_SEG
SCL_1__LCD_EN EQU CYREG_PRT1_LCD_EN
SCL_1__MASK EQU 0x04
SCL_1__PORT EQU 1
SCL_1__PRT EQU CYREG_PRT1_PRT
SCL_1__PRTDSI__CAPS_SEL EQU CYREG_PRT1_CAPS_SEL
SCL_1__PRTDSI__DBL_SYNC_IN EQU CYREG_PRT1_DBL_SYNC_IN
SCL_1__PRTDSI__OE_SEL0 EQU CYREG_PRT1_OE_SEL0
SCL_1__PRTDSI__OE_SEL1 EQU CYREG_PRT1_OE_SEL1
SCL_1__PRTDSI__OUT_SEL0 EQU CYREG_PRT1_OUT_SEL0
SCL_1__PRTDSI__OUT_SEL1 EQU CYREG_PRT1_OUT_SEL1
SCL_1__PRTDSI__SYNC_OUT EQU CYREG_PRT1_SYNC_OUT
SCL_1__PS EQU CYREG_PRT1_PS
SCL_1__SHIFT EQU 2
SCL_1__SLW EQU CYREG_PRT1_SLW

; SDA_1
SDA_1__0__INTTYPE EQU CYREG_PICU5_INTTYPE3
SDA_1__0__MASK EQU 0x08
SDA_1__0__PC EQU CYREG_PRT5_PC3
SDA_1__0__PORT EQU 5
SDA_1__0__SHIFT EQU 3
SDA_1__AG EQU CYREG_PRT5_AG
SDA_1__AMUX EQU CYREG_PRT5_AMUX
SDA_1__BIE EQU CYREG_PRT5_BIE
SDA_1__BIT_MASK EQU CYREG_PRT5_BIT_MASK
SDA_1__BYP EQU CYREG_PRT5_BYP
SDA_1__CTL EQU CYREG_PRT5_CTL
SDA_1__DM0 EQU CYREG_PRT5_DM0
SDA_1__DM1 EQU CYREG_PRT5_DM1
SDA_1__DM2 EQU CYREG_PRT5_DM2
SDA_1__DR EQU CYREG_PRT5_DR
SDA_1__INP_DIS EQU CYREG_PRT5_INP_DIS
SDA_1__INTTYPE_BASE EQU CYDEV_PICU_INTTYPE_PICU5_BASE
SDA_1__LCD_COM_SEG EQU CYREG_PRT5_LCD_COM_SEG
SDA_1__LCD_EN EQU CYREG_PRT5_LCD_EN
SDA_1__MASK EQU 0x08
SDA_1__PORT EQU 5
SDA_1__PRT EQU CYREG_PRT5_PRT
SDA_1__PRTDSI__CAPS_SEL EQU CYREG_PRT5_CAPS_SEL
SDA_1__PRTDSI__DBL_SYNC_IN EQU CYREG_PRT5_DBL_SYNC_IN
SDA_1__PRTDSI__OE_SEL0 EQU CYREG_PRT5_OE_SEL0
SDA_1__PRTDSI__OE_SEL1 EQU CYREG_PRT5_OE_SEL1
SDA_1__PRTDSI__OUT_SEL0 EQU CYREG_PRT5_OUT_SEL0
SDA_1__PRTDSI__OUT_SEL1 EQU CYREG_PRT5_OUT_SEL1
SDA_1__PRTDSI__SYNC_OUT EQU CYREG_PRT5_SYNC_OUT
SDA_1__PS EQU CYREG_PRT5_PS
SDA_1__SHIFT EQU 3
SDA_1__SLW EQU CYREG_PRT5_SLW

; Sensirion_I2C_bI2C_UDB
Sensirion_I2C_bI2C_UDB_Master_ClkGen_u0__16BIT_A0_REG EQU CYREG_B1_UDB08_09_A0
Sensirion_I2C_bI2C_UDB_Master_ClkGen_u0__16BIT_A1_REG EQU CYREG_B1_UDB08_09_A1
Sensirion_I2C_bI2C_UDB_Master_ClkGen_u0__16BIT_D0_REG EQU CYREG_B1_UDB08_09_D0
Sensirion_I2C_bI2C_UDB_Master_ClkGen_u0__16BIT_D1_REG EQU CYREG_B1_UDB08_09_D1
Sensirion_I2C_bI2C_UDB_Master_ClkGen_u0__16BIT_DP_AUX_CTL_REG EQU CYREG_B1_UDB08_09_ACTL
Sensirion_I2C_bI2C_UDB_Master_ClkGen_u0__16BIT_F0_REG EQU CYREG_B1_UDB08_09_F0
Sensirion_I2C_bI2C_UDB_Master_ClkGen_u0__16BIT_F1_REG EQU CYREG_B1_UDB08_09_F1
Sensirion_I2C_bI2C_UDB_Master_ClkGen_u0__A0_A1_REG EQU CYREG_B1_UDB08_A0_A1
Sensirion_I2C_bI2C_UDB_Master_ClkGen_u0__A0_REG EQU CYREG_B1_UDB08_A0
Sensirion_I2C_bI2C_UDB_Master_ClkGen_u0__A1_REG EQU CYREG_B1_UDB08_A1
Sensirion_I2C_bI2C_UDB_Master_ClkGen_u0__D0_D1_REG EQU CYREG_B1_UDB08_D0_D1
Sensirion_I2C_bI2C_UDB_Master_ClkGen_u0__D0_REG EQU CYREG_B1_UDB08_D0
Sensirion_I2C_bI2C_UDB_Master_ClkGen_u0__D1_REG EQU CYREG_B1_UDB08_D1
Sensirion_I2C_bI2C_UDB_Master_ClkGen_u0__DP_AUX_CTL_REG EQU CYREG_B1_UDB08_ACTL
Sensirion_I2C_bI2C_UDB_Master_ClkGen_u0__F0_F1_REG EQU CYREG_B1_UDB08_F0_F1
Sensirion_I2C_bI2C_UDB_Master_ClkGen_u0__F0_REG EQU CYREG_B1_UDB08_F0
Sensirion_I2C_bI2C_UDB_Master_ClkGen_u0__F1_REG EQU CYREG_B1_UDB08_F1
Sensirion_I2C_bI2C_UDB_Shifter_u0__16BIT_A0_REG EQU CYREG_B0_UDB09_10_A0
Sensirion_I2C_bI2C_UDB_Shifter_u0__16BIT_A1_REG EQU CYREG_B0_UDB09_10_A1
Sensirion_I2C_bI2C_UDB_Shifter_u0__16BIT_D0_REG EQU CYREG_B0_UDB09_10_D0
Sensirion_I2C_bI2C_UDB_Shifter_u0__16BIT_D1_REG EQU CYREG_B0_UDB09_10_D1
Sensirion_I2C_bI2C_UDB_Shifter_u0__16BIT_DP_AUX_CTL_REG EQU CYREG_B0_UDB09_10_ACTL
Sensirion_I2C_bI2C_UDB_Shifter_u0__16BIT_F0_REG EQU CYREG_B0_UDB09_10_F0
Sensirion_I2C_bI2C_UDB_Shifter_u0__16BIT_F1_REG EQU CYREG_B0_UDB09_10_F1
Sensirion_I2C_bI2C_UDB_Shifter_u0__A0_A1_REG EQU CYREG_B0_UDB09_A0_A1
Sensirion_I2C_bI2C_UDB_Shifter_u0__A0_REG EQU CYREG_B0_UDB09_A0
Sensirion_I2C_bI2C_UDB_Shifter_u0__A1_REG EQU CYREG_B0_UDB09_A1
Sensirion_I2C_bI2C_UDB_Shifter_u0__D0_D1_REG EQU CYREG_B0_UDB09_D0_D1
Sensirion_I2C_bI2C_UDB_Shifter_u0__D0_REG EQU CYREG_B0_UDB09_D0
Sensirion_I2C_bI2C_UDB_Shifter_u0__D1_REG EQU CYREG_B0_UDB09_D1
Sensirion_I2C_bI2C_UDB_Shifter_u0__DP_AUX_CTL_REG EQU CYREG_B0_UDB09_ACTL
Sensirion_I2C_bI2C_UDB_Shifter_u0__F0_F1_REG EQU CYREG_B0_UDB09_F0_F1
Sensirion_I2C_bI2C_UDB_Shifter_u0__F0_REG EQU CYREG_B0_UDB09_F0
Sensirion_I2C_bI2C_UDB_Shifter_u0__F1_REG EQU CYREG_B0_UDB09_F1
Sensirion_I2C_bI2C_UDB_Shifter_u0__MSK_DP_AUX_CTL_REG EQU CYREG_B0_UDB09_MSK_ACTL
Sensirion_I2C_bI2C_UDB_Shifter_u0__PER_DP_AUX_CTL_REG EQU CYREG_B0_UDB09_MSK_ACTL
Sensirion_I2C_bI2C_UDB_StsReg__0__MASK EQU 0x01
Sensirion_I2C_bI2C_UDB_StsReg__0__POS EQU 0
Sensirion_I2C_bI2C_UDB_StsReg__1__MASK EQU 0x02
Sensirion_I2C_bI2C_UDB_StsReg__1__POS EQU 1
Sensirion_I2C_bI2C_UDB_StsReg__16BIT_STATUS_AUX_CTL_REG EQU CYREG_B0_UDB11_12_ACTL
Sensirion_I2C_bI2C_UDB_StsReg__16BIT_STATUS_REG EQU CYREG_B0_UDB11_12_ST
Sensirion_I2C_bI2C_UDB_StsReg__2__MASK EQU 0x04
Sensirion_I2C_bI2C_UDB_StsReg__2__POS EQU 2
Sensirion_I2C_bI2C_UDB_StsReg__3__MASK EQU 0x08
Sensirion_I2C_bI2C_UDB_StsReg__3__POS EQU 3
Sensirion_I2C_bI2C_UDB_StsReg__4__MASK EQU 0x10
Sensirion_I2C_bI2C_UDB_StsReg__4__POS EQU 4
Sensirion_I2C_bI2C_UDB_StsReg__5__MASK EQU 0x20
Sensirion_I2C_bI2C_UDB_StsReg__5__POS EQU 5
Sensirion_I2C_bI2C_UDB_StsReg__MASK EQU 0x3F
Sensirion_I2C_bI2C_UDB_StsReg__MASK_REG EQU CYREG_B0_UDB11_MSK
Sensirion_I2C_bI2C_UDB_StsReg__STATUS_AUX_CTL_REG EQU CYREG_B0_UDB11_ACTL
Sensirion_I2C_bI2C_UDB_StsReg__STATUS_REG EQU CYREG_B0_UDB11_ST
Sensirion_I2C_bI2C_UDB_SyncCtl_CtrlReg__1__MASK EQU 0x02
Sensirion_I2C_bI2C_UDB_SyncCtl_CtrlReg__1__POS EQU 1
Sensirion_I2C_bI2C_UDB_SyncCtl_CtrlReg__16BIT_CONTROL_AUX_CTL_REG EQU CYREG_B0_UDB09_10_ACTL
Sensirion_I2C_bI2C_UDB_SyncCtl_CtrlReg__16BIT_CONTROL_CONTROL_REG EQU CYREG_B0_UDB09_10_CTL
Sensirion_I2C_bI2C_UDB_SyncCtl_CtrlReg__16BIT_CONTROL_COUNT_REG EQU CYREG_B0_UDB09_10_CTL
Sensirion_I2C_bI2C_UDB_SyncCtl_CtrlReg__16BIT_COUNT_CONTROL_REG EQU CYREG_B0_UDB09_10_CTL
Sensirion_I2C_bI2C_UDB_SyncCtl_CtrlReg__16BIT_COUNT_COUNT_REG EQU CYREG_B0_UDB09_10_CTL
Sensirion_I2C_bI2C_UDB_SyncCtl_CtrlReg__16BIT_MASK_MASK_REG EQU CYREG_B0_UDB09_10_MSK
Sensirion_I2C_bI2C_UDB_SyncCtl_CtrlReg__16BIT_MASK_PERIOD_REG EQU CYREG_B0_UDB09_10_MSK
Sensirion_I2C_bI2C_UDB_SyncCtl_CtrlReg__16BIT_PERIOD_MASK_REG EQU CYREG_B0_UDB09_10_MSK
Sensirion_I2C_bI2C_UDB_SyncCtl_CtrlReg__16BIT_PERIOD_PERIOD_REG EQU CYREG_B0_UDB09_10_MSK
Sensirion_I2C_bI2C_UDB_SyncCtl_CtrlReg__2__MASK EQU 0x04
Sensirion_I2C_bI2C_UDB_SyncCtl_CtrlReg__2__POS EQU 2
Sensirion_I2C_bI2C_UDB_SyncCtl_CtrlReg__4__MASK EQU 0x10
Sensirion_I2C_bI2C_UDB_SyncCtl_CtrlReg__4__POS EQU 4
Sensirion_I2C_bI2C_UDB_SyncCtl_CtrlReg__5__MASK EQU 0x20
Sensirion_I2C_bI2C_UDB_SyncCtl_CtrlReg__5__POS EQU 5
Sensirion_I2C_bI2C_UDB_SyncCtl_CtrlReg__6__MASK EQU 0x40
Sensirion_I2C_bI2C_UDB_SyncCtl_CtrlReg__6__POS EQU 6
Sensirion_I2C_bI2C_UDB_SyncCtl_CtrlReg__7__MASK EQU 0x80
Sensirion_I2C_bI2C_UDB_SyncCtl_CtrlReg__7__POS EQU 7
Sensirion_I2C_bI2C_UDB_SyncCtl_CtrlReg__CONTROL_AUX_CTL_REG EQU CYREG_B0_UDB09_ACTL
Sensirion_I2C_bI2C_UDB_SyncCtl_CtrlReg__CONTROL_REG EQU CYREG_B0_UDB09_CTL
Sensirion_I2C_bI2C_UDB_SyncCtl_CtrlReg__CONTROL_ST_REG EQU CYREG_B0_UDB09_ST_CTL
Sensirion_I2C_bI2C_UDB_SyncCtl_CtrlReg__COUNT_REG EQU CYREG_B0_UDB09_CTL
Sensirion_I2C_bI2C_UDB_SyncCtl_CtrlReg__COUNT_ST_REG EQU CYREG_B0_UDB09_ST_CTL
Sensirion_I2C_bI2C_UDB_SyncCtl_CtrlReg__MASK EQU 0xF6
Sensirion_I2C_bI2C_UDB_SyncCtl_CtrlReg__MASK_CTL_AUX_CTL_REG EQU CYREG_B0_UDB09_MSK_ACTL
Sensirion_I2C_bI2C_UDB_SyncCtl_CtrlReg__PER_CTL_AUX_CTL_REG EQU CYREG_B0_UDB09_MSK_ACTL
Sensirion_I2C_bI2C_UDB_SyncCtl_CtrlReg__PERIOD_REG EQU CYREG_B0_UDB09_MSK

; Sensirion_I2C_I2C_IRQ
Sensirion_I2C_I2C_IRQ__INTC_CLR_EN_REG EQU CYREG_NVIC_CLRENA0
Sensirion_I2C_I2C_IRQ__INTC_CLR_PD_REG EQU CYREG_NVIC_CLRPEND0
Sensirion_I2C_I2C_IRQ__INTC_MASK EQU 0x01
Sensirion_I2C_I2C_IRQ__INTC_NUMBER EQU 0
Sensirion_I2C_I2C_IRQ__INTC_PRIOR_NUM EQU 7
Sensirion_I2C_I2C_IRQ__INTC_PRIOR_REG EQU CYREG_NVIC_PRI_0
Sensirion_I2C_I2C_IRQ__INTC_SET_EN_REG EQU CYREG_NVIC_SETENA0
Sensirion_I2C_I2C_IRQ__INTC_SET_PD_REG EQU CYREG_NVIC_SETPEND0

; Sensirion_I2C_IntClock
Sensirion_I2C_IntClock__CFG0 EQU CYREG_CLKDIST_DCFG0_CFG0
Sensirion_I2C_IntClock__CFG1 EQU CYREG_CLKDIST_DCFG0_CFG1
Sensirion_I2C_IntClock__CFG2 EQU CYREG_CLKDIST_DCFG0_CFG2
Sensirion_I2C_IntClock__CFG2_SRC_SEL_MASK EQU 0x07
Sensirion_I2C_IntClock__INDEX EQU 0x00
Sensirion_I2C_IntClock__PM_ACT_CFG EQU CYREG_PM_ACT_CFG2
Sensirion_I2C_IntClock__PM_ACT_MSK EQU 0x01
Sensirion_I2C_IntClock__PM_STBY_CFG EQU CYREG_PM_STBY_CFG2
Sensirion_I2C_IntClock__PM_STBY_MSK EQU 0x01

; Sensirion_Power
Sensirion_Power__0__INTTYPE EQU CYREG_PICU5_INTTYPE2
Sensirion_Power__0__MASK EQU 0x04
Sensirion_Power__0__PC EQU CYREG_PRT5_PC2
Sensirion_Power__0__PORT EQU 5
Sensirion_Power__0__SHIFT EQU 2
Sensirion_Power__AG EQU CYREG_PRT5_AG
Sensirion_Power__AMUX EQU CYREG_PRT5_AMUX
Sensirion_Power__BIE EQU CYREG_PRT5_BIE
Sensirion_Power__BIT_MASK EQU CYREG_PRT5_BIT_MASK
Sensirion_Power__BYP EQU CYREG_PRT5_BYP
Sensirion_Power__CTL EQU CYREG_PRT5_CTL
Sensirion_Power__DM0 EQU CYREG_PRT5_DM0
Sensirion_Power__DM1 EQU CYREG_PRT5_DM1
Sensirion_Power__DM2 EQU CYREG_PRT5_DM2
Sensirion_Power__DR EQU CYREG_PRT5_DR
Sensirion_Power__INP_DIS EQU CYREG_PRT5_INP_DIS
Sensirion_Power__INTTYPE_BASE EQU CYDEV_PICU_INTTYPE_PICU5_BASE
Sensirion_Power__LCD_COM_SEG EQU CYREG_PRT5_LCD_COM_SEG
Sensirion_Power__LCD_EN EQU CYREG_PRT5_LCD_EN
Sensirion_Power__MASK EQU 0x04
Sensirion_Power__PORT EQU 5
Sensirion_Power__PRT EQU CYREG_PRT5_PRT
Sensirion_Power__PRTDSI__CAPS_SEL EQU CYREG_PRT5_CAPS_SEL
Sensirion_Power__PRTDSI__DBL_SYNC_IN EQU CYREG_PRT5_DBL_SYNC_IN
Sensirion_Power__PRTDSI__OE_SEL0 EQU CYREG_PRT5_OE_SEL0
Sensirion_Power__PRTDSI__OE_SEL1 EQU CYREG_PRT5_OE_SEL1
Sensirion_Power__PRTDSI__OUT_SEL0 EQU CYREG_PRT5_OUT_SEL0
Sensirion_Power__PRTDSI__OUT_SEL1 EQU CYREG_PRT5_OUT_SEL1
Sensirion_Power__PRTDSI__SYNC_OUT EQU CYREG_PRT5_SYNC_OUT
Sensirion_Power__PS EQU CYREG_PRT5_PS
Sensirion_Power__SHIFT EQU 2
Sensirion_Power__SLW EQU CYREG_PRT5_SLW

; Miscellaneous
BCLK__BUS_CLK__HZ EQU 24000000
BCLK__BUS_CLK__KHZ EQU 24000
BCLK__BUS_CLK__MHZ EQU 24
CYDEV_CHIP_DIE_LEOPARD EQU 1
CYDEV_CHIP_DIE_PANTHER EQU 18
CYDEV_CHIP_DIE_PSOC4A EQU 10
CYDEV_CHIP_DIE_PSOC5LP EQU 17
CYDEV_CHIP_DIE_TMA4 EQU 2
CYDEV_CHIP_DIE_UNKNOWN EQU 0
CYDEV_CHIP_FAMILY_PSOC3 EQU 1
CYDEV_CHIP_FAMILY_PSOC4 EQU 2
CYDEV_CHIP_FAMILY_PSOC5 EQU 3
CYDEV_CHIP_FAMILY_UNKNOWN EQU 0
CYDEV_CHIP_FAMILY_USED EQU CYDEV_CHIP_FAMILY_PSOC5
CYDEV_CHIP_JTAG_ID EQU 0x2E123069
CYDEV_CHIP_MEMBER_3A EQU 1
CYDEV_CHIP_MEMBER_4A EQU 10
CYDEV_CHIP_MEMBER_4C EQU 15
CYDEV_CHIP_MEMBER_4D EQU 6
CYDEV_CHIP_MEMBER_4E EQU 4
CYDEV_CHIP_MEMBER_4F EQU 11
CYDEV_CHIP_MEMBER_4G EQU 2
CYDEV_CHIP_MEMBER_4H EQU 9
CYDEV_CHIP_MEMBER_4I EQU 14
CYDEV_CHIP_MEMBER_4J EQU 7
CYDEV_CHIP_MEMBER_4K EQU 8
CYDEV_CHIP_MEMBER_4L EQU 13
CYDEV_CHIP_MEMBER_4M EQU 12
CYDEV_CHIP_MEMBER_4N EQU 5
CYDEV_CHIP_MEMBER_4U EQU 3
CYDEV_CHIP_MEMBER_5A EQU 17
CYDEV_CHIP_MEMBER_5B EQU 16
CYDEV_CHIP_MEMBER_UNKNOWN EQU 0
CYDEV_CHIP_MEMBER_USED EQU CYDEV_CHIP_MEMBER_5B
CYDEV_CHIP_DIE_EXPECT EQU CYDEV_CHIP_MEMBER_USED
CYDEV_CHIP_DIE_ACTUAL EQU CYDEV_CHIP_DIE_EXPECT
CYDEV_CHIP_REV_LEOPARD_ES1 EQU 0
CYDEV_CHIP_REV_LEOPARD_ES2 EQU 1
CYDEV_CHIP_REV_LEOPARD_ES3 EQU 3
CYDEV_CHIP_REV_LEOPARD_PRODUCTION EQU 3
CYDEV_CHIP_REV_PANTHER_ES0 EQU 0
CYDEV_CHIP_REV_PANTHER_ES1 EQU 1
CYDEV_CHIP_REV_PANTHER_PRODUCTION EQU 1
CYDEV_CHIP_REV_PSOC4A_ES0 EQU 17
CYDEV_CHIP_REV_PSOC4A_PRODUCTION EQU 17
CYDEV_CHIP_REV_PSOC5LP_ES0 EQU 0
CYDEV_CHIP_REV_PSOC5LP_PRODUCTION EQU 0
CYDEV_CHIP_REV_TMA4_ES EQU 17
CYDEV_CHIP_REV_TMA4_ES2 EQU 33
CYDEV_CHIP_REV_TMA4_PRODUCTION EQU 17
CYDEV_CHIP_REVISION_3A_ES1 EQU 0
CYDEV_CHIP_REVISION_3A_ES2 EQU 1
CYDEV_CHIP_REVISION_3A_ES3 EQU 3
CYDEV_CHIP_REVISION_3A_PRODUCTION EQU 3
CYDEV_CHIP_REVISION_4A_ES0 EQU 17
CYDEV_CHIP_REVISION_4A_PRODUCTION EQU 17
CYDEV_CHIP_REVISION_4C_PRODUCTION EQU 0
CYDEV_CHIP_REVISION_4D_PRODUCTION EQU 0
CYDEV_CHIP_REVISION_4E_PRODUCTION EQU 0
CYDEV_CHIP_REVISION_4F_PRODUCTION EQU 0
CYDEV_CHIP_REVISION_4F_PRODUCTION_256DMA EQU 0
CYDEV_CHIP_REVISION_4F_PRODUCTION_256K EQU 0
CYDEV_CHIP_REVISION_4G_ES EQU 17
CYDEV_CHIP_REVISION_4G_ES2 EQU 33
CYDEV_CHIP_REVISION_4G_PRODUCTION EQU 17
CYDEV_CHIP_REVISION_4H_PRODUCTION EQU 0
CYDEV_CHIP_REVISION_4I_PRODUCTION EQU 0
CYDEV_CHIP_REVISION_4J_PRODUCTION EQU 0
CYDEV_CHIP_REVISION_4K_PRODUCTION EQU 0
CYDEV_CHIP_REVISION_4L_PRODUCTION EQU 0
CYDEV_CHIP_REVISION_4M_PRODUCTION EQU 0
CYDEV_CHIP_REVISION_4N_PRODUCTION EQU 0
CYDEV_CHIP_REVISION_4U_PRODUCTION EQU 0
CYDEV_CHIP_REVISION_5A_ES0 EQU 0
CYDEV_CHIP_REVISION_5A_ES1 EQU 1
CYDEV_CHIP_REVISION_5A_PRODUCTION EQU 1
CYDEV_CHIP_REVISION_5B_ES0 EQU 0
CYDEV_CHIP_REVISION_5B_PRODUCTION EQU 0
CYDEV_CHIP_REVISION_USED EQU CYDEV_CHIP_REVISION_5B_PRODUCTION
CYDEV_CHIP_REV_EXPECT EQU CYDEV_CHIP_REVISION_USED
CYDEV_CONFIG_FASTBOOT_ENABLED EQU 1
CYDEV_CONFIG_UNUSED_IO_AllowButWarn EQU 0
CYDEV_CONFIG_UNUSED_IO EQU CYDEV_CONFIG_UNUSED_IO_AllowButWarn
CYDEV_CONFIG_UNUSED_IO_AllowWithInfo EQU 1
CYDEV_CONFIG_UNUSED_IO_Disallowed EQU 2
CYDEV_CONFIGURATION_COMPRESSED EQU 1
CYDEV_CONFIGURATION_DMA EQU 0
CYDEV_CONFIGURATION_ECC EQU 1
CYDEV_CONFIGURATION_IMOENABLED EQU CYDEV_CONFIG_FASTBOOT_ENABLED
CYDEV_CONFIGURATION_MODE_COMPRESSED EQU 0
CYDEV_CONFIGURATION_MODE EQU CYDEV_CONFIGURATION_MODE_COMPRESSED
CYDEV_CONFIGURATION_MODE_DMA EQU 2
CYDEV_CONFIGURATION_MODE_UNCOMPRESSED EQU 1
CYDEV_DEBUG_ENABLE_MASK EQU 0x20
CYDEV_DEBUG_ENABLE_REGISTER EQU CYREG_MLOGIC_DEBUG
CYDEV_DEBUGGING_DPS_Disable EQU 3
CYDEV_DEBUGGING_DPS_JTAG_4 EQU 1
CYDEV_DEBUGGING_DPS_JTAG_5 EQU 0
CYDEV_DEBUGGING_DPS_SWD EQU 2
CYDEV_DEBUGGING_DPS_SWD_SWV EQU 6
CYDEV_DEBUGGING_DPS EQU CYDEV_DEBUGGING_DPS_SWD_SWV
CYDEV_DEBUGGING_ENABLE EQU 1
CYDEV_DEBUGGING_XRES EQU 0
CYDEV_DMA_CHANNELS_AVAILABLE EQU 24
CYDEV_ECC_ENABLE EQU 0
CYDEV_HEAP_SIZE EQU 0x80
CYDEV_INSTRUCT_CACHE_ENABLED EQU 1
CYDEV_INTR_RISING EQU 0x00000001
CYDEV_IS_EXPORTING_CODE EQU 0
CYDEV_IS_IMPORTING_CODE EQU 0
CYDEV_PROJ_TYPE EQU 0
CYDEV_PROJ_TYPE_BOOTLOADER EQU 1
CYDEV_PROJ_TYPE_LAUNCHER EQU 5
CYDEV_PROJ_TYPE_LOADABLE EQU 2
CYDEV_PROJ_TYPE_LOADABLEANDBOOTLOADER EQU 4
CYDEV_PROJ_TYPE_MULTIAPPBOOTLOADER EQU 3
CYDEV_PROJ_TYPE_STANDARD EQU 0
CYDEV_PROTECTION_ENABLE EQU 0
CYDEV_STACK_SIZE EQU 0x0800
CYDEV_USE_BUNDLED_CMSIS EQU 1
CYDEV_VARIABLE_VDDA EQU 0
CYDEV_VDDA_MV EQU 5000
CYDEV_VDDD_MV EQU 5000
CYDEV_VDDIO0_MV EQU 5000
CYDEV_VDDIO1_MV EQU 5000
CYDEV_VDDIO2_MV EQU 5000
CYDEV_VDDIO3_MV EQU 5000
CYDEV_VIO0_MV EQU 5000
CYDEV_VIO1_MV EQU 5000
CYDEV_VIO2_MV EQU 5000
CYDEV_VIO3_MV EQU 5000
CYIPBLOCK_ARM_CM3_VERSION EQU 0
CYIPBLOCK_P3_ANAIF_VERSION EQU 0
CYIPBLOCK_P3_CAN_VERSION EQU 0
CYIPBLOCK_P3_CAPSENSE_VERSION EQU 0
CYIPBLOCK_P3_COMP_VERSION EQU 0
CYIPBLOCK_P3_DECIMATOR_VERSION EQU 0
CYIPBLOCK_P3_DFB_VERSION EQU 0
CYIPBLOCK_P3_DMA_VERSION EQU 0
CYIPBLOCK_P3_DRQ_VERSION EQU 0
CYIPBLOCK_P3_DSM_VERSION EQU 0
CYIPBLOCK_P3_EMIF_VERSION EQU 0
CYIPBLOCK_P3_I2C_VERSION EQU 0
CYIPBLOCK_P3_LCD_VERSION EQU 0
CYIPBLOCK_P3_LPF_VERSION EQU 0
CYIPBLOCK_P3_OPAMP_VERSION EQU 0
CYIPBLOCK_P3_PM_VERSION EQU 0
CYIPBLOCK_P3_SCCT_VERSION EQU 0
CYIPBLOCK_P3_TIMER_VERSION EQU 0
CYIPBLOCK_P3_USB_VERSION EQU 0
CYIPBLOCK_P3_VIDAC_VERSION EQU 0
CYIPBLOCK_P3_VREF_VERSION EQU 0
CYIPBLOCK_S8_GPIO_VERSION EQU 0
CYIPBLOCK_S8_IRQ_VERSION EQU 0
CYIPBLOCK_S8_SAR_VERSION EQU 0
CYIPBLOCK_S8_SIO_VERSION EQU 0
CYIPBLOCK_S8_UDB_VERSION EQU 0
DMA_CHANNELS_USED__MASK0 EQU 0x00000000
CYDEV_BOOTLOADER_ENABLE EQU 0
    ENDIF
    END
