    IF :LNOT::DEF:INCLUDED_CYFITTERRV_INC
INCLUDED_CYFITTERRV_INC EQU 1
    GET cydevicerv.inc
    GET cydevicerv_trm.inc

; ADC_DelSig_1_Ext_CP_Clk
ADC_DelSig_1_Ext_CP_Clk__CFG0 EQU CYREG_CLKDIST_DCFG0_CFG0
ADC_DelSig_1_Ext_CP_Clk__CFG1 EQU CYREG_CLKDIST_DCFG0_CFG1
ADC_DelSig_1_Ext_CP_Clk__CFG2 EQU CYREG_CLKDIST_DCFG0_CFG2
ADC_DelSig_1_Ext_CP_Clk__CFG2_SRC_SEL_MASK EQU 0x07
ADC_DelSig_1_Ext_CP_Clk__INDEX EQU 0x00
ADC_DelSig_1_Ext_CP_Clk__PM_ACT_CFG EQU CYREG_PM_ACT_CFG2
ADC_DelSig_1_Ext_CP_Clk__PM_ACT_MSK EQU 0x01
ADC_DelSig_1_Ext_CP_Clk__PM_STBY_CFG EQU CYREG_PM_STBY_CFG2
ADC_DelSig_1_Ext_CP_Clk__PM_STBY_MSK EQU 0x01

; ADC_DelSig_1_theACLK
ADC_DelSig_1_theACLK__CFG0 EQU CYREG_CLKDIST_ACFG0_CFG0
ADC_DelSig_1_theACLK__CFG1 EQU CYREG_CLKDIST_ACFG0_CFG1
ADC_DelSig_1_theACLK__CFG2 EQU CYREG_CLKDIST_ACFG0_CFG2
ADC_DelSig_1_theACLK__CFG2_SRC_SEL_MASK EQU 0x07
ADC_DelSig_1_theACLK__CFG3 EQU CYREG_CLKDIST_ACFG0_CFG3
ADC_DelSig_1_theACLK__CFG3_PHASE_DLY_MASK EQU 0x0F
ADC_DelSig_1_theACLK__INDEX EQU 0x00
ADC_DelSig_1_theACLK__PM_ACT_CFG EQU CYREG_PM_ACT_CFG1
ADC_DelSig_1_theACLK__PM_ACT_MSK EQU 0x01
ADC_DelSig_1_theACLK__PM_STBY_CFG EQU CYREG_PM_STBY_CFG1
ADC_DelSig_1_theACLK__PM_STBY_MSK EQU 0x01

; ADC_DelSig_1_DSM4
ADC_DelSig_1_DSM4__BUF0 EQU CYREG_DSM0_BUF0
ADC_DelSig_1_DSM4__BUF1 EQU CYREG_DSM0_BUF1
ADC_DelSig_1_DSM4__BUF2 EQU CYREG_DSM0_BUF2
ADC_DelSig_1_DSM4__BUF3 EQU CYREG_DSM0_BUF3
ADC_DelSig_1_DSM4__CLK EQU CYREG_DSM0_CLK
ADC_DelSig_1_DSM4__CR0 EQU CYREG_DSM0_CR0
ADC_DelSig_1_DSM4__CR1 EQU CYREG_DSM0_CR1
ADC_DelSig_1_DSM4__CR10 EQU CYREG_DSM0_CR10
ADC_DelSig_1_DSM4__CR11 EQU CYREG_DSM0_CR11
ADC_DelSig_1_DSM4__CR12 EQU CYREG_DSM0_CR12
ADC_DelSig_1_DSM4__CR13 EQU CYREG_DSM0_CR13
ADC_DelSig_1_DSM4__CR14 EQU CYREG_DSM0_CR14
ADC_DelSig_1_DSM4__CR15 EQU CYREG_DSM0_CR15
ADC_DelSig_1_DSM4__CR16 EQU CYREG_DSM0_CR16
ADC_DelSig_1_DSM4__CR17 EQU CYREG_DSM0_CR17
ADC_DelSig_1_DSM4__CR2 EQU CYREG_DSM0_CR2
ADC_DelSig_1_DSM4__CR3 EQU CYREG_DSM0_CR3
ADC_DelSig_1_DSM4__CR4 EQU CYREG_DSM0_CR4
ADC_DelSig_1_DSM4__CR5 EQU CYREG_DSM0_CR5
ADC_DelSig_1_DSM4__CR6 EQU CYREG_DSM0_CR6
ADC_DelSig_1_DSM4__CR7 EQU CYREG_DSM0_CR7
ADC_DelSig_1_DSM4__CR8 EQU CYREG_DSM0_CR8
ADC_DelSig_1_DSM4__CR9 EQU CYREG_DSM0_CR9
ADC_DelSig_1_DSM4__DEM0 EQU CYREG_DSM0_DEM0
ADC_DelSig_1_DSM4__DEM1 EQU CYREG_DSM0_DEM1
ADC_DelSig_1_DSM4__MISC EQU CYREG_DSM0_MISC
ADC_DelSig_1_DSM4__OUT0 EQU CYREG_DSM0_OUT0
ADC_DelSig_1_DSM4__OUT1 EQU CYREG_DSM0_OUT1
ADC_DelSig_1_DSM4__REF0 EQU CYREG_DSM0_REF0
ADC_DelSig_1_DSM4__REF1 EQU CYREG_DSM0_REF1
ADC_DelSig_1_DSM4__REF2 EQU CYREG_DSM0_REF2
ADC_DelSig_1_DSM4__REF3 EQU CYREG_DSM0_REF3
ADC_DelSig_1_DSM4__RSVD1 EQU CYREG_DSM0_RSVD1
ADC_DelSig_1_DSM4__SW0 EQU CYREG_DSM0_SW0
ADC_DelSig_1_DSM4__SW2 EQU CYREG_DSM0_SW2
ADC_DelSig_1_DSM4__SW3 EQU CYREG_DSM0_SW3
ADC_DelSig_1_DSM4__SW4 EQU CYREG_DSM0_SW4
ADC_DelSig_1_DSM4__SW6 EQU CYREG_DSM0_SW6
ADC_DelSig_1_DSM4__TR0 EQU CYREG_NPUMP_DSM_TR0
ADC_DelSig_1_DSM4__TST0 EQU CYREG_DSM0_TST0
ADC_DelSig_1_DSM4__TST1 EQU CYREG_DSM0_TST1

; ADC_DelSig_1_DEC
ADC_DelSig_1_DEC__COHER EQU CYREG_DEC_COHER
ADC_DelSig_1_DEC__CR EQU CYREG_DEC_CR
ADC_DelSig_1_DEC__DR1 EQU CYREG_DEC_DR1
ADC_DelSig_1_DEC__DR2 EQU CYREG_DEC_DR2
ADC_DelSig_1_DEC__DR2H EQU CYREG_DEC_DR2H
ADC_DelSig_1_DEC__GCOR EQU CYREG_DEC_GCOR
ADC_DelSig_1_DEC__GCORH EQU CYREG_DEC_GCORH
ADC_DelSig_1_DEC__GVAL EQU CYREG_DEC_GVAL
ADC_DelSig_1_DEC__OCOR EQU CYREG_DEC_OCOR
ADC_DelSig_1_DEC__OCORH EQU CYREG_DEC_OCORH
ADC_DelSig_1_DEC__OCORM EQU CYREG_DEC_OCORM
ADC_DelSig_1_DEC__OUTSAMP EQU CYREG_DEC_OUTSAMP
ADC_DelSig_1_DEC__OUTSAMPH EQU CYREG_DEC_OUTSAMPH
ADC_DelSig_1_DEC__OUTSAMPM EQU CYREG_DEC_OUTSAMPM
ADC_DelSig_1_DEC__OUTSAMPS EQU CYREG_DEC_OUTSAMPS
ADC_DelSig_1_DEC__PM_ACT_CFG EQU CYREG_PM_ACT_CFG10
ADC_DelSig_1_DEC__PM_ACT_MSK EQU 0x01
ADC_DelSig_1_DEC__PM_STBY_CFG EQU CYREG_PM_STBY_CFG10
ADC_DelSig_1_DEC__PM_STBY_MSK EQU 0x01
ADC_DelSig_1_DEC__SHIFT1 EQU CYREG_DEC_SHIFT1
ADC_DelSig_1_DEC__SHIFT2 EQU CYREG_DEC_SHIFT2
ADC_DelSig_1_DEC__SR EQU CYREG_DEC_SR
ADC_DelSig_1_DEC__TRIM__M1 EQU CYREG_FLSHID_CUST_TABLES_DEC_M1
ADC_DelSig_1_DEC__TRIM__M2 EQU CYREG_FLSHID_CUST_TABLES_DEC_M2
ADC_DelSig_1_DEC__TRIM__M3 EQU CYREG_FLSHID_CUST_TABLES_DEC_M3
ADC_DelSig_1_DEC__TRIM__M4 EQU CYREG_FLSHID_CUST_TABLES_DEC_M4
ADC_DelSig_1_DEC__TRIM__M5 EQU CYREG_FLSHID_CUST_TABLES_DEC_M5
ADC_DelSig_1_DEC__TRIM__M6 EQU CYREG_FLSHID_CUST_TABLES_DEC_M6
ADC_DelSig_1_DEC__TRIM__M7 EQU CYREG_FLSHID_CUST_TABLES_DEC_M7
ADC_DelSig_1_DEC__TRIM__M8 EQU CYREG_FLSHID_CUST_TABLES_DEC_M8

; ADC_DelSig_1_IRQ
ADC_DelSig_1_IRQ__INTC_CLR_EN_REG EQU CYREG_NVIC_CLRENA0
ADC_DelSig_1_IRQ__INTC_CLR_PD_REG EQU CYREG_NVIC_CLRPEND0
ADC_DelSig_1_IRQ__INTC_MASK EQU 0x20000000
ADC_DelSig_1_IRQ__INTC_NUMBER EQU 29
ADC_DelSig_1_IRQ__INTC_PRIOR_NUM EQU 7
ADC_DelSig_1_IRQ__INTC_PRIOR_REG EQU CYREG_NVIC_PRI_29
ADC_DelSig_1_IRQ__INTC_SET_EN_REG EQU CYREG_NVIC_SETENA0
ADC_DelSig_1_IRQ__INTC_SET_PD_REG EQU CYREG_NVIC_SETPEND0

; Sample_Hold_1_SC
Sample_Hold_1_SC__BST EQU CYREG_SC0_BST
Sample_Hold_1_SC__CLK EQU CYREG_SC0_CLK
Sample_Hold_1_SC__CMPINV EQU CYREG_SC_CMPINV
Sample_Hold_1_SC__CPTR EQU CYREG_SC_CPTR
Sample_Hold_1_SC__CR0 EQU CYREG_SC0_CR0
Sample_Hold_1_SC__CR1 EQU CYREG_SC0_CR1
Sample_Hold_1_SC__CR2 EQU CYREG_SC0_CR2
Sample_Hold_1_SC__MSK EQU CYREG_SC_MSK
Sample_Hold_1_SC__PM_ACT_CFG EQU CYREG_PM_ACT_CFG9
Sample_Hold_1_SC__PM_ACT_MSK EQU 0x01
Sample_Hold_1_SC__PM_STBY_CFG EQU CYREG_PM_STBY_CFG9
Sample_Hold_1_SC__PM_STBY_MSK EQU 0x01
Sample_Hold_1_SC__SR EQU CYREG_SC_SR
Sample_Hold_1_SC__SW0 EQU CYREG_SC0_SW0
Sample_Hold_1_SC__SW10 EQU CYREG_SC0_SW10
Sample_Hold_1_SC__SW2 EQU CYREG_SC0_SW2
Sample_Hold_1_SC__SW3 EQU CYREG_SC0_SW3
Sample_Hold_1_SC__SW4 EQU CYREG_SC0_SW4
Sample_Hold_1_SC__SW6 EQU CYREG_SC0_SW6
Sample_Hold_1_SC__SW7 EQU CYREG_SC0_SW7
Sample_Hold_1_SC__SW8 EQU CYREG_SC0_SW8
Sample_Hold_1_SC__WRK1 EQU CYREG_SC_WRK1

; Sample_Hold_2_SC
Sample_Hold_2_SC__BST EQU CYREG_SC2_BST
Sample_Hold_2_SC__CLK EQU CYREG_SC2_CLK
Sample_Hold_2_SC__CMPINV EQU CYREG_SC_CMPINV
Sample_Hold_2_SC__CPTR EQU CYREG_SC_CPTR
Sample_Hold_2_SC__CR0 EQU CYREG_SC2_CR0
Sample_Hold_2_SC__CR1 EQU CYREG_SC2_CR1
Sample_Hold_2_SC__CR2 EQU CYREG_SC2_CR2
Sample_Hold_2_SC__MSK EQU CYREG_SC_MSK
Sample_Hold_2_SC__PM_ACT_CFG EQU CYREG_PM_ACT_CFG9
Sample_Hold_2_SC__PM_ACT_MSK EQU 0x04
Sample_Hold_2_SC__PM_STBY_CFG EQU CYREG_PM_STBY_CFG9
Sample_Hold_2_SC__PM_STBY_MSK EQU 0x04
Sample_Hold_2_SC__SR EQU CYREG_SC_SR
Sample_Hold_2_SC__SW0 EQU CYREG_SC2_SW0
Sample_Hold_2_SC__SW10 EQU CYREG_SC2_SW10
Sample_Hold_2_SC__SW2 EQU CYREG_SC2_SW2
Sample_Hold_2_SC__SW3 EQU CYREG_SC2_SW3
Sample_Hold_2_SC__SW4 EQU CYREG_SC2_SW4
Sample_Hold_2_SC__SW6 EQU CYREG_SC2_SW6
Sample_Hold_2_SC__SW7 EQU CYREG_SC2_SW7
Sample_Hold_2_SC__SW8 EQU CYREG_SC2_SW8
Sample_Hold_2_SC__WRK1 EQU CYREG_SC_WRK1

; Sample_Hold_3_SC
Sample_Hold_3_SC__BST EQU CYREG_SC1_BST
Sample_Hold_3_SC__CLK EQU CYREG_SC1_CLK
Sample_Hold_3_SC__CMPINV EQU CYREG_SC_CMPINV
Sample_Hold_3_SC__CPTR EQU CYREG_SC_CPTR
Sample_Hold_3_SC__CR0 EQU CYREG_SC1_CR0
Sample_Hold_3_SC__CR1 EQU CYREG_SC1_CR1
Sample_Hold_3_SC__CR2 EQU CYREG_SC1_CR2
Sample_Hold_3_SC__MSK EQU CYREG_SC_MSK
Sample_Hold_3_SC__PM_ACT_CFG EQU CYREG_PM_ACT_CFG9
Sample_Hold_3_SC__PM_ACT_MSK EQU 0x02
Sample_Hold_3_SC__PM_STBY_CFG EQU CYREG_PM_STBY_CFG9
Sample_Hold_3_SC__PM_STBY_MSK EQU 0x02
Sample_Hold_3_SC__SR EQU CYREG_SC_SR
Sample_Hold_3_SC__SW0 EQU CYREG_SC1_SW0
Sample_Hold_3_SC__SW10 EQU CYREG_SC1_SW10
Sample_Hold_3_SC__SW2 EQU CYREG_SC1_SW2
Sample_Hold_3_SC__SW3 EQU CYREG_SC1_SW3
Sample_Hold_3_SC__SW4 EQU CYREG_SC1_SW4
Sample_Hold_3_SC__SW6 EQU CYREG_SC1_SW6
Sample_Hold_3_SC__SW7 EQU CYREG_SC1_SW7
Sample_Hold_3_SC__SW8 EQU CYREG_SC1_SW8
Sample_Hold_3_SC__WRK1 EQU CYREG_SC_WRK1

; Comp_1_ctComp
Comp_1_ctComp__CLK EQU CYREG_CMP2_CLK
Comp_1_ctComp__CMP_MASK EQU 0x04
Comp_1_ctComp__CMP_NUMBER EQU 2
Comp_1_ctComp__CR EQU CYREG_CMP2_CR
Comp_1_ctComp__LUT__CR EQU CYREG_LUT2_CR
Comp_1_ctComp__LUT__MSK EQU CYREG_LUT_MSK
Comp_1_ctComp__LUT__MSK_MASK EQU 0x04
Comp_1_ctComp__LUT__MSK_SHIFT EQU 2
Comp_1_ctComp__LUT__MX EQU CYREG_LUT2_MX
Comp_1_ctComp__LUT__SR EQU CYREG_LUT_SR
Comp_1_ctComp__LUT__SR_MASK EQU 0x04
Comp_1_ctComp__LUT__SR_SHIFT EQU 2
Comp_1_ctComp__PM_ACT_CFG EQU CYREG_PM_ACT_CFG7
Comp_1_ctComp__PM_ACT_MSK EQU 0x04
Comp_1_ctComp__PM_STBY_CFG EQU CYREG_PM_STBY_CFG7
Comp_1_ctComp__PM_STBY_MSK EQU 0x04
Comp_1_ctComp__SW0 EQU CYREG_CMP2_SW0
Comp_1_ctComp__SW2 EQU CYREG_CMP2_SW2
Comp_1_ctComp__SW3 EQU CYREG_CMP2_SW3
Comp_1_ctComp__SW4 EQU CYREG_CMP2_SW4
Comp_1_ctComp__SW6 EQU CYREG_CMP2_SW6
Comp_1_ctComp__TR0 EQU CYREG_CMP2_TR0
Comp_1_ctComp__TR1 EQU CYREG_CMP2_TR1
Comp_1_ctComp__TRIM__TR0 EQU CYREG_FLSHID_MFG_CFG_CMP2_TR0
Comp_1_ctComp__TRIM__TR0_HS EQU CYREG_FLSHID_CUST_TABLES_CMP2_TR0_HS
Comp_1_ctComp__TRIM__TR1 EQU CYREG_FLSHID_MFG_CFG_CMP2_TR1
Comp_1_ctComp__TRIM__TR1_HS EQU CYREG_FLSHID_CUST_TABLES_CMP2_TR1_HS
Comp_1_ctComp__WRK EQU CYREG_CMP_WRK
Comp_1_ctComp__WRK_MASK EQU 0x04
Comp_1_ctComp__WRK_SHIFT EQU 2

; Comp_2_ctComp
Comp_2_ctComp__CLK EQU CYREG_CMP3_CLK
Comp_2_ctComp__CMP_MASK EQU 0x08
Comp_2_ctComp__CMP_NUMBER EQU 3
Comp_2_ctComp__CR EQU CYREG_CMP3_CR
Comp_2_ctComp__LUT__CR EQU CYREG_LUT3_CR
Comp_2_ctComp__LUT__MSK EQU CYREG_LUT_MSK
Comp_2_ctComp__LUT__MSK_MASK EQU 0x08
Comp_2_ctComp__LUT__MSK_SHIFT EQU 3
Comp_2_ctComp__LUT__MX EQU CYREG_LUT3_MX
Comp_2_ctComp__LUT__SR EQU CYREG_LUT_SR
Comp_2_ctComp__LUT__SR_MASK EQU 0x08
Comp_2_ctComp__LUT__SR_SHIFT EQU 3
Comp_2_ctComp__PM_ACT_CFG EQU CYREG_PM_ACT_CFG7
Comp_2_ctComp__PM_ACT_MSK EQU 0x08
Comp_2_ctComp__PM_STBY_CFG EQU CYREG_PM_STBY_CFG7
Comp_2_ctComp__PM_STBY_MSK EQU 0x08
Comp_2_ctComp__SW0 EQU CYREG_CMP3_SW0
Comp_2_ctComp__SW2 EQU CYREG_CMP3_SW2
Comp_2_ctComp__SW3 EQU CYREG_CMP3_SW3
Comp_2_ctComp__SW4 EQU CYREG_CMP3_SW4
Comp_2_ctComp__SW6 EQU CYREG_CMP3_SW6
Comp_2_ctComp__TR0 EQU CYREG_CMP3_TR0
Comp_2_ctComp__TR1 EQU CYREG_CMP3_TR1
Comp_2_ctComp__TRIM__TR0 EQU CYREG_FLSHID_MFG_CFG_CMP3_TR0
Comp_2_ctComp__TRIM__TR0_HS EQU CYREG_FLSHID_CUST_TABLES_CMP3_TR0_HS
Comp_2_ctComp__TRIM__TR1 EQU CYREG_FLSHID_MFG_CFG_CMP3_TR1
Comp_2_ctComp__TRIM__TR1_HS EQU CYREG_FLSHID_CUST_TABLES_CMP3_TR1_HS
Comp_2_ctComp__WRK EQU CYREG_CMP_WRK
Comp_2_ctComp__WRK_MASK EQU 0x08
Comp_2_ctComp__WRK_SHIFT EQU 3

; Comp_3_ctComp
Comp_3_ctComp__CLK EQU CYREG_CMP1_CLK
Comp_3_ctComp__CMP_MASK EQU 0x02
Comp_3_ctComp__CMP_NUMBER EQU 1
Comp_3_ctComp__CR EQU CYREG_CMP1_CR
Comp_3_ctComp__LUT__CR EQU CYREG_LUT1_CR
Comp_3_ctComp__LUT__MSK EQU CYREG_LUT_MSK
Comp_3_ctComp__LUT__MSK_MASK EQU 0x02
Comp_3_ctComp__LUT__MSK_SHIFT EQU 1
Comp_3_ctComp__LUT__MX EQU CYREG_LUT1_MX
Comp_3_ctComp__LUT__SR EQU CYREG_LUT_SR
Comp_3_ctComp__LUT__SR_MASK EQU 0x02
Comp_3_ctComp__LUT__SR_SHIFT EQU 1
Comp_3_ctComp__PM_ACT_CFG EQU CYREG_PM_ACT_CFG7
Comp_3_ctComp__PM_ACT_MSK EQU 0x02
Comp_3_ctComp__PM_STBY_CFG EQU CYREG_PM_STBY_CFG7
Comp_3_ctComp__PM_STBY_MSK EQU 0x02
Comp_3_ctComp__SW0 EQU CYREG_CMP1_SW0
Comp_3_ctComp__SW2 EQU CYREG_CMP1_SW2
Comp_3_ctComp__SW3 EQU CYREG_CMP1_SW3
Comp_3_ctComp__SW4 EQU CYREG_CMP1_SW4
Comp_3_ctComp__SW6 EQU CYREG_CMP1_SW6
Comp_3_ctComp__TR0 EQU CYREG_CMP1_TR0
Comp_3_ctComp__TR1 EQU CYREG_CMP1_TR1
Comp_3_ctComp__TRIM__TR0 EQU CYREG_FLSHID_MFG_CFG_CMP1_TR0
Comp_3_ctComp__TRIM__TR0_HS EQU CYREG_FLSHID_CUST_TABLES_CMP1_TR0_HS
Comp_3_ctComp__TRIM__TR1 EQU CYREG_FLSHID_MFG_CFG_CMP1_TR1
Comp_3_ctComp__TRIM__TR1_HS EQU CYREG_FLSHID_CUST_TABLES_CMP1_TR1_HS
Comp_3_ctComp__WRK EQU CYREG_CMP_WRK
Comp_3_ctComp__WRK_MASK EQU 0x02
Comp_3_ctComp__WRK_SHIFT EQU 1

; Cond_PWM_out
Cond_PWM_out__0__MASK EQU 0x40
Cond_PWM_out__0__PC EQU CYREG_PRT0_PC6
Cond_PWM_out__0__PORT EQU 0
Cond_PWM_out__0__SHIFT EQU 6
Cond_PWM_out__AG EQU CYREG_PRT0_AG
Cond_PWM_out__AMUX EQU CYREG_PRT0_AMUX
Cond_PWM_out__BIE EQU CYREG_PRT0_BIE
Cond_PWM_out__BIT_MASK EQU CYREG_PRT0_BIT_MASK
Cond_PWM_out__BYP EQU CYREG_PRT0_BYP
Cond_PWM_out__CTL EQU CYREG_PRT0_CTL
Cond_PWM_out__DM0 EQU CYREG_PRT0_DM0
Cond_PWM_out__DM1 EQU CYREG_PRT0_DM1
Cond_PWM_out__DM2 EQU CYREG_PRT0_DM2
Cond_PWM_out__DR EQU CYREG_PRT0_DR
Cond_PWM_out__INP_DIS EQU CYREG_PRT0_INP_DIS
Cond_PWM_out__LCD_COM_SEG EQU CYREG_PRT0_LCD_COM_SEG
Cond_PWM_out__LCD_EN EQU CYREG_PRT0_LCD_EN
Cond_PWM_out__MASK EQU 0x40
Cond_PWM_out__PORT EQU 0
Cond_PWM_out__PRT EQU CYREG_PRT0_PRT
Cond_PWM_out__PRTDSI__CAPS_SEL EQU CYREG_PRT0_CAPS_SEL
Cond_PWM_out__PRTDSI__DBL_SYNC_IN EQU CYREG_PRT0_DBL_SYNC_IN
Cond_PWM_out__PRTDSI__OE_SEL0 EQU CYREG_PRT0_OE_SEL0
Cond_PWM_out__PRTDSI__OE_SEL1 EQU CYREG_PRT0_OE_SEL1
Cond_PWM_out__PRTDSI__OUT_SEL0 EQU CYREG_PRT0_OUT_SEL0
Cond_PWM_out__PRTDSI__OUT_SEL1 EQU CYREG_PRT0_OUT_SEL1
Cond_PWM_out__PRTDSI__SYNC_OUT EQU CYREG_PRT0_SYNC_OUT
Cond_PWM_out__PS EQU CYREG_PRT0_PS
Cond_PWM_out__SHIFT EQU 6
Cond_PWM_out__SLW EQU CYREG_PRT0_SLW

; PWM_1_PWMUDB
PWM_1_PWMUDB_sCTRLReg_SyncCtl_ctrlreg__16BIT_CONTROL_AUX_CTL_REG EQU CYREG_B0_UDB03_04_ACTL
PWM_1_PWMUDB_sCTRLReg_SyncCtl_ctrlreg__16BIT_CONTROL_CONTROL_REG EQU CYREG_B0_UDB03_04_CTL
PWM_1_PWMUDB_sCTRLReg_SyncCtl_ctrlreg__16BIT_CONTROL_COUNT_REG EQU CYREG_B0_UDB03_04_CTL
PWM_1_PWMUDB_sCTRLReg_SyncCtl_ctrlreg__16BIT_COUNT_CONTROL_REG EQU CYREG_B0_UDB03_04_CTL
PWM_1_PWMUDB_sCTRLReg_SyncCtl_ctrlreg__16BIT_COUNT_COUNT_REG EQU CYREG_B0_UDB03_04_CTL
PWM_1_PWMUDB_sCTRLReg_SyncCtl_ctrlreg__16BIT_MASK_MASK_REG EQU CYREG_B0_UDB03_04_MSK
PWM_1_PWMUDB_sCTRLReg_SyncCtl_ctrlreg__16BIT_MASK_PERIOD_REG EQU CYREG_B0_UDB03_04_MSK
PWM_1_PWMUDB_sCTRLReg_SyncCtl_ctrlreg__16BIT_PERIOD_MASK_REG EQU CYREG_B0_UDB03_04_MSK
PWM_1_PWMUDB_sCTRLReg_SyncCtl_ctrlreg__16BIT_PERIOD_PERIOD_REG EQU CYREG_B0_UDB03_04_MSK
PWM_1_PWMUDB_sCTRLReg_SyncCtl_ctrlreg__7__MASK EQU 0x80
PWM_1_PWMUDB_sCTRLReg_SyncCtl_ctrlreg__7__POS EQU 7
PWM_1_PWMUDB_sCTRLReg_SyncCtl_ctrlreg__CONTROL_AUX_CTL_REG EQU CYREG_B0_UDB03_ACTL
PWM_1_PWMUDB_sCTRLReg_SyncCtl_ctrlreg__CONTROL_REG EQU CYREG_B0_UDB03_CTL
PWM_1_PWMUDB_sCTRLReg_SyncCtl_ctrlreg__CONTROL_ST_REG EQU CYREG_B0_UDB03_ST_CTL
PWM_1_PWMUDB_sCTRLReg_SyncCtl_ctrlreg__COUNT_REG EQU CYREG_B0_UDB03_CTL
PWM_1_PWMUDB_sCTRLReg_SyncCtl_ctrlreg__COUNT_ST_REG EQU CYREG_B0_UDB03_ST_CTL
PWM_1_PWMUDB_sCTRLReg_SyncCtl_ctrlreg__MASK EQU 0x80
PWM_1_PWMUDB_sCTRLReg_SyncCtl_ctrlreg__MASK_CTL_AUX_CTL_REG EQU CYREG_B0_UDB03_MSK_ACTL
PWM_1_PWMUDB_sCTRLReg_SyncCtl_ctrlreg__PERIOD_REG EQU CYREG_B0_UDB03_MSK
PWM_1_PWMUDB_sCTRLReg_SyncCtl_ctrlreg__PER_CTL_AUX_CTL_REG EQU CYREG_B0_UDB03_MSK_ACTL
PWM_1_PWMUDB_sP8_pwmdp_u0__16BIT_A0_REG EQU CYREG_B0_UDB03_04_A0
PWM_1_PWMUDB_sP8_pwmdp_u0__16BIT_A1_REG EQU CYREG_B0_UDB03_04_A1
PWM_1_PWMUDB_sP8_pwmdp_u0__16BIT_D0_REG EQU CYREG_B0_UDB03_04_D0
PWM_1_PWMUDB_sP8_pwmdp_u0__16BIT_D1_REG EQU CYREG_B0_UDB03_04_D1
PWM_1_PWMUDB_sP8_pwmdp_u0__16BIT_DP_AUX_CTL_REG EQU CYREG_B0_UDB03_04_ACTL
PWM_1_PWMUDB_sP8_pwmdp_u0__16BIT_F0_REG EQU CYREG_B0_UDB03_04_F0
PWM_1_PWMUDB_sP8_pwmdp_u0__16BIT_F1_REG EQU CYREG_B0_UDB03_04_F1
PWM_1_PWMUDB_sP8_pwmdp_u0__A0_A1_REG EQU CYREG_B0_UDB03_A0_A1
PWM_1_PWMUDB_sP8_pwmdp_u0__A0_REG EQU CYREG_B0_UDB03_A0
PWM_1_PWMUDB_sP8_pwmdp_u0__A1_REG EQU CYREG_B0_UDB03_A1
PWM_1_PWMUDB_sP8_pwmdp_u0__D0_D1_REG EQU CYREG_B0_UDB03_D0_D1
PWM_1_PWMUDB_sP8_pwmdp_u0__D0_REG EQU CYREG_B0_UDB03_D0
PWM_1_PWMUDB_sP8_pwmdp_u0__D1_REG EQU CYREG_B0_UDB03_D1
PWM_1_PWMUDB_sP8_pwmdp_u0__DP_AUX_CTL_REG EQU CYREG_B0_UDB03_ACTL
PWM_1_PWMUDB_sP8_pwmdp_u0__F0_F1_REG EQU CYREG_B0_UDB03_F0_F1
PWM_1_PWMUDB_sP8_pwmdp_u0__F0_REG EQU CYREG_B0_UDB03_F0
PWM_1_PWMUDB_sP8_pwmdp_u0__F1_REG EQU CYREG_B0_UDB03_F1
PWM_1_PWMUDB_sP8_pwmdp_u0__MSK_DP_AUX_CTL_REG EQU CYREG_B0_UDB03_MSK_ACTL
PWM_1_PWMUDB_sP8_pwmdp_u0__PER_DP_AUX_CTL_REG EQU CYREG_B0_UDB03_MSK_ACTL

; PWM_2_PWMUDB
PWM_2_PWMUDB_sCTRLReg_SyncCtl_ctrlreg__16BIT_CONTROL_AUX_CTL_REG EQU CYREG_B0_UDB02_03_ACTL
PWM_2_PWMUDB_sCTRLReg_SyncCtl_ctrlreg__16BIT_CONTROL_CONTROL_REG EQU CYREG_B0_UDB02_03_CTL
PWM_2_PWMUDB_sCTRLReg_SyncCtl_ctrlreg__16BIT_CONTROL_COUNT_REG EQU CYREG_B0_UDB02_03_CTL
PWM_2_PWMUDB_sCTRLReg_SyncCtl_ctrlreg__16BIT_COUNT_CONTROL_REG EQU CYREG_B0_UDB02_03_CTL
PWM_2_PWMUDB_sCTRLReg_SyncCtl_ctrlreg__16BIT_COUNT_COUNT_REG EQU CYREG_B0_UDB02_03_CTL
PWM_2_PWMUDB_sCTRLReg_SyncCtl_ctrlreg__16BIT_MASK_MASK_REG EQU CYREG_B0_UDB02_03_MSK
PWM_2_PWMUDB_sCTRLReg_SyncCtl_ctrlreg__16BIT_MASK_PERIOD_REG EQU CYREG_B0_UDB02_03_MSK
PWM_2_PWMUDB_sCTRLReg_SyncCtl_ctrlreg__16BIT_PERIOD_MASK_REG EQU CYREG_B0_UDB02_03_MSK
PWM_2_PWMUDB_sCTRLReg_SyncCtl_ctrlreg__16BIT_PERIOD_PERIOD_REG EQU CYREG_B0_UDB02_03_MSK
PWM_2_PWMUDB_sCTRLReg_SyncCtl_ctrlreg__7__MASK EQU 0x80
PWM_2_PWMUDB_sCTRLReg_SyncCtl_ctrlreg__7__POS EQU 7
PWM_2_PWMUDB_sCTRLReg_SyncCtl_ctrlreg__CONTROL_AUX_CTL_REG EQU CYREG_B0_UDB02_ACTL
PWM_2_PWMUDB_sCTRLReg_SyncCtl_ctrlreg__CONTROL_REG EQU CYREG_B0_UDB02_CTL
PWM_2_PWMUDB_sCTRLReg_SyncCtl_ctrlreg__CONTROL_ST_REG EQU CYREG_B0_UDB02_ST_CTL
PWM_2_PWMUDB_sCTRLReg_SyncCtl_ctrlreg__COUNT_REG EQU CYREG_B0_UDB02_CTL
PWM_2_PWMUDB_sCTRLReg_SyncCtl_ctrlreg__COUNT_ST_REG EQU CYREG_B0_UDB02_ST_CTL
PWM_2_PWMUDB_sCTRLReg_SyncCtl_ctrlreg__MASK EQU 0x80
PWM_2_PWMUDB_sCTRLReg_SyncCtl_ctrlreg__MASK_CTL_AUX_CTL_REG EQU CYREG_B0_UDB02_MSK_ACTL
PWM_2_PWMUDB_sCTRLReg_SyncCtl_ctrlreg__PERIOD_REG EQU CYREG_B0_UDB02_MSK
PWM_2_PWMUDB_sCTRLReg_SyncCtl_ctrlreg__PER_CTL_AUX_CTL_REG EQU CYREG_B0_UDB02_MSK_ACTL
PWM_2_PWMUDB_sP8_pwmdp_u0__16BIT_A0_REG EQU CYREG_B0_UDB02_03_A0
PWM_2_PWMUDB_sP8_pwmdp_u0__16BIT_A1_REG EQU CYREG_B0_UDB02_03_A1
PWM_2_PWMUDB_sP8_pwmdp_u0__16BIT_D0_REG EQU CYREG_B0_UDB02_03_D0
PWM_2_PWMUDB_sP8_pwmdp_u0__16BIT_D1_REG EQU CYREG_B0_UDB02_03_D1
PWM_2_PWMUDB_sP8_pwmdp_u0__16BIT_DP_AUX_CTL_REG EQU CYREG_B0_UDB02_03_ACTL
PWM_2_PWMUDB_sP8_pwmdp_u0__16BIT_F0_REG EQU CYREG_B0_UDB02_03_F0
PWM_2_PWMUDB_sP8_pwmdp_u0__16BIT_F1_REG EQU CYREG_B0_UDB02_03_F1
PWM_2_PWMUDB_sP8_pwmdp_u0__A0_A1_REG EQU CYREG_B0_UDB02_A0_A1
PWM_2_PWMUDB_sP8_pwmdp_u0__A0_REG EQU CYREG_B0_UDB02_A0
PWM_2_PWMUDB_sP8_pwmdp_u0__A1_REG EQU CYREG_B0_UDB02_A1
PWM_2_PWMUDB_sP8_pwmdp_u0__D0_D1_REG EQU CYREG_B0_UDB02_D0_D1
PWM_2_PWMUDB_sP8_pwmdp_u0__D0_REG EQU CYREG_B0_UDB02_D0
PWM_2_PWMUDB_sP8_pwmdp_u0__D1_REG EQU CYREG_B0_UDB02_D1
PWM_2_PWMUDB_sP8_pwmdp_u0__DP_AUX_CTL_REG EQU CYREG_B0_UDB02_ACTL
PWM_2_PWMUDB_sP8_pwmdp_u0__F0_F1_REG EQU CYREG_B0_UDB02_F0_F1
PWM_2_PWMUDB_sP8_pwmdp_u0__F0_REG EQU CYREG_B0_UDB02_F0
PWM_2_PWMUDB_sP8_pwmdp_u0__F1_REG EQU CYREG_B0_UDB02_F1
PWM_2_PWMUDB_sP8_pwmdp_u0__MSK_DP_AUX_CTL_REG EQU CYREG_B0_UDB02_MSK_ACTL
PWM_2_PWMUDB_sP8_pwmdp_u0__PER_DP_AUX_CTL_REG EQU CYREG_B0_UDB02_MSK_ACTL

; Cond_Vout
Cond_Vout__0__MASK EQU 0x80
Cond_Vout__0__PC EQU CYREG_PRT0_PC7
Cond_Vout__0__PORT EQU 0
Cond_Vout__0__SHIFT EQU 7
Cond_Vout__AG EQU CYREG_PRT0_AG
Cond_Vout__AMUX EQU CYREG_PRT0_AMUX
Cond_Vout__BIE EQU CYREG_PRT0_BIE
Cond_Vout__BIT_MASK EQU CYREG_PRT0_BIT_MASK
Cond_Vout__BYP EQU CYREG_PRT0_BYP
Cond_Vout__CTL EQU CYREG_PRT0_CTL
Cond_Vout__DM0 EQU CYREG_PRT0_DM0
Cond_Vout__DM1 EQU CYREG_PRT0_DM1
Cond_Vout__DM2 EQU CYREG_PRT0_DM2
Cond_Vout__DR EQU CYREG_PRT0_DR
Cond_Vout__INP_DIS EQU CYREG_PRT0_INP_DIS
Cond_Vout__LCD_COM_SEG EQU CYREG_PRT0_LCD_COM_SEG
Cond_Vout__LCD_EN EQU CYREG_PRT0_LCD_EN
Cond_Vout__MASK EQU 0x80
Cond_Vout__PORT EQU 0
Cond_Vout__PRT EQU CYREG_PRT0_PRT
Cond_Vout__PRTDSI__CAPS_SEL EQU CYREG_PRT0_CAPS_SEL
Cond_Vout__PRTDSI__DBL_SYNC_IN EQU CYREG_PRT0_DBL_SYNC_IN
Cond_Vout__PRTDSI__OE_SEL0 EQU CYREG_PRT0_OE_SEL0
Cond_Vout__PRTDSI__OE_SEL1 EQU CYREG_PRT0_OE_SEL1
Cond_Vout__PRTDSI__OUT_SEL0 EQU CYREG_PRT0_OUT_SEL0
Cond_Vout__PRTDSI__OUT_SEL1 EQU CYREG_PRT0_OUT_SEL1
Cond_Vout__PRTDSI__SYNC_OUT EQU CYREG_PRT0_SYNC_OUT
Cond_Vout__PS EQU CYREG_PRT0_PS
Cond_Vout__SHIFT EQU 7
Cond_Vout__SLW EQU CYREG_PRT0_SLW

; Temp_Vout
Temp_Vout__0__MASK EQU 0x01
Temp_Vout__0__PC EQU CYREG_PRT0_PC0
Temp_Vout__0__PORT EQU 0
Temp_Vout__0__SHIFT EQU 0
Temp_Vout__AG EQU CYREG_PRT0_AG
Temp_Vout__AMUX EQU CYREG_PRT0_AMUX
Temp_Vout__BIE EQU CYREG_PRT0_BIE
Temp_Vout__BIT_MASK EQU CYREG_PRT0_BIT_MASK
Temp_Vout__BYP EQU CYREG_PRT0_BYP
Temp_Vout__CTL EQU CYREG_PRT0_CTL
Temp_Vout__DM0 EQU CYREG_PRT0_DM0
Temp_Vout__DM1 EQU CYREG_PRT0_DM1
Temp_Vout__DM2 EQU CYREG_PRT0_DM2
Temp_Vout__DR EQU CYREG_PRT0_DR
Temp_Vout__INP_DIS EQU CYREG_PRT0_INP_DIS
Temp_Vout__LCD_COM_SEG EQU CYREG_PRT0_LCD_COM_SEG
Temp_Vout__LCD_EN EQU CYREG_PRT0_LCD_EN
Temp_Vout__MASK EQU 0x01
Temp_Vout__PORT EQU 0
Temp_Vout__PRT EQU CYREG_PRT0_PRT
Temp_Vout__PRTDSI__CAPS_SEL EQU CYREG_PRT0_CAPS_SEL
Temp_Vout__PRTDSI__DBL_SYNC_IN EQU CYREG_PRT0_DBL_SYNC_IN
Temp_Vout__PRTDSI__OE_SEL0 EQU CYREG_PRT0_OE_SEL0
Temp_Vout__PRTDSI__OE_SEL1 EQU CYREG_PRT0_OE_SEL1
Temp_Vout__PRTDSI__OUT_SEL0 EQU CYREG_PRT0_OUT_SEL0
Temp_Vout__PRTDSI__OUT_SEL1 EQU CYREG_PRT0_OUT_SEL1
Temp_Vout__PRTDSI__SYNC_OUT EQU CYREG_PRT0_SYNC_OUT
Temp_Vout__PS EQU CYREG_PRT0_PS
Temp_Vout__SHIFT EQU 0
Temp_Vout__SLW EQU CYREG_PRT0_SLW

; Clock_1
Clock_1__CFG0 EQU CYREG_CLKDIST_DCFG1_CFG0
Clock_1__CFG1 EQU CYREG_CLKDIST_DCFG1_CFG1
Clock_1__CFG2 EQU CYREG_CLKDIST_DCFG1_CFG2
Clock_1__CFG2_SRC_SEL_MASK EQU 0x07
Clock_1__INDEX EQU 0x01
Clock_1__PM_ACT_CFG EQU CYREG_PM_ACT_CFG2
Clock_1__PM_ACT_MSK EQU 0x02
Clock_1__PM_STBY_CFG EQU CYREG_PM_STBY_CFG2
Clock_1__PM_STBY_MSK EQU 0x02

; Cond_Vs
Cond_Vs__0__MASK EQU 0x02
Cond_Vs__0__PC EQU CYREG_PRT3_PC1
Cond_Vs__0__PORT EQU 3
Cond_Vs__0__SHIFT EQU 1
Cond_Vs__AG EQU CYREG_PRT3_AG
Cond_Vs__AMUX EQU CYREG_PRT3_AMUX
Cond_Vs__BIE EQU CYREG_PRT3_BIE
Cond_Vs__BIT_MASK EQU CYREG_PRT3_BIT_MASK
Cond_Vs__BYP EQU CYREG_PRT3_BYP
Cond_Vs__CTL EQU CYREG_PRT3_CTL
Cond_Vs__DM0 EQU CYREG_PRT3_DM0
Cond_Vs__DM1 EQU CYREG_PRT3_DM1
Cond_Vs__DM2 EQU CYREG_PRT3_DM2
Cond_Vs__DR EQU CYREG_PRT3_DR
Cond_Vs__INP_DIS EQU CYREG_PRT3_INP_DIS
Cond_Vs__LCD_COM_SEG EQU CYREG_PRT3_LCD_COM_SEG
Cond_Vs__LCD_EN EQU CYREG_PRT3_LCD_EN
Cond_Vs__MASK EQU 0x02
Cond_Vs__PORT EQU 3
Cond_Vs__PRT EQU CYREG_PRT3_PRT
Cond_Vs__PRTDSI__CAPS_SEL EQU CYREG_PRT3_CAPS_SEL
Cond_Vs__PRTDSI__DBL_SYNC_IN EQU CYREG_PRT3_DBL_SYNC_IN
Cond_Vs__PRTDSI__OE_SEL0 EQU CYREG_PRT3_OE_SEL0
Cond_Vs__PRTDSI__OE_SEL1 EQU CYREG_PRT3_OE_SEL1
Cond_Vs__PRTDSI__OUT_SEL0 EQU CYREG_PRT3_OUT_SEL0
Cond_Vs__PRTDSI__OUT_SEL1 EQU CYREG_PRT3_OUT_SEL1
Cond_Vs__PRTDSI__SYNC_OUT EQU CYREG_PRT3_SYNC_OUT
Cond_Vs__PS EQU CYREG_PRT3_PS
Cond_Vs__SHIFT EQU 1
Cond_Vs__SLW EQU CYREG_PRT3_SLW

; Cond_Vx
Cond_Vx__0__MASK EQU 0x01
Cond_Vx__0__PC EQU CYREG_PRT3_PC0
Cond_Vx__0__PORT EQU 3
Cond_Vx__0__SHIFT EQU 0
Cond_Vx__AG EQU CYREG_PRT3_AG
Cond_Vx__AMUX EQU CYREG_PRT3_AMUX
Cond_Vx__BIE EQU CYREG_PRT3_BIE
Cond_Vx__BIT_MASK EQU CYREG_PRT3_BIT_MASK
Cond_Vx__BYP EQU CYREG_PRT3_BYP
Cond_Vx__CTL EQU CYREG_PRT3_CTL
Cond_Vx__DM0 EQU CYREG_PRT3_DM0
Cond_Vx__DM1 EQU CYREG_PRT3_DM1
Cond_Vx__DM2 EQU CYREG_PRT3_DM2
Cond_Vx__DR EQU CYREG_PRT3_DR
Cond_Vx__INP_DIS EQU CYREG_PRT3_INP_DIS
Cond_Vx__LCD_COM_SEG EQU CYREG_PRT3_LCD_COM_SEG
Cond_Vx__LCD_EN EQU CYREG_PRT3_LCD_EN
Cond_Vx__MASK EQU 0x01
Cond_Vx__PORT EQU 3
Cond_Vx__PRT EQU CYREG_PRT3_PRT
Cond_Vx__PRTDSI__CAPS_SEL EQU CYREG_PRT3_CAPS_SEL
Cond_Vx__PRTDSI__DBL_SYNC_IN EQU CYREG_PRT3_DBL_SYNC_IN
Cond_Vx__PRTDSI__OE_SEL0 EQU CYREG_PRT3_OE_SEL0
Cond_Vx__PRTDSI__OE_SEL1 EQU CYREG_PRT3_OE_SEL1
Cond_Vx__PRTDSI__OUT_SEL0 EQU CYREG_PRT3_OUT_SEL0
Cond_Vx__PRTDSI__OUT_SEL1 EQU CYREG_PRT3_OUT_SEL1
Cond_Vx__PRTDSI__SYNC_OUT EQU CYREG_PRT3_SYNC_OUT
Cond_Vx__PS EQU CYREG_PRT3_PS
Cond_Vx__SHIFT EQU 0
Cond_Vx__SLW EQU CYREG_PRT3_SLW

; Temp_Vs
Temp_Vs__0__MASK EQU 0x08
Temp_Vs__0__PC EQU CYREG_PRT3_PC3
Temp_Vs__0__PORT EQU 3
Temp_Vs__0__SHIFT EQU 3
Temp_Vs__AG EQU CYREG_PRT3_AG
Temp_Vs__AMUX EQU CYREG_PRT3_AMUX
Temp_Vs__BIE EQU CYREG_PRT3_BIE
Temp_Vs__BIT_MASK EQU CYREG_PRT3_BIT_MASK
Temp_Vs__BYP EQU CYREG_PRT3_BYP
Temp_Vs__CTL EQU CYREG_PRT3_CTL
Temp_Vs__DM0 EQU CYREG_PRT3_DM0
Temp_Vs__DM1 EQU CYREG_PRT3_DM1
Temp_Vs__DM2 EQU CYREG_PRT3_DM2
Temp_Vs__DR EQU CYREG_PRT3_DR
Temp_Vs__INP_DIS EQU CYREG_PRT3_INP_DIS
Temp_Vs__LCD_COM_SEG EQU CYREG_PRT3_LCD_COM_SEG
Temp_Vs__LCD_EN EQU CYREG_PRT3_LCD_EN
Temp_Vs__MASK EQU 0x08
Temp_Vs__PORT EQU 3
Temp_Vs__PRT EQU CYREG_PRT3_PRT
Temp_Vs__PRTDSI__CAPS_SEL EQU CYREG_PRT3_CAPS_SEL
Temp_Vs__PRTDSI__DBL_SYNC_IN EQU CYREG_PRT3_DBL_SYNC_IN
Temp_Vs__PRTDSI__OE_SEL0 EQU CYREG_PRT3_OE_SEL0
Temp_Vs__PRTDSI__OE_SEL1 EQU CYREG_PRT3_OE_SEL1
Temp_Vs__PRTDSI__OUT_SEL0 EQU CYREG_PRT3_OUT_SEL0
Temp_Vs__PRTDSI__OUT_SEL1 EQU CYREG_PRT3_OUT_SEL1
Temp_Vs__PRTDSI__SYNC_OUT EQU CYREG_PRT3_SYNC_OUT
Temp_Vs__PS EQU CYREG_PRT3_PS
Temp_Vs__SHIFT EQU 3
Temp_Vs__SLW EQU CYREG_PRT3_SLW

; Temp_Vx
Temp_Vx__0__MASK EQU 0x10
Temp_Vx__0__PC EQU CYREG_PRT3_PC4
Temp_Vx__0__PORT EQU 3
Temp_Vx__0__SHIFT EQU 4
Temp_Vx__AG EQU CYREG_PRT3_AG
Temp_Vx__AMUX EQU CYREG_PRT3_AMUX
Temp_Vx__BIE EQU CYREG_PRT3_BIE
Temp_Vx__BIT_MASK EQU CYREG_PRT3_BIT_MASK
Temp_Vx__BYP EQU CYREG_PRT3_BYP
Temp_Vx__CTL EQU CYREG_PRT3_CTL
Temp_Vx__DM0 EQU CYREG_PRT3_DM0
Temp_Vx__DM1 EQU CYREG_PRT3_DM1
Temp_Vx__DM2 EQU CYREG_PRT3_DM2
Temp_Vx__DR EQU CYREG_PRT3_DR
Temp_Vx__INP_DIS EQU CYREG_PRT3_INP_DIS
Temp_Vx__LCD_COM_SEG EQU CYREG_PRT3_LCD_COM_SEG
Temp_Vx__LCD_EN EQU CYREG_PRT3_LCD_EN
Temp_Vx__MASK EQU 0x10
Temp_Vx__PORT EQU 3
Temp_Vx__PRT EQU CYREG_PRT3_PRT
Temp_Vx__PRTDSI__CAPS_SEL EQU CYREG_PRT3_CAPS_SEL
Temp_Vx__PRTDSI__DBL_SYNC_IN EQU CYREG_PRT3_DBL_SYNC_IN
Temp_Vx__PRTDSI__OE_SEL0 EQU CYREG_PRT3_OE_SEL0
Temp_Vx__PRTDSI__OE_SEL1 EQU CYREG_PRT3_OE_SEL1
Temp_Vx__PRTDSI__OUT_SEL0 EQU CYREG_PRT3_OUT_SEL0
Temp_Vx__PRTDSI__OUT_SEL1 EQU CYREG_PRT3_OUT_SEL1
Temp_Vx__PRTDSI__SYNC_OUT EQU CYREG_PRT3_SYNC_OUT
Temp_Vx__PS EQU CYREG_PRT3_PS
Temp_Vx__SHIFT EQU 4
Temp_Vx__SLW EQU CYREG_PRT3_SLW

; Miscellaneous
; -- WARNING: define names containing LEOPARD or PANTHER are deprecated and will be removed in a future release
CYDEV_DEBUGGING_DPS_SWD_SWV EQU 6
CYDEV_CONFIG_UNUSED_IO_AllowButWarn EQU 0
CYDEV_CONFIGURATION_MODE_COMPRESSED EQU 0
CYDEV_CONFIG_FASTBOOT_ENABLED EQU 1
CYDEV_CHIP_REV_PSOC5LP_PRODUCTION EQU 0
CYDEV_CHIP_REVISION_5B_PRODUCTION EQU 0
CYDEV_CHIP_MEMBER_5B EQU 4
CYDEV_CHIP_FAMILY_PSOC5 EQU 3
CYDEV_CHIP_DIE_PSOC5LP EQU 4
CYDEV_CHIP_DIE_EXPECT EQU CYDEV_CHIP_DIE_PSOC5LP
BCLK__BUS_CLK__HZ EQU 24000000
BCLK__BUS_CLK__KHZ EQU 24000
BCLK__BUS_CLK__MHZ EQU 24
CYDEV_CHIP_DIE_ACTUAL EQU CYDEV_CHIP_DIE_EXPECT
CYDEV_CHIP_DIE_LEOPARD EQU 1
CYDEV_CHIP_DIE_PANTHER EQU 3
CYDEV_CHIP_DIE_PSOC4A EQU 2
CYDEV_CHIP_DIE_UNKNOWN EQU 0
CYDEV_CHIP_FAMILY_PSOC3 EQU 1
CYDEV_CHIP_FAMILY_PSOC4 EQU 2
CYDEV_CHIP_FAMILY_UNKNOWN EQU 0
CYDEV_CHIP_FAMILY_USED EQU CYDEV_CHIP_FAMILY_PSOC5
CYDEV_CHIP_JTAG_ID EQU 0x2E123069
CYDEV_CHIP_MEMBER_3A EQU 1
CYDEV_CHIP_MEMBER_4A EQU 2
CYDEV_CHIP_MEMBER_5A EQU 3
CYDEV_CHIP_MEMBER_UNKNOWN EQU 0
CYDEV_CHIP_MEMBER_USED EQU CYDEV_CHIP_MEMBER_5B
CYDEV_CHIP_REVISION_3A_ES1 EQU 0
CYDEV_CHIP_REVISION_3A_ES2 EQU 1
CYDEV_CHIP_REVISION_3A_ES3 EQU 3
CYDEV_CHIP_REVISION_3A_PRODUCTION EQU 3
CYDEV_CHIP_REVISION_4A_ES0 EQU 17
CYDEV_CHIP_REVISION_4A_PRODUCTION EQU 17
CYDEV_CHIP_REVISION_5A_ES0 EQU 0
CYDEV_CHIP_REVISION_5A_ES1 EQU 1
CYDEV_CHIP_REVISION_5A_PRODUCTION EQU 1
CYDEV_CHIP_REVISION_5B_ES0 EQU 0
CYDEV_CHIP_REVISION_USED EQU CYDEV_CHIP_REVISION_5B_PRODUCTION
CYDEV_CHIP_REV_EXPECT EQU CYDEV_CHIP_REV_PSOC5LP_PRODUCTION
CYDEV_CHIP_REV_LEOPARD_ES1 EQU 0
CYDEV_CHIP_REV_LEOPARD_ES2 EQU 1
CYDEV_CHIP_REV_LEOPARD_ES3 EQU 3
CYDEV_CHIP_REV_LEOPARD_PRODUCTION EQU 3
CYDEV_CHIP_REV_PANTHER_ES0 EQU 0
CYDEV_CHIP_REV_PANTHER_ES1 EQU 1
CYDEV_CHIP_REV_PANTHER_PRODUCTION EQU 1
CYDEV_CHIP_REV_PSOC4A_ES0 EQU 17
CYDEV_CHIP_REV_PSOC4A_PRODUCTION EQU 17
CYDEV_CHIP_REV_PSOC5LP_ES0 EQU 0
CYDEV_CONFIGURATION_COMPRESSED EQU 1
CYDEV_CONFIGURATION_DMA EQU 0
CYDEV_CONFIGURATION_ECC EQU 1
CYDEV_CONFIGURATION_IMOENABLED EQU CYDEV_CONFIG_FASTBOOT_ENABLED
CYDEV_CONFIGURATION_MODE EQU CYDEV_CONFIGURATION_MODE_COMPRESSED
CYDEV_CONFIGURATION_MODE_DMA EQU 2
CYDEV_CONFIGURATION_MODE_UNCOMPRESSED EQU 1
CYDEV_CONFIG_UNUSED_IO EQU CYDEV_CONFIG_UNUSED_IO_AllowButWarn
CYDEV_CONFIG_UNUSED_IO_AllowWithInfo EQU 1
CYDEV_CONFIG_UNUSED_IO_Disallowed EQU 2
CYDEV_DEBUGGING_DPS EQU CYDEV_DEBUGGING_DPS_SWD_SWV
CYDEV_DEBUGGING_DPS_Disable EQU 3
CYDEV_DEBUGGING_DPS_JTAG_4 EQU 1
CYDEV_DEBUGGING_DPS_JTAG_5 EQU 0
CYDEV_DEBUGGING_DPS_SWD EQU 2
CYDEV_DEBUGGING_ENABLE EQU 1
CYDEV_DEBUGGING_REQXRES EQU 1
CYDEV_DEBUGGING_XRES EQU 0
CYDEV_DEBUG_ENABLE_MASK EQU 0x20
CYDEV_DEBUG_ENABLE_REGISTER EQU CYREG_MLOGIC_DEBUG
CYDEV_DMA_CHANNELS_AVAILABLE EQU 24
CYDEV_ECC_ENABLE EQU 0
CYDEV_HEAP_SIZE EQU 0x1000
CYDEV_INSTRUCT_CACHE_ENABLED EQU 1
CYDEV_INTR_RISING EQU 0x00000000
CYDEV_PROJ_TYPE EQU 0
CYDEV_PROJ_TYPE_BOOTLOADER EQU 1
CYDEV_PROJ_TYPE_LOADABLE EQU 2
CYDEV_PROJ_TYPE_MULTIAPPBOOTLOADER EQU 3
CYDEV_PROJ_TYPE_STANDARD EQU 0
CYDEV_PROTECTION_ENABLE EQU 0
CYDEV_STACK_SIZE EQU 0x4000
CYDEV_USE_BUNDLED_CMSIS EQU 1
CYDEV_VARIABLE_VDDA EQU 0
CYDEV_VDDA_MV EQU 5000
CYDEV_VDDD_MV EQU 5000
CYDEV_VDDIO0_MV EQU 5000
CYDEV_VDDIO1_MV EQU 5000
CYDEV_VDDIO2_MV EQU 5000
CYDEV_VDDIO3_MV EQU 5000
CYDEV_VIO0 EQU 5
CYDEV_VIO0_MV EQU 5000
CYDEV_VIO1 EQU 5
CYDEV_VIO1_MV EQU 5000
CYDEV_VIO2 EQU 5
CYDEV_VIO2_MV EQU 5000
CYDEV_VIO3 EQU 5
CYDEV_VIO3_MV EQU 5000
DMA_CHANNELS_USED__MASK0 EQU 0x00000000
CYDEV_BOOTLOADER_ENABLE EQU 0
    ENDIF
    END
