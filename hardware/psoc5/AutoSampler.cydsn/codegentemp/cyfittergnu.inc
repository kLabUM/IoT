.ifndef INCLUDED_CYFITTERGNU_INC
.set INCLUDED_CYFITTERGNU_INC, 1
.include "cydevicegnu.inc"
.include "cydevicegnu_trm.inc"

/* Pin_Sampler_Completed_Sample */
.set Pin_Sampler_Completed_Sample__0__MASK, 0x10
.set Pin_Sampler_Completed_Sample__0__PC, CYREG_PRT4_PC4
.set Pin_Sampler_Completed_Sample__0__PORT, 4
.set Pin_Sampler_Completed_Sample__0__SHIFT, 4
.set Pin_Sampler_Completed_Sample__AG, CYREG_PRT4_AG
.set Pin_Sampler_Completed_Sample__AMUX, CYREG_PRT4_AMUX
.set Pin_Sampler_Completed_Sample__BIE, CYREG_PRT4_BIE
.set Pin_Sampler_Completed_Sample__BIT_MASK, CYREG_PRT4_BIT_MASK
.set Pin_Sampler_Completed_Sample__BYP, CYREG_PRT4_BYP
.set Pin_Sampler_Completed_Sample__CTL, CYREG_PRT4_CTL
.set Pin_Sampler_Completed_Sample__DM0, CYREG_PRT4_DM0
.set Pin_Sampler_Completed_Sample__DM1, CYREG_PRT4_DM1
.set Pin_Sampler_Completed_Sample__DM2, CYREG_PRT4_DM2
.set Pin_Sampler_Completed_Sample__DR, CYREG_PRT4_DR
.set Pin_Sampler_Completed_Sample__INP_DIS, CYREG_PRT4_INP_DIS
.set Pin_Sampler_Completed_Sample__LCD_COM_SEG, CYREG_PRT4_LCD_COM_SEG
.set Pin_Sampler_Completed_Sample__LCD_EN, CYREG_PRT4_LCD_EN
.set Pin_Sampler_Completed_Sample__MASK, 0x10
.set Pin_Sampler_Completed_Sample__PORT, 4
.set Pin_Sampler_Completed_Sample__PRT, CYREG_PRT4_PRT
.set Pin_Sampler_Completed_Sample__PRTDSI__CAPS_SEL, CYREG_PRT4_CAPS_SEL
.set Pin_Sampler_Completed_Sample__PRTDSI__DBL_SYNC_IN, CYREG_PRT4_DBL_SYNC_IN
.set Pin_Sampler_Completed_Sample__PRTDSI__OE_SEL0, CYREG_PRT4_OE_SEL0
.set Pin_Sampler_Completed_Sample__PRTDSI__OE_SEL1, CYREG_PRT4_OE_SEL1
.set Pin_Sampler_Completed_Sample__PRTDSI__OUT_SEL0, CYREG_PRT4_OUT_SEL0
.set Pin_Sampler_Completed_Sample__PRTDSI__OUT_SEL1, CYREG_PRT4_OUT_SEL1
.set Pin_Sampler_Completed_Sample__PRTDSI__SYNC_OUT, CYREG_PRT4_SYNC_OUT
.set Pin_Sampler_Completed_Sample__PS, CYREG_PRT4_PS
.set Pin_Sampler_Completed_Sample__SHIFT, 4
.set Pin_Sampler_Completed_Sample__SLW, CYREG_PRT4_SLW

/* Pin_Sampler_Sampler_Count */
.set Pin_Sampler_Sampler_Count__0__MASK, 0x04
.set Pin_Sampler_Sampler_Count__0__PC, CYREG_PRT4_PC2
.set Pin_Sampler_Sampler_Count__0__PORT, 4
.set Pin_Sampler_Sampler_Count__0__SHIFT, 2
.set Pin_Sampler_Sampler_Count__AG, CYREG_PRT4_AG
.set Pin_Sampler_Sampler_Count__AMUX, CYREG_PRT4_AMUX
.set Pin_Sampler_Sampler_Count__BIE, CYREG_PRT4_BIE
.set Pin_Sampler_Sampler_Count__BIT_MASK, CYREG_PRT4_BIT_MASK
.set Pin_Sampler_Sampler_Count__BYP, CYREG_PRT4_BYP
.set Pin_Sampler_Sampler_Count__CTL, CYREG_PRT4_CTL
.set Pin_Sampler_Sampler_Count__DM0, CYREG_PRT4_DM0
.set Pin_Sampler_Sampler_Count__DM1, CYREG_PRT4_DM1
.set Pin_Sampler_Sampler_Count__DM2, CYREG_PRT4_DM2
.set Pin_Sampler_Sampler_Count__DR, CYREG_PRT4_DR
.set Pin_Sampler_Sampler_Count__INP_DIS, CYREG_PRT4_INP_DIS
.set Pin_Sampler_Sampler_Count__LCD_COM_SEG, CYREG_PRT4_LCD_COM_SEG
.set Pin_Sampler_Sampler_Count__LCD_EN, CYREG_PRT4_LCD_EN
.set Pin_Sampler_Sampler_Count__MASK, 0x04
.set Pin_Sampler_Sampler_Count__PORT, 4
.set Pin_Sampler_Sampler_Count__PRT, CYREG_PRT4_PRT
.set Pin_Sampler_Sampler_Count__PRTDSI__CAPS_SEL, CYREG_PRT4_CAPS_SEL
.set Pin_Sampler_Sampler_Count__PRTDSI__DBL_SYNC_IN, CYREG_PRT4_DBL_SYNC_IN
.set Pin_Sampler_Sampler_Count__PRTDSI__OE_SEL0, CYREG_PRT4_OE_SEL0
.set Pin_Sampler_Sampler_Count__PRTDSI__OE_SEL1, CYREG_PRT4_OE_SEL1
.set Pin_Sampler_Sampler_Count__PRTDSI__OUT_SEL0, CYREG_PRT4_OUT_SEL0
.set Pin_Sampler_Sampler_Count__PRTDSI__OUT_SEL1, CYREG_PRT4_OUT_SEL1
.set Pin_Sampler_Sampler_Count__PRTDSI__SYNC_OUT, CYREG_PRT4_SYNC_OUT
.set Pin_Sampler_Sampler_Count__PS, CYREG_PRT4_PS
.set Pin_Sampler_Sampler_Count__SHIFT, 2
.set Pin_Sampler_Sampler_Count__SLW, CYREG_PRT4_SLW

/* Pin_Sampler_Trigger */
.set Pin_Sampler_Trigger__0__MASK, 0x40
.set Pin_Sampler_Trigger__0__PC, CYREG_PRT4_PC6
.set Pin_Sampler_Trigger__0__PORT, 4
.set Pin_Sampler_Trigger__0__SHIFT, 6
.set Pin_Sampler_Trigger__AG, CYREG_PRT4_AG
.set Pin_Sampler_Trigger__AMUX, CYREG_PRT4_AMUX
.set Pin_Sampler_Trigger__BIE, CYREG_PRT4_BIE
.set Pin_Sampler_Trigger__BIT_MASK, CYREG_PRT4_BIT_MASK
.set Pin_Sampler_Trigger__BYP, CYREG_PRT4_BYP
.set Pin_Sampler_Trigger__CTL, CYREG_PRT4_CTL
.set Pin_Sampler_Trigger__DM0, CYREG_PRT4_DM0
.set Pin_Sampler_Trigger__DM1, CYREG_PRT4_DM1
.set Pin_Sampler_Trigger__DM2, CYREG_PRT4_DM2
.set Pin_Sampler_Trigger__DR, CYREG_PRT4_DR
.set Pin_Sampler_Trigger__INP_DIS, CYREG_PRT4_INP_DIS
.set Pin_Sampler_Trigger__LCD_COM_SEG, CYREG_PRT4_LCD_COM_SEG
.set Pin_Sampler_Trigger__LCD_EN, CYREG_PRT4_LCD_EN
.set Pin_Sampler_Trigger__MASK, 0x40
.set Pin_Sampler_Trigger__PORT, 4
.set Pin_Sampler_Trigger__PRT, CYREG_PRT4_PRT
.set Pin_Sampler_Trigger__PRTDSI__CAPS_SEL, CYREG_PRT4_CAPS_SEL
.set Pin_Sampler_Trigger__PRTDSI__DBL_SYNC_IN, CYREG_PRT4_DBL_SYNC_IN
.set Pin_Sampler_Trigger__PRTDSI__OE_SEL0, CYREG_PRT4_OE_SEL0
.set Pin_Sampler_Trigger__PRTDSI__OE_SEL1, CYREG_PRT4_OE_SEL1
.set Pin_Sampler_Trigger__PRTDSI__OUT_SEL0, CYREG_PRT4_OUT_SEL0
.set Pin_Sampler_Trigger__PRTDSI__OUT_SEL1, CYREG_PRT4_OUT_SEL1
.set Pin_Sampler_Trigger__PRTDSI__SYNC_OUT, CYREG_PRT4_SYNC_OUT
.set Pin_Sampler_Trigger__PS, CYREG_PRT4_PS
.set Pin_Sampler_Trigger__SHIFT, 6
.set Pin_Sampler_Trigger__SLW, CYREG_PRT4_SLW

/* isr_SampleCounter */
.set isr_SampleCounter__INTC_CLR_EN_REG, CYREG_NVIC_CLRENA0
.set isr_SampleCounter__INTC_CLR_PD_REG, CYREG_NVIC_CLRPEND0
.set isr_SampleCounter__INTC_MASK, 0x01
.set isr_SampleCounter__INTC_NUMBER, 0
.set isr_SampleCounter__INTC_PRIOR_NUM, 7
.set isr_SampleCounter__INTC_PRIOR_REG, CYREG_NVIC_PRI_0
.set isr_SampleCounter__INTC_SET_EN_REG, CYREG_NVIC_SETENA0
.set isr_SampleCounter__INTC_SET_PD_REG, CYREG_NVIC_SETPEND0

/* Pin_Sampler_Power */
.set Pin_Sampler_Power__0__MASK, 0x80
.set Pin_Sampler_Power__0__PC, CYREG_PRT4_PC7
.set Pin_Sampler_Power__0__PORT, 4
.set Pin_Sampler_Power__0__SHIFT, 7
.set Pin_Sampler_Power__AG, CYREG_PRT4_AG
.set Pin_Sampler_Power__AMUX, CYREG_PRT4_AMUX
.set Pin_Sampler_Power__BIE, CYREG_PRT4_BIE
.set Pin_Sampler_Power__BIT_MASK, CYREG_PRT4_BIT_MASK
.set Pin_Sampler_Power__BYP, CYREG_PRT4_BYP
.set Pin_Sampler_Power__CTL, CYREG_PRT4_CTL
.set Pin_Sampler_Power__DM0, CYREG_PRT4_DM0
.set Pin_Sampler_Power__DM1, CYREG_PRT4_DM1
.set Pin_Sampler_Power__DM2, CYREG_PRT4_DM2
.set Pin_Sampler_Power__DR, CYREG_PRT4_DR
.set Pin_Sampler_Power__INP_DIS, CYREG_PRT4_INP_DIS
.set Pin_Sampler_Power__LCD_COM_SEG, CYREG_PRT4_LCD_COM_SEG
.set Pin_Sampler_Power__LCD_EN, CYREG_PRT4_LCD_EN
.set Pin_Sampler_Power__MASK, 0x80
.set Pin_Sampler_Power__PORT, 4
.set Pin_Sampler_Power__PRT, CYREG_PRT4_PRT
.set Pin_Sampler_Power__PRTDSI__CAPS_SEL, CYREG_PRT4_CAPS_SEL
.set Pin_Sampler_Power__PRTDSI__DBL_SYNC_IN, CYREG_PRT4_DBL_SYNC_IN
.set Pin_Sampler_Power__PRTDSI__OE_SEL0, CYREG_PRT4_OE_SEL0
.set Pin_Sampler_Power__PRTDSI__OE_SEL1, CYREG_PRT4_OE_SEL1
.set Pin_Sampler_Power__PRTDSI__OUT_SEL0, CYREG_PRT4_OUT_SEL0
.set Pin_Sampler_Power__PRTDSI__OUT_SEL1, CYREG_PRT4_OUT_SEL1
.set Pin_Sampler_Power__PRTDSI__SYNC_OUT, CYREG_PRT4_SYNC_OUT
.set Pin_Sampler_Power__PS, CYREG_PRT4_PS
.set Pin_Sampler_Power__SHIFT, 7
.set Pin_Sampler_Power__SLW, CYREG_PRT4_SLW

/* BottleCount */
.set BottleCount_sts_sts_reg__0__MASK, 0x01
.set BottleCount_sts_sts_reg__0__POS, 0
.set BottleCount_sts_sts_reg__16BIT_STATUS_AUX_CTL_REG, CYREG_B0_UDB00_01_ACTL
.set BottleCount_sts_sts_reg__16BIT_STATUS_REG, CYREG_B0_UDB00_01_ST
.set BottleCount_sts_sts_reg__1__MASK, 0x02
.set BottleCount_sts_sts_reg__1__POS, 1
.set BottleCount_sts_sts_reg__2__MASK, 0x04
.set BottleCount_sts_sts_reg__2__POS, 2
.set BottleCount_sts_sts_reg__3__MASK, 0x08
.set BottleCount_sts_sts_reg__3__POS, 3
.set BottleCount_sts_sts_reg__4__MASK, 0x10
.set BottleCount_sts_sts_reg__4__POS, 4
.set BottleCount_sts_sts_reg__5__MASK, 0x20
.set BottleCount_sts_sts_reg__5__POS, 5
.set BottleCount_sts_sts_reg__6__MASK, 0x40
.set BottleCount_sts_sts_reg__6__POS, 6
.set BottleCount_sts_sts_reg__7__MASK, 0x80
.set BottleCount_sts_sts_reg__7__POS, 7
.set BottleCount_sts_sts_reg__MASK, 0xFF
.set BottleCount_sts_sts_reg__MASK_REG, CYREG_B0_UDB00_MSK
.set BottleCount_sts_sts_reg__STATUS_AUX_CTL_REG, CYREG_B0_UDB00_ACTL
.set BottleCount_sts_sts_reg__STATUS_REG, CYREG_B0_UDB00_ST

/* SlowClock_1 */
.set SlowClock_1__CFG0, CYREG_CLKDIST_DCFG1_CFG0
.set SlowClock_1__CFG1, CYREG_CLKDIST_DCFG1_CFG1
.set SlowClock_1__CFG2, CYREG_CLKDIST_DCFG1_CFG2
.set SlowClock_1__CFG2_SRC_SEL_MASK, 0x07
.set SlowClock_1__INDEX, 0x01
.set SlowClock_1__PM_ACT_CFG, CYREG_PM_ACT_CFG2
.set SlowClock_1__PM_ACT_MSK, 0x02
.set SlowClock_1__PM_STBY_CFG, CYREG_PM_STBY_CFG2
.set SlowClock_1__PM_STBY_MSK, 0x02

/* SlowClock */
.set SlowClock__CFG0, CYREG_CLKDIST_DCFG0_CFG0
.set SlowClock__CFG1, CYREG_CLKDIST_DCFG0_CFG1
.set SlowClock__CFG2, CYREG_CLKDIST_DCFG0_CFG2
.set SlowClock__CFG2_SRC_SEL_MASK, 0x07
.set SlowClock__INDEX, 0x00
.set SlowClock__PM_ACT_CFG, CYREG_PM_ACT_CFG2
.set SlowClock__PM_ACT_MSK, 0x01
.set SlowClock__PM_STBY_CFG, CYREG_PM_STBY_CFG2
.set SlowClock__PM_STBY_MSK, 0x01

/* Miscellaneous */
/* -- WARNING: define names containing LEOPARD or PANTHER are deprecated and will be removed in a future release */
.set CYDEV_DEBUGGING_DPS_SWD_SWV, 6
.set CYDEV_CONFIG_UNUSED_IO_AllowButWarn, 0
.set CYDEV_CONFIGURATION_MODE_COMPRESSED, 0
.set CYDEV_CONFIG_FASTBOOT_ENABLED, 1
.set CYDEV_CHIP_REV_PSOC5LP_PRODUCTION, 0
.set CYDEV_CHIP_REVISION_5B_PRODUCTION, 0
.set CYDEV_CHIP_MEMBER_5B, 4
.set CYDEV_CHIP_FAMILY_PSOC5, 3
.set CYDEV_CHIP_DIE_PSOC5LP, 4
.set CYDEV_CHIP_DIE_EXPECT, CYDEV_CHIP_DIE_PSOC5LP
.set BCLK__BUS_CLK__HZ, 24000000
.set BCLK__BUS_CLK__KHZ, 24000
.set BCLK__BUS_CLK__MHZ, 24
.set CYDEV_CHIP_DIE_ACTUAL, CYDEV_CHIP_DIE_EXPECT
.set CYDEV_CHIP_DIE_LEOPARD, 1
.set CYDEV_CHIP_DIE_PANTHER, 3
.set CYDEV_CHIP_DIE_PSOC4A, 2
.set CYDEV_CHIP_DIE_UNKNOWN, 0
.set CYDEV_CHIP_FAMILY_PSOC3, 1
.set CYDEV_CHIP_FAMILY_PSOC4, 2
.set CYDEV_CHIP_FAMILY_UNKNOWN, 0
.set CYDEV_CHIP_FAMILY_USED, CYDEV_CHIP_FAMILY_PSOC5
.set CYDEV_CHIP_JTAG_ID, 0x2E123069
.set CYDEV_CHIP_MEMBER_3A, 1
.set CYDEV_CHIP_MEMBER_4A, 2
.set CYDEV_CHIP_MEMBER_5A, 3
.set CYDEV_CHIP_MEMBER_UNKNOWN, 0
.set CYDEV_CHIP_MEMBER_USED, CYDEV_CHIP_MEMBER_5B
.set CYDEV_CHIP_REVISION_3A_ES1, 0
.set CYDEV_CHIP_REVISION_3A_ES2, 1
.set CYDEV_CHIP_REVISION_3A_ES3, 3
.set CYDEV_CHIP_REVISION_3A_PRODUCTION, 3
.set CYDEV_CHIP_REVISION_4A_ES0, 17
.set CYDEV_CHIP_REVISION_4A_PRODUCTION, 17
.set CYDEV_CHIP_REVISION_5A_ES0, 0
.set CYDEV_CHIP_REVISION_5A_ES1, 1
.set CYDEV_CHIP_REVISION_5A_PRODUCTION, 1
.set CYDEV_CHIP_REVISION_5B_ES0, 0
.set CYDEV_CHIP_REVISION_USED, CYDEV_CHIP_REVISION_5B_PRODUCTION
.set CYDEV_CHIP_REV_EXPECT, CYDEV_CHIP_REV_PSOC5LP_PRODUCTION
.set CYDEV_CHIP_REV_LEOPARD_ES1, 0
.set CYDEV_CHIP_REV_LEOPARD_ES2, 1
.set CYDEV_CHIP_REV_LEOPARD_ES3, 3
.set CYDEV_CHIP_REV_LEOPARD_PRODUCTION, 3
.set CYDEV_CHIP_REV_PANTHER_ES0, 0
.set CYDEV_CHIP_REV_PANTHER_ES1, 1
.set CYDEV_CHIP_REV_PANTHER_PRODUCTION, 1
.set CYDEV_CHIP_REV_PSOC4A_ES0, 17
.set CYDEV_CHIP_REV_PSOC4A_PRODUCTION, 17
.set CYDEV_CHIP_REV_PSOC5LP_ES0, 0
.set CYDEV_CONFIGURATION_COMPRESSED, 1
.set CYDEV_CONFIGURATION_DMA, 0
.set CYDEV_CONFIGURATION_ECC, 1
.set CYDEV_CONFIGURATION_IMOENABLED, CYDEV_CONFIG_FASTBOOT_ENABLED
.set CYDEV_CONFIGURATION_MODE, CYDEV_CONFIGURATION_MODE_COMPRESSED
.set CYDEV_CONFIGURATION_MODE_DMA, 2
.set CYDEV_CONFIGURATION_MODE_UNCOMPRESSED, 1
.set CYDEV_CONFIG_UNUSED_IO, CYDEV_CONFIG_UNUSED_IO_AllowButWarn
.set CYDEV_CONFIG_UNUSED_IO_AllowWithInfo, 1
.set CYDEV_CONFIG_UNUSED_IO_Disallowed, 2
.set CYDEV_DEBUGGING_DPS, CYDEV_DEBUGGING_DPS_SWD_SWV
.set CYDEV_DEBUGGING_DPS_Disable, 3
.set CYDEV_DEBUGGING_DPS_JTAG_4, 1
.set CYDEV_DEBUGGING_DPS_JTAG_5, 0
.set CYDEV_DEBUGGING_DPS_SWD, 2
.set CYDEV_DEBUGGING_ENABLE, 1
.set CYDEV_DEBUGGING_REQXRES, 1
.set CYDEV_DEBUGGING_XRES, 0
.set CYDEV_DEBUG_ENABLE_MASK, 0x20
.set CYDEV_DEBUG_ENABLE_REGISTER, CYREG_MLOGIC_DEBUG
.set CYDEV_DMA_CHANNELS_AVAILABLE, 24
.set CYDEV_ECC_ENABLE, 0
.set CYDEV_HEAP_SIZE, 0x1000
.set CYDEV_INSTRUCT_CACHE_ENABLED, 1
.set CYDEV_INTR_RISING, 0x00000001
.set CYDEV_PROJ_TYPE, 0
.set CYDEV_PROJ_TYPE_BOOTLOADER, 1
.set CYDEV_PROJ_TYPE_LOADABLE, 2
.set CYDEV_PROJ_TYPE_MULTIAPPBOOTLOADER, 3
.set CYDEV_PROJ_TYPE_STANDARD, 0
.set CYDEV_PROTECTION_ENABLE, 0
.set CYDEV_STACK_SIZE, 0x4000
.set CYDEV_USE_BUNDLED_CMSIS, 1
.set CYDEV_VARIABLE_VDDA, 0
.set CYDEV_VDDA_MV, 5000
.set CYDEV_VDDD_MV, 5000
.set CYDEV_VDDIO0_MV, 5000
.set CYDEV_VDDIO1_MV, 5000
.set CYDEV_VDDIO2_MV, 5000
.set CYDEV_VDDIO3_MV, 5000
.set CYDEV_VIO0, 5
.set CYDEV_VIO0_MV, 5000
.set CYDEV_VIO1, 5
.set CYDEV_VIO1_MV, 5000
.set CYDEV_VIO2, 5
.set CYDEV_VIO2_MV, 5000
.set CYDEV_VIO3, 5
.set CYDEV_VIO3_MV, 5000
.set DMA_CHANNELS_USED__MASK0, 0x00000000
.set CYDEV_BOOTLOADER_ENABLE, 0
.endif
