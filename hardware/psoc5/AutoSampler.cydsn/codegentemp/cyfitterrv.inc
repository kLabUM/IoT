    IF :LNOT::DEF:INCLUDED_CYFITTERRV_INC
INCLUDED_CYFITTERRV_INC EQU 1
    GET cydevicerv.inc
    GET cydevicerv_trm.inc

; Pin_Sampler_Completed_Sample
Pin_Sampler_Completed_Sample__0__MASK EQU 0x10
Pin_Sampler_Completed_Sample__0__PC EQU CYREG_PRT4_PC4
Pin_Sampler_Completed_Sample__0__PORT EQU 4
Pin_Sampler_Completed_Sample__0__SHIFT EQU 4
Pin_Sampler_Completed_Sample__AG EQU CYREG_PRT4_AG
Pin_Sampler_Completed_Sample__AMUX EQU CYREG_PRT4_AMUX
Pin_Sampler_Completed_Sample__BIE EQU CYREG_PRT4_BIE
Pin_Sampler_Completed_Sample__BIT_MASK EQU CYREG_PRT4_BIT_MASK
Pin_Sampler_Completed_Sample__BYP EQU CYREG_PRT4_BYP
Pin_Sampler_Completed_Sample__CTL EQU CYREG_PRT4_CTL
Pin_Sampler_Completed_Sample__DM0 EQU CYREG_PRT4_DM0
Pin_Sampler_Completed_Sample__DM1 EQU CYREG_PRT4_DM1
Pin_Sampler_Completed_Sample__DM2 EQU CYREG_PRT4_DM2
Pin_Sampler_Completed_Sample__DR EQU CYREG_PRT4_DR
Pin_Sampler_Completed_Sample__INP_DIS EQU CYREG_PRT4_INP_DIS
Pin_Sampler_Completed_Sample__LCD_COM_SEG EQU CYREG_PRT4_LCD_COM_SEG
Pin_Sampler_Completed_Sample__LCD_EN EQU CYREG_PRT4_LCD_EN
Pin_Sampler_Completed_Sample__MASK EQU 0x10
Pin_Sampler_Completed_Sample__PORT EQU 4
Pin_Sampler_Completed_Sample__PRT EQU CYREG_PRT4_PRT
Pin_Sampler_Completed_Sample__PRTDSI__CAPS_SEL EQU CYREG_PRT4_CAPS_SEL
Pin_Sampler_Completed_Sample__PRTDSI__DBL_SYNC_IN EQU CYREG_PRT4_DBL_SYNC_IN
Pin_Sampler_Completed_Sample__PRTDSI__OE_SEL0 EQU CYREG_PRT4_OE_SEL0
Pin_Sampler_Completed_Sample__PRTDSI__OE_SEL1 EQU CYREG_PRT4_OE_SEL1
Pin_Sampler_Completed_Sample__PRTDSI__OUT_SEL0 EQU CYREG_PRT4_OUT_SEL0
Pin_Sampler_Completed_Sample__PRTDSI__OUT_SEL1 EQU CYREG_PRT4_OUT_SEL1
Pin_Sampler_Completed_Sample__PRTDSI__SYNC_OUT EQU CYREG_PRT4_SYNC_OUT
Pin_Sampler_Completed_Sample__PS EQU CYREG_PRT4_PS
Pin_Sampler_Completed_Sample__SHIFT EQU 4
Pin_Sampler_Completed_Sample__SLW EQU CYREG_PRT4_SLW

; Pin_Sampler_Sampler_Count
Pin_Sampler_Sampler_Count__0__MASK EQU 0x04
Pin_Sampler_Sampler_Count__0__PC EQU CYREG_PRT4_PC2
Pin_Sampler_Sampler_Count__0__PORT EQU 4
Pin_Sampler_Sampler_Count__0__SHIFT EQU 2
Pin_Sampler_Sampler_Count__AG EQU CYREG_PRT4_AG
Pin_Sampler_Sampler_Count__AMUX EQU CYREG_PRT4_AMUX
Pin_Sampler_Sampler_Count__BIE EQU CYREG_PRT4_BIE
Pin_Sampler_Sampler_Count__BIT_MASK EQU CYREG_PRT4_BIT_MASK
Pin_Sampler_Sampler_Count__BYP EQU CYREG_PRT4_BYP
Pin_Sampler_Sampler_Count__CTL EQU CYREG_PRT4_CTL
Pin_Sampler_Sampler_Count__DM0 EQU CYREG_PRT4_DM0
Pin_Sampler_Sampler_Count__DM1 EQU CYREG_PRT4_DM1
Pin_Sampler_Sampler_Count__DM2 EQU CYREG_PRT4_DM2
Pin_Sampler_Sampler_Count__DR EQU CYREG_PRT4_DR
Pin_Sampler_Sampler_Count__INP_DIS EQU CYREG_PRT4_INP_DIS
Pin_Sampler_Sampler_Count__LCD_COM_SEG EQU CYREG_PRT4_LCD_COM_SEG
Pin_Sampler_Sampler_Count__LCD_EN EQU CYREG_PRT4_LCD_EN
Pin_Sampler_Sampler_Count__MASK EQU 0x04
Pin_Sampler_Sampler_Count__PORT EQU 4
Pin_Sampler_Sampler_Count__PRT EQU CYREG_PRT4_PRT
Pin_Sampler_Sampler_Count__PRTDSI__CAPS_SEL EQU CYREG_PRT4_CAPS_SEL
Pin_Sampler_Sampler_Count__PRTDSI__DBL_SYNC_IN EQU CYREG_PRT4_DBL_SYNC_IN
Pin_Sampler_Sampler_Count__PRTDSI__OE_SEL0 EQU CYREG_PRT4_OE_SEL0
Pin_Sampler_Sampler_Count__PRTDSI__OE_SEL1 EQU CYREG_PRT4_OE_SEL1
Pin_Sampler_Sampler_Count__PRTDSI__OUT_SEL0 EQU CYREG_PRT4_OUT_SEL0
Pin_Sampler_Sampler_Count__PRTDSI__OUT_SEL1 EQU CYREG_PRT4_OUT_SEL1
Pin_Sampler_Sampler_Count__PRTDSI__SYNC_OUT EQU CYREG_PRT4_SYNC_OUT
Pin_Sampler_Sampler_Count__PS EQU CYREG_PRT4_PS
Pin_Sampler_Sampler_Count__SHIFT EQU 2
Pin_Sampler_Sampler_Count__SLW EQU CYREG_PRT4_SLW

; Pin_Sampler_Trigger
Pin_Sampler_Trigger__0__MASK EQU 0x40
Pin_Sampler_Trigger__0__PC EQU CYREG_PRT4_PC6
Pin_Sampler_Trigger__0__PORT EQU 4
Pin_Sampler_Trigger__0__SHIFT EQU 6
Pin_Sampler_Trigger__AG EQU CYREG_PRT4_AG
Pin_Sampler_Trigger__AMUX EQU CYREG_PRT4_AMUX
Pin_Sampler_Trigger__BIE EQU CYREG_PRT4_BIE
Pin_Sampler_Trigger__BIT_MASK EQU CYREG_PRT4_BIT_MASK
Pin_Sampler_Trigger__BYP EQU CYREG_PRT4_BYP
Pin_Sampler_Trigger__CTL EQU CYREG_PRT4_CTL
Pin_Sampler_Trigger__DM0 EQU CYREG_PRT4_DM0
Pin_Sampler_Trigger__DM1 EQU CYREG_PRT4_DM1
Pin_Sampler_Trigger__DM2 EQU CYREG_PRT4_DM2
Pin_Sampler_Trigger__DR EQU CYREG_PRT4_DR
Pin_Sampler_Trigger__INP_DIS EQU CYREG_PRT4_INP_DIS
Pin_Sampler_Trigger__LCD_COM_SEG EQU CYREG_PRT4_LCD_COM_SEG
Pin_Sampler_Trigger__LCD_EN EQU CYREG_PRT4_LCD_EN
Pin_Sampler_Trigger__MASK EQU 0x40
Pin_Sampler_Trigger__PORT EQU 4
Pin_Sampler_Trigger__PRT EQU CYREG_PRT4_PRT
Pin_Sampler_Trigger__PRTDSI__CAPS_SEL EQU CYREG_PRT4_CAPS_SEL
Pin_Sampler_Trigger__PRTDSI__DBL_SYNC_IN EQU CYREG_PRT4_DBL_SYNC_IN
Pin_Sampler_Trigger__PRTDSI__OE_SEL0 EQU CYREG_PRT4_OE_SEL0
Pin_Sampler_Trigger__PRTDSI__OE_SEL1 EQU CYREG_PRT4_OE_SEL1
Pin_Sampler_Trigger__PRTDSI__OUT_SEL0 EQU CYREG_PRT4_OUT_SEL0
Pin_Sampler_Trigger__PRTDSI__OUT_SEL1 EQU CYREG_PRT4_OUT_SEL1
Pin_Sampler_Trigger__PRTDSI__SYNC_OUT EQU CYREG_PRT4_SYNC_OUT
Pin_Sampler_Trigger__PS EQU CYREG_PRT4_PS
Pin_Sampler_Trigger__SHIFT EQU 6
Pin_Sampler_Trigger__SLW EQU CYREG_PRT4_SLW

; isr_SampleCounter
isr_SampleCounter__INTC_CLR_EN_REG EQU CYREG_NVIC_CLRENA0
isr_SampleCounter__INTC_CLR_PD_REG EQU CYREG_NVIC_CLRPEND0
isr_SampleCounter__INTC_MASK EQU 0x01
isr_SampleCounter__INTC_NUMBER EQU 0
isr_SampleCounter__INTC_PRIOR_NUM EQU 7
isr_SampleCounter__INTC_PRIOR_REG EQU CYREG_NVIC_PRI_0
isr_SampleCounter__INTC_SET_EN_REG EQU CYREG_NVIC_SETENA0
isr_SampleCounter__INTC_SET_PD_REG EQU CYREG_NVIC_SETPEND0

; Pin_Sampler_Power
Pin_Sampler_Power__0__MASK EQU 0x80
Pin_Sampler_Power__0__PC EQU CYREG_PRT4_PC7
Pin_Sampler_Power__0__PORT EQU 4
Pin_Sampler_Power__0__SHIFT EQU 7
Pin_Sampler_Power__AG EQU CYREG_PRT4_AG
Pin_Sampler_Power__AMUX EQU CYREG_PRT4_AMUX
Pin_Sampler_Power__BIE EQU CYREG_PRT4_BIE
Pin_Sampler_Power__BIT_MASK EQU CYREG_PRT4_BIT_MASK
Pin_Sampler_Power__BYP EQU CYREG_PRT4_BYP
Pin_Sampler_Power__CTL EQU CYREG_PRT4_CTL
Pin_Sampler_Power__DM0 EQU CYREG_PRT4_DM0
Pin_Sampler_Power__DM1 EQU CYREG_PRT4_DM1
Pin_Sampler_Power__DM2 EQU CYREG_PRT4_DM2
Pin_Sampler_Power__DR EQU CYREG_PRT4_DR
Pin_Sampler_Power__INP_DIS EQU CYREG_PRT4_INP_DIS
Pin_Sampler_Power__LCD_COM_SEG EQU CYREG_PRT4_LCD_COM_SEG
Pin_Sampler_Power__LCD_EN EQU CYREG_PRT4_LCD_EN
Pin_Sampler_Power__MASK EQU 0x80
Pin_Sampler_Power__PORT EQU 4
Pin_Sampler_Power__PRT EQU CYREG_PRT4_PRT
Pin_Sampler_Power__PRTDSI__CAPS_SEL EQU CYREG_PRT4_CAPS_SEL
Pin_Sampler_Power__PRTDSI__DBL_SYNC_IN EQU CYREG_PRT4_DBL_SYNC_IN
Pin_Sampler_Power__PRTDSI__OE_SEL0 EQU CYREG_PRT4_OE_SEL0
Pin_Sampler_Power__PRTDSI__OE_SEL1 EQU CYREG_PRT4_OE_SEL1
Pin_Sampler_Power__PRTDSI__OUT_SEL0 EQU CYREG_PRT4_OUT_SEL0
Pin_Sampler_Power__PRTDSI__OUT_SEL1 EQU CYREG_PRT4_OUT_SEL1
Pin_Sampler_Power__PRTDSI__SYNC_OUT EQU CYREG_PRT4_SYNC_OUT
Pin_Sampler_Power__PS EQU CYREG_PRT4_PS
Pin_Sampler_Power__SHIFT EQU 7
Pin_Sampler_Power__SLW EQU CYREG_PRT4_SLW

; BottleCount
BottleCount_sts_sts_reg__0__MASK EQU 0x01
BottleCount_sts_sts_reg__0__POS EQU 0
BottleCount_sts_sts_reg__16BIT_STATUS_AUX_CTL_REG EQU CYREG_B0_UDB12_13_ACTL
BottleCount_sts_sts_reg__16BIT_STATUS_REG EQU CYREG_B0_UDB12_13_ST
BottleCount_sts_sts_reg__1__MASK EQU 0x02
BottleCount_sts_sts_reg__1__POS EQU 1
BottleCount_sts_sts_reg__2__MASK EQU 0x04
BottleCount_sts_sts_reg__2__POS EQU 2
BottleCount_sts_sts_reg__3__MASK EQU 0x08
BottleCount_sts_sts_reg__3__POS EQU 3
BottleCount_sts_sts_reg__4__MASK EQU 0x10
BottleCount_sts_sts_reg__4__POS EQU 4
BottleCount_sts_sts_reg__5__MASK EQU 0x20
BottleCount_sts_sts_reg__5__POS EQU 5
BottleCount_sts_sts_reg__6__MASK EQU 0x40
BottleCount_sts_sts_reg__6__POS EQU 6
BottleCount_sts_sts_reg__7__MASK EQU 0x80
BottleCount_sts_sts_reg__7__POS EQU 7
BottleCount_sts_sts_reg__MASK EQU 0xFF
BottleCount_sts_sts_reg__MASK_REG EQU CYREG_B0_UDB12_MSK
BottleCount_sts_sts_reg__STATUS_AUX_CTL_REG EQU CYREG_B0_UDB12_ACTL
BottleCount_sts_sts_reg__STATUS_REG EQU CYREG_B0_UDB12_ST

; SlowClock_1
SlowClock_1__CFG0 EQU CYREG_CLKDIST_DCFG1_CFG0
SlowClock_1__CFG1 EQU CYREG_CLKDIST_DCFG1_CFG1
SlowClock_1__CFG2 EQU CYREG_CLKDIST_DCFG1_CFG2
SlowClock_1__CFG2_SRC_SEL_MASK EQU 0x07
SlowClock_1__INDEX EQU 0x01
SlowClock_1__PM_ACT_CFG EQU CYREG_PM_ACT_CFG2
SlowClock_1__PM_ACT_MSK EQU 0x02
SlowClock_1__PM_STBY_CFG EQU CYREG_PM_STBY_CFG2
SlowClock_1__PM_STBY_MSK EQU 0x02

; SlowClock
SlowClock__CFG0 EQU CYREG_CLKDIST_DCFG0_CFG0
SlowClock__CFG1 EQU CYREG_CLKDIST_DCFG0_CFG1
SlowClock__CFG2 EQU CYREG_CLKDIST_DCFG0_CFG2
SlowClock__CFG2_SRC_SEL_MASK EQU 0x07
SlowClock__INDEX EQU 0x00
SlowClock__PM_ACT_CFG EQU CYREG_PM_ACT_CFG2
SlowClock__PM_ACT_MSK EQU 0x01
SlowClock__PM_STBY_CFG EQU CYREG_PM_STBY_CFG2
SlowClock__PM_STBY_MSK EQU 0x01

; Miscellaneous
; -- WARNING: define names containing LEOPARD or PANTHER are deprecated and will be removed in a future release
CYDEV_DEBUGGING_DPS_SWD_SWV EQU 6
CYDEV_CONFIG_UNUSED_IO_AllowButWarn EQU 0
CYDEV_CONFIGURATION_MODE_COMPRESSED EQU 0
CYDEV_CONFIG_FASTBOOT_ENABLED EQU 0
CYDEV_CHIP_REV_PANTHER_PRODUCTION EQU 1
CYDEV_CHIP_REVISION_5A_PRODUCTION EQU 1
CYDEV_CHIP_MEMBER_5A EQU 3
CYDEV_CHIP_FAMILY_PSOC5 EQU 3
CYDEV_CHIP_DIE_PANTHER EQU 3
CYDEV_CHIP_DIE_EXPECT EQU CYDEV_CHIP_DIE_PANTHER
BCLK__BUS_CLK__HZ EQU 24000000
BCLK__BUS_CLK__KHZ EQU 24000
BCLK__BUS_CLK__MHZ EQU 24
CYDEV_CHIP_DIE_ACTUAL EQU CYDEV_CHIP_DIE_EXPECT
CYDEV_CHIP_DIE_LEOPARD EQU 1
CYDEV_CHIP_DIE_PSOC4A EQU 2
CYDEV_CHIP_DIE_PSOC5LP EQU 4
CYDEV_CHIP_DIE_UNKNOWN EQU 0
CYDEV_CHIP_FAMILY_PSOC3 EQU 1
CYDEV_CHIP_FAMILY_PSOC4 EQU 2
CYDEV_CHIP_FAMILY_UNKNOWN EQU 0
CYDEV_CHIP_FAMILY_USED EQU CYDEV_CHIP_FAMILY_PSOC5
CYDEV_CHIP_JTAG_ID EQU 0x0E13C069
CYDEV_CHIP_MEMBER_3A EQU 1
CYDEV_CHIP_MEMBER_4A EQU 2
CYDEV_CHIP_MEMBER_5B EQU 4
CYDEV_CHIP_MEMBER_UNKNOWN EQU 0
CYDEV_CHIP_MEMBER_USED EQU CYDEV_CHIP_MEMBER_5A
CYDEV_CHIP_REVISION_3A_ES1 EQU 0
CYDEV_CHIP_REVISION_3A_ES2 EQU 1
CYDEV_CHIP_REVISION_3A_ES3 EQU 3
CYDEV_CHIP_REVISION_3A_PRODUCTION EQU 3
CYDEV_CHIP_REVISION_4A_ES0 EQU 17
CYDEV_CHIP_REVISION_4A_PRODUCTION EQU 17
CYDEV_CHIP_REVISION_5A_ES0 EQU 0
CYDEV_CHIP_REVISION_5A_ES1 EQU 1
CYDEV_CHIP_REVISION_5B_ES0 EQU 0
CYDEV_CHIP_REVISION_5B_PRODUCTION EQU 0
CYDEV_CHIP_REVISION_USED EQU CYDEV_CHIP_REVISION_5A_PRODUCTION
CYDEV_CHIP_REV_EXPECT EQU CYDEV_CHIP_REV_PANTHER_PRODUCTION
CYDEV_CHIP_REV_LEOPARD_ES1 EQU 0
CYDEV_CHIP_REV_LEOPARD_ES2 EQU 1
CYDEV_CHIP_REV_LEOPARD_ES3 EQU 3
CYDEV_CHIP_REV_LEOPARD_PRODUCTION EQU 3
CYDEV_CHIP_REV_PANTHER_ES0 EQU 0
CYDEV_CHIP_REV_PANTHER_ES1 EQU 1
CYDEV_CHIP_REV_PSOC4A_ES0 EQU 17
CYDEV_CHIP_REV_PSOC4A_PRODUCTION EQU 17
CYDEV_CHIP_REV_PSOC5LP_ES0 EQU 0
CYDEV_CHIP_REV_PSOC5LP_PRODUCTION EQU 0
CYDEV_CONFIGURATION_COMPRESSED EQU 1
CYDEV_CONFIGURATION_DMA EQU 0
CYDEV_CONFIGURATION_ECC EQU 1
CYDEV_CONFIGURATION_IMOENABLED EQU CYDEV_CONFIG_FASTBOOT_ENABLED
CYDEV_CONFIGURATION_MODE EQU CYDEV_CONFIGURATION_MODE_COMPRESSED
CYDEV_CONFIGURATION_MODE_DMA EQU 2
CYDEV_CONFIGURATION_MODE_UNCOMPRESSED EQU 1
CYDEV_CONFIG_UNUSED_IO EQU CYDEV_CONFIG_UNUSED_IO_AllowButWarn
CYDEV_CONFIG_UNUSED_IO_AllowWithInfo EQU 1
CYDEV_CONFIG_UNUSED_IO_Disallowed EQU 2
CYDEV_DATA_CACHE_ENABLED EQU 0
CYDEV_DEBUGGING_DPS EQU CYDEV_DEBUGGING_DPS_SWD_SWV
CYDEV_DEBUGGING_DPS_Disable EQU 3
CYDEV_DEBUGGING_ENABLE EQU 1
CYDEV_DEBUGGING_REQXRES EQU 1
CYDEV_DEBUGGING_XRES EQU 0
CYDEV_DEBUG_ENABLE_MASK EQU 0x01
CYDEV_DEBUG_ENABLE_REGISTER EQU CYREG_MLOGIC_DBG_DBE
CYDEV_DMA_CHANNELS_AVAILABLE EQU 24
CYDEV_ECC_ENABLE EQU 0
CYDEV_HEAP_SIZE EQU 0x1000
CYDEV_INSTRUCT_CACHE_ENABLED EQU 1
CYDEV_INTR_RISING EQU 0x00000001
CYDEV_PROJ_TYPE EQU 0
CYDEV_PROJ_TYPE_BOOTLOADER EQU 1
CYDEV_PROJ_TYPE_LOADABLE EQU 2
CYDEV_PROJ_TYPE_MULTIAPPBOOTLOADER EQU 3
CYDEV_PROJ_TYPE_STANDARD EQU 0
CYDEV_PROTECTION_ENABLE EQU 0
CYDEV_STACK_SIZE EQU 0x4000
CYDEV_USE_BUNDLED_CMSIS EQU 1
CYDEV_VDDA_MV EQU 5000
CYDEV_VDDD_MV EQU 5000
CYDEV_VDDIO0_MV EQU 5000
CYDEV_VDDIO1_MV EQU 5000
CYDEV_VDDIO2_MV EQU 5000
CYDEV_VDDIO3_MV EQU 5000
CYDEV_VIO0 EQU 5
CYDEV_VIO0_MV EQU 5000
CYDEV_VIO1 EQU 5
CYDEV_VIO1_MV EQU 5000
CYDEV_VIO2 EQU 5
CYDEV_VIO2_MV EQU 5000
CYDEV_VIO3 EQU 5
CYDEV_VIO3_MV EQU 5000
DMA_CHANNELS_USED__MASK0 EQU 0x00000000
CYDEV_BOOTLOADER_ENABLE EQU 0
    ENDIF
    END
